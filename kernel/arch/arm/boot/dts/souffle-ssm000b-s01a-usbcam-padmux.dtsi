/*
* souffle-ssm000b-s01a-usbcam-padmux.dtsi- Sigmastar
*
* Copyright (c) [2019~2020] SigmaStar Technology.
*
*
* This software is licensed under the terms of the GNU General Public
* License version 2, as published by the Free Software Foundation, and
* may be copied, distributed, and modified under those terms.
*
* This program is distributed in the hope that it will be useful,
* but WITHOUT ANY WARRANTY; without even the implied warranty of
* MERCHANTABILITY or FITNESS FOR A PARTICULAR PURPOSE.  See the
* GNU General Public License version 2 for more details.
*
*/

#include "../../../../drivers/sstar/include/souffle/padmux.h"
#include "../../../../drivers/sstar/include/drv_puse.h"
#include "../../../../drivers/sstar/include/souffle/gpio.h"

/ {
    soc {
         padmux {
            compatible = "sstar,padmux";
            schematic =
                <PAD_I2C2_SCL            PINMUX_FOR_I2C0_MODE_5           MDRV_PUSE_I2C0_SCL>,
                <PAD_I2C2_SDA            PINMUX_FOR_I2C0_MODE_5           MDRV_PUSE_I2C0_SDA>,
                <PAD_I2C3_SCL            PINMUX_FOR_I2C3_MODE_1           MDRV_PUSE_I2C3_SCL>,
                <PAD_I2C3_SDA            PINMUX_FOR_I2C3_MODE_1           MDRV_PUSE_I2C3_SDA>,
# if 1
                // SDMMC0
                <PAD_SD0_D1              PINMUX_FOR_SD0_MODE_1            MDRV_PUSE_SDIO0_D1>,
                <PAD_SD0_D0              PINMUX_FOR_SD0_MODE_1            MDRV_PUSE_SDIO0_D0>,
                <PAD_SD0_CLK             PINMUX_FOR_SD0_MODE_1            MDRV_PUSE_SDIO0_CLK>,
                <PAD_SD0_CMD             PINMUX_FOR_SD0_MODE_1            MDRV_PUSE_SDIO0_CMD>,
                <PAD_SD0_D3              PINMUX_FOR_SD0_MODE_1            MDRV_PUSE_SDIO0_D3>,
                <PAD_SD0_D2              PINMUX_FOR_SD0_MODE_1            MDRV_PUSE_SDIO0_D2>,
                <PAD_SD0_GPIO0           PINMUX_FOR_GPIO_MODE             MDRV_PUSE_SDIO0_PWR>,
                <PAD_SD0_CDZ             PINMUX_FOR_SD0_CDZ_MODE_1        MDRV_PUSE_SDIO0_CDZ>,
#endif
#if 0
                //DMIC mode 6
                <PAD_PM_DMIC0_CLK        PINMUX_FOR_DMIC_6CH_MODE_6      MDRV_PUSE_DMIC0_CLK>,
                <PAD_PM_DMIC0_D0         PINMUX_FOR_DMIC_6CH_MODE_6      MDRV_PUSE_DMIC0_D0>,
                <PAD_ISP0_XHS            PINMUX_FOR_DMIC_6CH_MODE_6      MDRV_PUSE_DMIC0_D1>,
                <PAD_ISP0_XTRIG          PINMUX_FOR_DMIC_6CH_MODE_6      MDRV_PUSE_DMIC0_D2>,
                <PAD_ISP0_XVS            PINMUX_FOR_DMIC_6CH_MODE_6      MDRV_PUSE_DMIC0_D3>,
#endif
                <GPIO_NR                 PINMUX_FOR_UNKNOWN_MODE          MDRV_PUSE_NA>;
            status = "ok"; // ok or disable
        };
    };

};
