/*
* iford-cardv-ssc029a-s01a-padmux.dtsi- Sigmastar
*
* Copyright (c) [2019~2020] SigmaStar Technology.
*
*
* This software is licensed under the terms of the GNU General Public
* License version 2, as published by the Free Software Foundation, and
* may be copied, distributed, and modified under those terms.
*
* This program is distributed in the hope that it will be useful,
* but WITHOUT ANY WARRANTY; without even the implied warranty of
* MERCHANTABILITY or FITNESS FOR A PARTICULAR PURPOSE.  See the
* GNU General Public License version 2 for more details.
*
*/

#include "../../../../drivers/sstar/include/iford/padmux.h"
#include "../../../../drivers/sstar/include/drv_puse.h"
#include "../../../../drivers/sstar/include/iford/gpio.h"

/ {
    soc {
         padmux {
            compatible = "sstar,padmux";
            schematic =

                <PAD_I2C1_SCL       PINMUX_FOR_I2C1_MODE_1      MDRV_PUSE_I2C1_SCL>,
                <PAD_I2C1_SDA       PINMUX_FOR_I2C1_MODE_1      MDRV_PUSE_I2C1_SDA>,
                <PAD_PM_GPIO8       PINMUX_FOR_PM_IR_IN_MODE_1  MDRV_PUSE_IR>,
#if 1
                //LINEOUT AMP
                <PAD_PM_GPIO0            PINMUX_FOR_GPIO_MODE             MDRV_PUSE_AIO_AMP_PWR>,
#endif


                <PAD_SD0_D1              PINMUX_FOR_SD0_MODE_1            MDRV_PUSE_SDIO0_D1>,
                <PAD_SD0_D0              PINMUX_FOR_SD0_MODE_1            MDRV_PUSE_SDIO0_D0>,
                <PAD_SD0_CLK             PINMUX_FOR_SD0_MODE_1            MDRV_PUSE_SDIO0_CLK>,
                <PAD_SD0_CMD             PINMUX_FOR_SD0_MODE_1            MDRV_PUSE_SDIO0_CMD>,
                <PAD_SD0_D3              PINMUX_FOR_SD0_MODE_1            MDRV_PUSE_SDIO0_D3>,
                <PAD_SD0_D2              PINMUX_FOR_SD0_MODE_1            MDRV_PUSE_SDIO0_D2>,
                <PAD_PM_GPIO11           PINMUX_FOR_GPIO_MODE             MDRV_PUSE_SDIO0_PWR>,
                <PAD_SD0_CDZ             PINMUX_FOR_SD0_CDZ_MODE_1        MDRV_PUSE_SDIO0_CDZ>,


                <GPIO_NR                 PINMUX_FOR_UNKNOWN_MODE          MDRV_PUSE_NA>;
            status = "ok"; // ok or disable
        };
    };

};
