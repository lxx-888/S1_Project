## project/configs/Kconfigs/image/Kconfig
```kconfig
menu "Image"
comment "The image configuration entry contains the partition configuration and"
comment "the bin file that the partition burns"

config CUSTOMIZE_CONFIG
    bool "Using Customize Image Config"
    default n

config IMAGE_CONFIG
    string "Image Partition Config"
    default "spinand.squashfs.partition.config"

config IPL_CONFIG
    string "IPL File Config"
    default "IPL.bin"

config IPL_CUST_CONFIG
    string "IPL_CUST File Config"
    default "IPL_CUST.bin"

config IPLX_CONFIG
    string "IPLX File Config"
    default "IPLX.bin"
    help
        only emmc need config this

config USB_UPGRADE_IPL_CONFIG
    string "USB_UPGRADE_IPL_CONFIG"
    default "IPL.USB_UPD.bin"

config USB_UPGRADE_UBOOT_CONFIG
    string "USB_UPGRADE_UBOOT_CONFIG"
    default "u-boot_ufu.img.bin"

config SD_UPGRADE_IPL_CONFIG
     string "SD_UPGRADE_IPL_CONFIG"
     default ""

config SD_UPGRADE_IPL_CUST_CONFIG
     string "SD_UPGRADE_IPL_CUST_CONFIG"
     default ""

config TFA_CONFIG
    string "TF-A File Config"
    default ""

config OPTEE_CONFIG
    string "OPTEE File Config"
    default ""

config VMM_CONFIG
    depends on (DUAL_OS_TYPE = HYP)
    string "VMM File Config"
    default ""

choice
    prompt "Flash Size"
    default FLASE_SIZE_NONE
    help
        only nor flash need config this

    config FLASH_SIZE_NONE
        bool "None"

    config FLASH_SIZE_8M
        bool "8M"

    config FLASH_SIZE_16M
        bool "16M"

    config FLASH_SIZE_32M
        bool "32M"

endchoice

config FLASH_SIZE
    string
    default "" if FLASH_SIZE_NONE
    default 8M if FLASH_SIZE_8M
    default 16M if FLASH_SIZE_16M
    default 32M if FLASH_SIZE_32M

config EMMC_BACKUPS
    bool "EMMC BOOT_PART.bin support backups"
    default n
    help
        only emmc need config this


source configs/Kconfigs/image/riscv/Kconfig

source configs/Kconfigs/image/pm51/Kconfig

config CONFIG_ENABLE_POWER_SAVE_AOV
    bool "Support AOV Image"
    default n
    help
        Packing MI modules into dualos image

config ENABLE_CM4_PRELOAD
    depends on BOOL_DUAL_OS
    bool "Support cm4 preload Image"
    default n
    help
        Packing MI modules into dualos image

config DLA_FIRMWARE_LIST
    string "dla firmware"
    default ""

config REMOVE_LIBS_LIST
    string "libs list to remove"
    default ""

config STRIP_OPTION
    string "STRIP OPTION"
    default "--strip-debug"
    help
        Control modules/library strip level

endmenu
```

## project/configs/Kconfigs/image/pm51/Kconfig
```kconfig
menu "pm51"
    depends on (CHIP = p5)

config PM51_BIN
    string "pm51 Bin"
    default ""

endmenu
```

## project/configs/Kconfigs/image/riscv/Kconfig
```kconfig
menu "riscv"
    depends on (CHIP = p5)

config RISCVFW_BIN
    string "riscvfw Bin"
    default ""

endmenu
```

## project/configs/Kconfigs/kernel/Kconfig
```kconfig
menu "Kernel"
    depends on !BOOL_PURE_RTOS

choice
    prompt "Kernel Version"
    default KERNEL_VERSION_4.9.84

    config KERNEL_VERSION_4.9.84
        bool "4.9.84"

    config KERNEL_VERSION_4.9.227
        bool "4.9.227"

    config KERNEL_VERSION_4.19.162
        bool "4.19.162"

    config KERNEL_VERSION_5.10
        bool "5.10"

    config KERNEL_VERSION_6.1
        bool "6.1"
endchoice

config KERNEL_VERSION
    string
    default 4.9.84 if KERNEL_VERSION_4.9.84
    default 4.9.227 if KERNEL_VERSION_4.9.227
    default 4.19.162 if KERNEL_VERSION_4.19.162
    default 5.10 if KERNEL_VERSION_5.10
    default 6.1 if KERNEL_VERSION_6.1

config KERNEL_CONFIG
    string "Kernel Config"
    default ""

config KERNEL_BIN
    string "kernel Bin"
    default "Image-fpga" if BOOL_FPGA
    default "uImage" if BOOL_PZ1
    default "uImage.sz"

if CHIP = android
config KERNEL_DTB_NAME
    string "Kernel DTB NAME"
    default ""

config KERNEL_DTBO_NAME
    string "Kernel DTBO NAME"
    default ""

config KERNEL_DTBO_LIST
    string "Kernel DTBO LIST"
    default ""
endif

menu "Mmap"

config KERNEL_RESERVED_RISCV
    depends on (CHIP = p5)
    string "Kernel Reserved RISCV"
    default ""
endmenu

endmenu
```

## project/configs/Kconfigs/misc_options/Kconfig
```kconfig
menu "Misc Options"

config BOOL_FPGA
    bool "Fpga"
    default n

config FPGA
    int
    range 0 1
    default 1 if BOOL_FPGA
    default 0

config BOOL_PZ1
    bool "Fz1"
    default n

config PZ1
    int
    range 0 1
    default 1 if BOOL_PZ1
    default 0

config BOOL_BENCH
    bool "Bench"
    default n

config BENCH
    string
    default yes if BOOL_BENCH
    default no

config DOWNLOADADDR
    string "TFTP Download Addr"
    default ""

config KERNELBOOTADDR
    string "Kernel Boot Addr"
    default ""

config INITRAMFSLOADADDR
    string "Init Ramfs Addr"
    default ""

config SPLIT_EACH_FILE_SIZE
    string "Split Each File Size"
    default ""

choice
    prompt "upgrade_type"
    default TFTP

    config TFTP
        bool "tftp"

    config SD
        bool "sd"
endchoice

config UPGRADE_TYPE
    string
    default tftp if TFTP
    default sd if SD

config SD_UPGRADE_DEV
    int "which mmc device is the SD upgrade card"
    default 0
    help
    "when upgrade type is sd, or do make_sd_upgrade_sigmastar.sh, the option is useful"

config PACK_MOD_LIST
    string "kernel module list that only packs into image but not insmod"
    default ""

config CUST_MODPARAM
    string "customized linux modparam.json files"
    default ""

config CUST_MODPARAM_RTOS
    string "customized dualos or rtos modparam.json files"
    default ""

config USE_AB_SYSTEM_BOOT
    bool "use ab system boot"
    default n

source configs/Kconfigs/misc_options/sigma_wifi/Kconfig

source configs/Kconfigs/misc_options/ssh/Kconfig

source  configs/Kconfigs/misc_options/adb/Kconfig

source  configs/Kconfigs/misc_options/bootlogo/Kconfig

endmenu
```

## project/configs/Kconfigs/misc_options/adb/Kconfig
```kconfig
menu "ADB"

config ADB_TOOL
    bool "Support ADB"
    default n

config USE_ADB
    string
    default "on" if ADB_TOOL
    default "off"

endmenu
```

## project/configs/Kconfigs/misc_options/bootlogo/Kconfig
```kconfig
menu "BOOTLOGO"

config BOOTLOGO
    bool "Support BOOTLOGO"
    default n

config USE_BOOTLOGO
    string
    default "on" if BOOTLOGO
    default "off"

endmenu
```

## project/configs/Kconfigs/misc_options/ssh/Kconfig
```kconfig
menu "SSH"

config SSH_TOOL
    bool "Support SSH"
    default n

config USE_SSH
    string
    default "on" if SSH_TOOL
    default "off"

endmenu
```

## project/configs/Kconfigs/optee/Kconfig
```kconfig
menu "OPTEE"

config OPTEE_OS_MAKE_OPTION
    string "OPTEE OS make Option"
    default ""

config OPTEE_TEST
    bool "OPTEE Test"
    default n

endmenu
```
