## kernel/drivers/sstar/usb/Kconfig
```kconfig
source "drivers/sstar/usb/dwc3/Kconfig"
source "drivers/sstar/usb/phy/Kconfig"
source "drivers/sstar/usb/typec/Kconfig"
```

## kernel/drivers/sstar/usb/gadget/udc/usb20/Kconfig
```kconfig
config USB_SSTAR_MSB250X_UDC
	tristate "Sstar MSB250X USB 2.0 Device Controller"
	help
	  MSB250X is discrete USB2.0 device controller that supports both full and high speed
	  USB2.0 data transfers.

config USB_FPGA_VERIFICATION
	bool "FPGA verification only"
	depends on USB_SSTAR_MSB250X_UDC
	default n
	help
	  this only for FPGA, not select this item in asic.

config USB_MANUAL_MATCH_EP
        bool "test ep func of mamual match ep"
        depends on USB_SSTAR_MSB250X_UDC
        default n
        help
          usb endpoint selection, enable this can be insmod with parameters to specify which ep to use
```

## kernel/drivers/sstar/usb/phy/Kconfig
```kconfig
config SSTAR_USB3_PHY
	tristate "SStar USB3 PHY Driver"
	select GENERIC_PHY
	select USB_PHY
	select MFD_SYSCON
	help
	  Enable this to support Sigmastar USB3.0 PHY driver for Sigmastar
	  SoC. This driver will do the PHY initialization and shutdown.
	  The PHY driver will be used by Sigmastar USB3.0 driver.

	  To compile this driver as a module, choose M here.

config SSTAR_USB2_PHY
	tristate "SStar USB2 PHY Driver"
	select GENERIC_PHY
	select USB_PHY
	select MFD_SYSCON
	help
	  Enable this to support Sigmastar USB2.0 UTMI Transceiver driver
	  for Sigmastar SoC. This driver will do the UTMI initialization and
	  shutdown.The UTMI driver will be used by Sigmastar USB2.0 driver.

	  To compile this driver as a module, choose M here.

config SSTAR_USB_RESET_CONTROL
	tristate "SStar usb reset control support"
	default y if USB_SUPPORT
	select RESET_CONTROLLER if USB_SUPPORT
```

## kernel/drivers/sstar/usb/typec/Kconfig
```kconfig
config TYPEC_TUSB320
	tristate "TUSB320 USB Type-C connector driver"
	depends on I2C && USB_DWC3
	select REGMAP_I2C
	select TYPEC
	help
	  Say Y or M here if your system has a TUSB320xA Type-C DRP port
	  controller.

	  If you choose to build this driver as a dynamically linked module, the
	  module will be called tusb320.ko.
```

## kernel/drivers/sstar/ut/Kconfig
```kconfig
config SSTAR_UT
    tristate "Sigmastar UT Framework"
    default n
    help
      enable support for Sigmastar UT Framework
```

## kernel/drivers/sstar/voltage/Kconfig
```kconfig
config SSTAR_VOLTAGE_CTRL
    bool "Sstar Voltage Control"
    depends on SSTAR_GPIO
    default y

config SSTAR_VOLTAGE_CTRL_WITH_OSC
    bool "Sstar Voltage Control With OSC"
    depends on ARCH_INFINITY6C && SSTAR_VOLTAGE_CTRL
    default n
```

## kernel/drivers/sstar/voltage_idac/Kconfig
```kconfig
config SSTAR_VOLTAGE_IDAC_CTRL
    bool "Sstar Voltage IDAC Control"
    depends on SSTAR_GPIO && !SSTAR_VOLTAGE_CTRL
    default n

config SSTAR_VOLTAGE_IDAC_MIU_PHASE_SCALING_EN
    bool "Support miu phase scaling"
    depends on SSTAR_VOLTAGE_IDAC_CTRL
    default y

config SSTAR_VOLTAGE_IDAC_CTRL_BY_RTOS
    bool "Support rtos to control voltage"
    depends on SSTAR_VOLTAGE_IDAC_CTRL && SS_DUALOS
    default n
```

## kernel/drivers/sstar/watchdog/Kconfig
```kconfig
config SSTAR_WATCHDOG
	tristate "Sigmastar Watchdog Driver"
	default n
	help
	  Say Y here to enable the driver for the watchdog.
	  If unsure, say Y.
	  To compile this driver as a module, choose M here. The
	  module will be called drv_wdt.

config SSTAR_WATCHDOG_GOV
	bool "Sigmastar Watchdog Governor"
	depends on SSTAR_WATCHDOG && WATCHDOG_PRETIMEOUT_GOV
	default y
```

## kernel/sound/soc/sstar/Kconfig
```kconfig
# SPDX-License-Identifier: GPL-2.0-only
config SSTAR_SND_SOC
    tristate "Sstar ASoC Support"
    depends on ARCH_SSTAR
    select REGMAP_MMIO
    help
      This adds ASoC driver for SigmaStar SoC.
      that can be used with other codecs.
      Select Y if you have such device.
      If unsure select "N"
```

## project/Kconfig
```kconfig
#
# For a description of the syntax of this configuration file,
# see kernel/Documentation/kbuild/kconfig-language.txt.
mainmenu "Alkaid Configuration"

source configs/Kconfigs/chip/Kconfig

source configs/Kconfigs/product/Kconfig

source configs/Kconfigs/board/Kconfig

source configs/Kconfigs/toolchain/Kconfig

source configs/Kconfigs/busybox/Kconfig

source configs/Kconfigs/uboot/Kconfig

source configs/Kconfigs/optee/Kconfig

source configs/Kconfigs/dram_layout/Kconfig

source configs/Kconfigs/kernel/Kconfig

source configs/Kconfigs/image/Kconfig

source configs/Kconfigs/sensor/Kconfig

source configs/Kconfigs/customer_options/Kconfig

source configs/Kconfigs/misc_options/Kconfig

source configs/Kconfigs/rtos/Kconfig

source configs/Kconfigs/vmm/Kconfig

source configs/Kconfigs/pm_rtos/Kconfig

source configs/Kconfigs/sdk/Kconfig

source configs/Kconfigs/android/Kconfig

source configs/Kconfigs/secure_boot/Kconfig
```

## project/configs/Kconfigs/android/Kconfig
```kconfig
menu "Android"
    depends on (PRODUCT = android)

source configs/Kconfigs/android/ndk/Kconfig

endmenu
```

## project/configs/Kconfigs/android/ndk/Kconfig
```kconfig
menu "Android Ndk"

config NDK_API_VERSION
    string "NDK API Version"
    default 30

config NDK_CLANG_VERSION
    string "NDK Clang Version"
    default "9.0.9"

choice
    prompt "NDK Clang Target"
    default TARGET_ARMV7A-LINUX-ANDROIDEABI

    config TARGET_ARMV7A-LINUX-ANDROIDEABI
        bool "armv7a-linux-androideabi"

    config TARGET_AARCH64-LINUX-ANDROID
        bool "aarch64-linux-android"
endchoice

config NDK_CLANG_PREFIX
    string
    default "armv7a-linux-androideabi" if TARGET_ARMV7A-LINUX-ANDROIDEABI
    default "aarch64-linux-android" if TARGET_AARCH64-LINUX-ANDROID


choice
    prompt "NDK Binutils Prefix"
    default BINUTILS_PREFIX_ARM-LINUX-ANDROIDEABI

    config BINUTILS_PREFIX_ARM-LINUX-ANDROIDEABI
        bool "arm-linux-androideabi"

    config BINUTILS_PREFIX_AARCH64-LINUX-ANDROID
        bool "aarch64-linux-android"

    config BINUTILS_PREFIX_LLVM
        bool "llvm"
endchoice

config NDK_BINUTILS_PREFIX
    string
    default "arm-linux-androideabi" if BINUTILS_PREFIX_ARM-LINUX-ANDROIDEABI
    default "aarch64-linux-android" if BINUTILS_PREFIX_AARCH64-LINUX-ANDROID
    default "llvm" if BINUTILS_PREFIX_LLVM

endmenu
```

## project/configs/Kconfigs/chip/Kconfig
```kconfig
choice
    prompt "Chip"

    config Souffle
        bool "Souffle"

    config iford
        bool "iFord"
endchoice

config CHIP
    string
    default "souffle" if Souffle
    default "iford" if iford
```

## project/configs/Kconfigs/customer_options/Kconfig
```kconfig
menu "Customer Options"
config mi_dbg
    bool "Mi Dbg"
    default y

config MI_DBG
    int
    range 0 1
    default 0 if !mi_dbg
    default 1

config mi_enable_uv420_nv21_height16_align
    bool "Yuv420/nv21 data is max align uv height to 16"
    default n

config MI_ENABLE_UV420_NV21_HEIGHT16_ALIGN
    int
    range 0 1
    default 0 if !mi_enable_uv420_nv21_height16_align
    default 1

config BOOL_DEBUG_MODPARAM
    bool "DEBUG_MODPARAM"
    default n

config DEBUG_MODPARAM
    int
    range 0 1
    default 1 if BOOL_DEBUG_MODPARAM
    default 0

config CONFIG_ENABLE_MI_NORMAL_STR
    bool "MI suspend to RAM and standby"
    default n
    help
      Allow the mi modules to enter sleep states in which main memory is
      powered and thus its contents are preserved, such as the suspend-to-RAM state.

      If unsure, say N.

config CONFIG_ENABLE_MI_RTPM
    bool "MI runtime pm core functionality"
    default n
    help
      Enable functionality allowing mi modules to be put into energy-saving
      (low power) states, for example after a specified period of inactivity
      (autosuspended), and woken up in response to a hardware-generated
      wake-up event or a driver's request.

      Hardware support is generally required for this functionality to work.

      If unsure, say N.

config COMBINE_MI_MODULE
    bool "Merge all mi modules to a sstar_mi.ko"
    default n
    help
      This option will disable the compilation of standalone modules,
      and all mi modules will be linked to a sstar_mi.ko.

      If unsure, say N.

config COMBINE_MODULE_NAME
    string "Set combine module name"
    depends on COMBINE_MI_MODULE
    default "sstar_mi"

config COMBINE_IGNORE_MODULES
    string "Set combine ignore modules name"
    depends on COMBINE_MI_MODULE
    default "debug dummy"
    help
      These modules will not be linked to sstar_mi.ko,
      and mi_xxx.ko (xxx is a module name) will be generated.

config OVERDRIVE
    int "idac voltage ctrl: 0 - LD, 1 - NOD, 2 - OD, 3 - OFF"
    range 0 3
    default 3

menu "PROC DEBUG"
config DEBUG_SUPPORT
    tristate "DEBUG SUPPORT"
    help
      If you want to support debug,please INTERFACE_DEBUG say y,such as:
      Sdk config->Interface Compile Config->[*]debug

config ENABLE_PROC_DEBUG
    depends on DEBUG_SUPPORT=y && INTERFACE_DEBUG
    bool "ENABLE PROC DEBUG"
    default y

if  ENABLE_PROC_DEBUG
config enable_common_dump_buf_info
    bool "Enable Common Dump Buf Info"
    default y

config CONFIG_ENABLE_COMMON_DUMP_BUF_INFO
    int
    range 0 1
    default 0 if !enable_common_dump_buf_info
    default 1

config enable_module_dump_buf_info
    bool "Enable Module Dump Buf Info"
    default y

config CONFIG_ENABLE_MODULE_DUMP_BUF_INFO
    int
    range 0 1
    default 0 if !enable_module_dump_buf_info
    default 1

config ENABLE_ECHO_CMD
    bool "ENABLE ECHO CMD"
    default y

if  ENABLE_ECHO_CMD
config enable_sys_debug
    bool "Enable Sys Debug"
    default y

config CONFIG_ENABLE_SYS_DEBUG
    int
    range 0 1
    default 0 if !enable_sys_debug
    default 1

config enable_snr_debug
    bool "Enable Snr Debug"
    default y

config CONFIG_ENABLE_SNR_DEBUG
    int
    range 0 1
    default 0 if !enable_snr_debug
    default 1

config enable_vif_debug
    bool "Enable Vif Debug"
    default y

config CONFIG_ENABLE_VIF_DEBUG
    int
    range 0 1
    default 0 if !enable_vif_debug
    default 1

config enable_isp_debug
    bool "Enable Isp Debug"
    default y

config CONFIG_ENABLE_ISP_DEBUG
    int
    range 0 1
    default 0 if !enable_isp_debug
    default 1

config enable_scl_debug
    bool "Enable Scl Debug"
    default y

config CONFIG_ENABLE_SCL_DEBUG
    int
    range 0 1
    default 0 if !enable_scl_debug
    default 1

config enable_venc_debug
    bool "Enable Venc Debug"
    default y

config CONFIG_ENABLE_VENC_DEBUG
    int
    range 0 1
    default 0 if !enable_venc_debug
    default 1

config enable_vdec_debug
    bool "Enable Vdec Debug"
    default y

config CONFIG_ENABLE_VDEC_DEBUG
    int
    range 0 1
    default 0 if !enable_vdec_debug
    default 1

config enable_ive_debug
    bool "Enable Ive Debug"
    default y

config CONFIG_ENABLE_IVE_DEBUG
    int
    range 0 1
    default 0 if !enable_ive_debug
    default 1

config enable_jpd_debug
    bool "Enable Jpd Debug"
    default y

config CONFIG_ENABLE_JPD_DEBUG
    int
    range 0 1
    default 0 if !enable_jpd_debug
    default 1

config enable_ai_debug
    bool "Enable Ai Debug"
    default y

config CONFIG_ENABLE_AI_DEBUG
    int
    range 0 1
    default 0 if !enable_ai_debug
    default 1

config enable_ao_debug
    bool "Enable Ao Debug"
    default y

config CONFIG_ENABLE_AO_DEBUG
    int
    range 0 1
    default 0 if !enable_ao_debug
    default 1

config enable_rgn_debug
    bool "Enable Rgn Debug"
    default y

config CONFIG_ENABLE_RGN_DEBUG
    int
    range 0 1
    default 0 if !enable_rgn_debug
    default 1

config enable_disp_debug
    bool "Enable Disp Debug"
    default y

config CONFIG_ENABLE_DISP_DEBUG
    int
    range 0 1
    default 0 if !enable_disp_debug
    default 1

config enable_wbc_debug
    bool "Enable Wbc Debug"
    default y

config CONFIG_ENABLE_WBC_DEBUG
    int
    range 0 1
    default 0 if !enable_wbc_debug
    default 1

config enable_hdmi_debug
    bool "Enable Hdmi Debug"
    default y

config CONFIG_ENABLE_HDMI_DEBUG
    int
    range 0 1
    default 0 if !enable_hdmi_debug
    default 1

config enable_panel_debug
    bool "Enable Panel Debug"
    default y

config CONFIG_ENABLE_PANEL_DEBUG
    int
    range 0 1
    default 0 if !enable_panel_debug
    default 1

config enable_vdisp_debug
    bool "Enable Vdisp Debug"
    default y

config CONFIG_ENABLE_VDISP_DEBUG
    int
    range 0 1
    default 0 if !enable_vdisp_debug
    default 1

config enable_pcie_debug
    bool "Enable Pcie Debug"
    default y

config CONFIG_ENABLE_PCIE_DEBUG
    int
    range 0 1
    default 0 if !enable_pcie_debug
    default 1

config enable_shadow_debug
    bool "Enable Shadow(Vdf) Debug"
    default y

config CONFIG_ENABLE_SHADOW_DEBUG
    int
    range 0 1
    default 0 if !enable_shadow_debug
    default 1

config enable_ldc_debug
    bool "Enable LDC Debug"
    depends on (config_mi_ldc)
    default y

config CONFIG_ENABLE_LDC_DEBUG
    int
    range 0 1
    default 0 if !enable_ldc_debug
    default 1

config enable_dsp_debug
    bool "Enable Dsp Debug"
    default y

config CONFIG_ENABLE_DSP_DEBUG
    int
    range 0 1
    default 0 if !enable_dsp_debug
    default 1

config enable_fb_debug
    bool "Enable Fb Debug"
    default y

config CONFIG_ENABLE_FB_DEBUG
    int
    range 0 1
    default 0 if !enable_fb_debug
    default 1

config enable_gfx_debug
    bool "Enable Gfx Debug"
    default y

config CONFIG_ENABLE_GFX_DEBUG
    int
    range 0 1
    default 0 if !enable_gfx_debug
    default 1

config enable_hvp_debug
    bool "Enable Hvp Debug"
    default y

config CONFIG_ENABLE_HVP_DEBUG
    int
    range 0 1
    default 0 if !enable_hvp_debug
    default 1

config enable_pspi_debug
    bool "Enable Pspi Debug"
    default y

config CONFIG_ENABLE_PSPI_DEBUG
    int
    range 0 1
    default 0 if !enable_pspi_debug
    default 1

config enable_hdmirx_debug
    bool "Enable hdmirx Debug"
    default y

config CONFIG_ENABLE_HDMIRX_DEBUG
    int
    range 0 1
    default 0 if !enable_hdmirx_debug
    default 1

config enable_nir_debug
    bool "Enable Nir Debug"
    default y

config CONFIG_ENABLE_NIR_DEBUG
    int
    range 0 1
    default 0 if !enable_nir_debug
    default 1

config enable_dummy_debug
    bool "Enable Dummy Debug"
    default y

config CONFIG_ENABLE_DUMMY_DEBUG
    int
    range 0 1
    default 0 if !enable_dummy_debug
    default 1
endif
endif
endmenu
endmenu
```

## project/configs/Kconfigs/dram_layout/Kconfig
```kconfig
menu "DRAM_LAYOUT"

config DRAM_SIZE
    string "dram size"
    default "0"

config LX_MEM_SIZE
    string "LX Memory Size"
    default "0"

config MMA_MEM_SIZE
    string "MMA Memory Size"
    default "0"

config CMA_MEM_SIZE
    string "CMA Memory Size"
    default "0"

config LOGO_MEM_SIZE
    string "LOGO Memory Size"
    default "0"

config SMF_MEM_SIZE
    string "SMF Memory Size"
    default "0"

config RISCV_MEM_SIZE
    string "RISCV Memory Size"
    default "0"

config RTOS_MEM_SIZE
    string "RTOS Memory Size"
    default "0"

config RTOS_TIMESTAMP_MEM_SIZE
    string "RTOS Timestamp Memory Size"
    default "0"

config RTOS_RAMDISK_MEM_SIZE
    string "RTOS Ramdisk Memory Size"
    default "0"

config EARLYINIT_MEM_SIZE
    string "earlyinit Memory Size"
    default "0"

config RIU_RECORDER_MEM_SIZE
    string "riu recorder Memory Size"
    default "0"

config VMM_MEM_SIZE
    string "VMM Memory Size"
    default "0"

config OPTEE_MEM_SIZE
    string "OPTEE Memory Size"
    default "0"

config TFA_MEM_SIZE
    string "TF-A Memory Size"
    default "0"

config UBOOT_MEM_SIZE
    string "u-boot Memory Size"
    default "0x100000"

config FB_MEM_SIZE
    string "FB Memory Size"
    default "0"
endmenu
```
