## kernel/drivers/sstar/gyro/Kconfig
```kconfig
menuconfig SS_GYRO
    tristate "SStar Gyro Driver Support"
    default n
    help
        Support gyro for disalgo.

if SS_GYRO

# Limit: only support one device on souffle chip
#config  SUPPORT_MAXNUM_OF_GYRODEV
#        int "can support the max number of gyro devices"
#    default 4
#    depends on SS_GYRO_TRANSFER_I2C || SS_GYRO_TRANSFER_SPI
#
#menu "GYRO transfer choice"
#
#config SS_GYRO_TRANSFER_I2C
#    bool "Use I2C"
#    depends on I2C
#    default n
#    help
#        Use i2c to transfer data.
#
#config SS_GYRO_TRANSFER_SPI
#    bool "Use SPI"
#    depends on SPI_MASTER
#    default y
#    help
#        Use spi to transfer data.
#
#endmenu

choice
    prompt "GYRO transfer choice"
    default SS_GYRO_TRANSFER_SPI

config SS_GYRO_TRANSFER_I2C
	bool "Use I2C"
    depends on I2C
	help
		Use i2c to transfer data.

config SS_GYRO_TRANSFER_SPI
	bool "Use SPI"
    depends on SPI_MASTER
	help
		Use spi to transfer data.

endchoice

choice
    prompt "GYRO chip choice"
    default SS_GYRO_CHIP_ICG20660

config SS_GYRO_CHIP_ICG20660
    bool "ICG20660"
    help
        Use ICG20660

config SS_GYRO_CHIP_ICM40607
    bool "ICM40607"
    help
        Use ICM40607

config SS_GYRO_CHIP_ICM42607
    bool "ICM42607"
    help
        Use ICM42607

endchoice

config SS_GYRO_IOCTL
    bool "Enable gyro ioctl"
    default n
    help
        Enable gyro ioctl driver for user mode

config SS_GYRO_SYSFS
    bool "Enable gyro sysfs"
    default n
    help
        Enable gyro sysfs nodes for debug

config SS_GYRO_DEBUG_ON
    bool "Show debug info"
    default n
    help
        Show debug info

endif # SS_GYRO #
```

## kernel/drivers/sstar/i2c/Kconfig
```kconfig
config SSTAR_I2C
    tristate "Sstar I2C driver"
    help
        SigmaStar I2C driver function
```

## kernel/drivers/sstar/ir/Kconfig
```kconfig
config SSTAR_IR
tristate "Sstar IR driver"
    default n
    select INPUT
    select RC_CORE
    help
      enable support for IR driver
```

## kernel/drivers/sstar/ive/Kconfig
```kconfig
menuconfig SSTAR_IVE
    bool "SStar IVE driver"
    depends on SSTAR_DRIVERS
    default n

config SSTAR_IVE_SYS
    bool "Support IVE sys fs"
    depends on SSTAR_IVE
    default n
```

## kernel/drivers/sstar/mcu/Kconfig
```kconfig
config SSTAR_MCU
    bool "SStar MCU configuration driver"
    default n
    help
      Enable MCU configuration driver pass parameters to MCU only

config IR_KEY_NR
    int "Number of IR key for wakeup"
    depends on SSTAR_MCU
    default 3
    help
      Define number of IR key for wakeup system should match with
      configuration of MCU.
```

## kernel/drivers/sstar/miu/Kconfig
```kconfig
menuconfig SSTAR_MIU

tristate "SSTAR MIU"

help
    SStar miu driver

default y

if SSTAR_MIU

config MIU_HW_MMU
	bool "Support HW MMU"
	default y if CONFIG_CHIP!="ifado"

config MIU_BWLA
	bool "Support BWLA"
	default y if CONFIG_CHIP!="ifado"

config MIU_SW_QOS
	bool "Support SW QOS"
	default y if CONFIG_CHIP!="ifado"

config MIU_UT
    bool "sysfs:MIU ut"
    default n

endif #SSTAR_MIU
```

## kernel/drivers/sstar/miu_dq/Kconfig
```kconfig
config SSTAR_UPDATE_DQ
    tristate "MIU Update DQ"
    help
       Adjust update dq setting dynamically

    default y
    
```

## kernel/drivers/sstar/mspi/Kconfig
```kconfig
config SSTAR_MSPI
    tristate "Sstar MSPI driver"
    default n
    help
    Enable support for SPI master driver
```

## kernel/drivers/sstar/netphy/Kconfig
```kconfig
config SSTAR_NETPHY
      tristate "SSTAR 10/100 PHYs"
      default n
      help
        Currently supports the SSTAR ALBANY(10/100)
```

## kernel/drivers/sstar/padmux/Kconfig
```kconfig
config SSTAR_PADMUX
    tristate "PADMUX driver"
    help
       enable support for SigmaStar PADMUX driver

    default y
```

## kernel/drivers/sstar/power/Kconfig
```kconfig
config SSTAR_DUMMY_BATTERY
	tristate "SigmaStar dummy battery driver"
	default n
	help
	  "dummy battery driver for Android not battery device"
```

## kernel/drivers/sstar/pspi/Kconfig
```kconfig
config SSTAR_PSPI
    tristate "SStar PSPI driver"
    default n
    help
    Enable support for PSPI driver
```

## kernel/drivers/sstar/pwm/Kconfig
```kconfig
config SSTAR_PWM
    tristate "Sstar PWM driver"
    select PWM
    help
        enable support for PWM driver

config SSTAR_SPWM
    bool "Support SPWM function"
    depends on SSTAR_PWM
    default n
    help
        spwm and normal pwm functions are mutually exclusive

config SSTAR_PWM_DDT
    bool "Support dead time generation"
    depends on SSTAR_PWM
    default n
    help
        support dead time and break input

config SSTAR_PWM_EXTEND
    bool "Support high precision calculation"
    depends on SSTAR_PWM
    default y
    help
        support a wider range of parameter settings
```

## kernel/drivers/sstar/riu/Kconfig
```kconfig
config SSTAR_RIU_DBG
	bool "Sigmastar RIU Debug Driver"
	default y

config SSTAR_RIU_TIMEOUT
	bool "RIU timeout detector"
	default SSTAR_RIU_DBG
	depends on SSTAR_RIU_DBG
	help
	 "Support to detect RIU accessing timeout"

config SSTAR_RIU_RECORDER
	bool "RIU recorder"
	default n
	depends on SSTAR_RIU_DBG
	help
	 "Support to record RIU accessing"
```

## kernel/drivers/sstar/rpmsg/Kconfig
```kconfig
config SSTAR_DUALOS_DRIVER
        bool "SSTAR RPMSG-based dualos driver"
        default n

config SSTAR_CA7_VIRTIO
	bool "SSTAR ca7 virtio driver"
	default n
	select RPMSG
	select RPMSG_VIRTIO
	select SSTAR_RPMSG
	depends on ENABLE_CA7
	help
	  Say y here to enable I7 CA7 virtio device driver

config SSTAR_LH_RTOS_VIRTIO
    bool "SSTAR Light-Hypervisor RTOS virtio driver"
    default n
    select RPMSG
    select RPMSG_VIRTIO
    select SSTAR_RPMSG
    depends on LH_RTOS
    help
      Say y here to enable Light-Hypervisor RTOS virtio device driver

config SSTAR_RISCV_VIRTIO
	bool "SSTAR riscv virtio driver"
	default n
	select RPMSG
	select RPMSG_VIRTIO
	select SSTAR_DUALOS_DRIVER
	help
	  Say y here to enable SSTAR riscv virtio device driver

config SSTAR_RPMSG
	def_bool n
```

## kernel/drivers/sstar/rtc/Kconfig
```kconfig
config SSTAR_RTC
    select RTC_CLASS
    tristate "Sstar RTC Driver"
    default n

config SSTAR_RTC_WITH_PWC
    bool "Sstar RTC With PWC"
    depends on SSTAR_RTC
    default y

choice
    prompt "Sstar PWC IO Mode"
    depends on SSTAR_RTC_WITH_PWC && INPUT
    default SSTAR_PWC_IO_INTERRUPT

config SSTAR_PWC_IO_POLLING
    bool "Polling Mode"

config SSTAR_PWC_IO_INTERRUPT
    bool "Interrupt Mode"

endchoice

config SSTAR_RTC_WITH_ALARM
    bool "Sstar RTC With Alarm"
    depends on SSTAR_RTC
    default y

config SSTAR_RTC_WITH_OFFSET
    bool "Sstar RTC With Offset"
    depends on SSTAR_RTC
    default y

config PM_CLK_SRC_24M
    bool "Supports the removal of the RTC 32K crystal oscillator"
    default n
```

## kernel/drivers/sstar/sar/Kconfig
```kconfig
config SSTAR_ADCLP
    tristate "Sstar ADCLP driver"
    select IIO
    help
        ADCLP (Analog-Digital Converter Low Precision),
        utilize the principle of successive approximation ADC to obtain data with 10-bit accuracy.

        if you want ADCLP support, you should say Y here.
        you can also be built as a module. if so, the module will be called sstar-adclp.
```

## kernel/drivers/sstar/sdmmc/Kconfig
```kconfig
config SSTAR_SDMMC
        tristate "SStar SD/MMC Card Interface Support"
        depends on MMC
        default m
  help
        Enable SD/MMC Driver Support for SStar Product

choice
    prompt "Sstar SDMMC DDR Mode"
    depends on SSTAR_SDMMC
    default SSTAR_SDMMC_ADVANCE_MODE

config SSTAR_SDMMC_ADVANCE_MODE
    bool "sdr/ddr Mode"

config SSTAR_SDMMC_BYPASS_MODE
    bool "bypass Mode"

endchoice

choice
    prompt "Sstar SDMMC RECEIVE RESPONSE Mode"
    depends on SSTAR_SDMMC
    default SSTAR_SDMMC_INTERRUPT_MODE

config SSTAR_SDMMC_INTERRUPT_MODE
    bool "interrupt Mode"

config SSTAR_SDMMC_POLLING_MODE
    bool "polling Mode"

endchoice

config SUPPORT_SD30
        bool "Support SD30"
        depends on SSTAR_SDMMC
        default n

config SUPPORT_EMMC50
        bool "Support EMMC50"
        depends on SSTAR_SDMMC
        default n

config SUPPORT_SDMMC_COMMAND
        bool "Support SDMMC Command"
        depends on SSTAR_SDMMC
        default n

if SUPPORT_SDMMC_COMMAND
config SUPPORT_SDMMC_UT_VERIFY
        bool "Support SDMMC UT verify"
        depends on SSTAR_SDMMC
        default n
endif
config SUPPORT_SDMMC_AT_SMOKE
       bool "Support SDMMC AT/SMOKE test"
       depends on SSTAR_SDMMC
       default n

config SSTAR_SELECT_EMMC
        bool "SELECT EMMC"
        depends on SSTAR_SDMMC
        default n
```

## kernel/drivers/sstar/swla/Kconfig
```kconfig
config SSTAR_SWLA
    bool "Support SStar SWLA"
    default n

config SSTAR_SWLA_SYS_LOG_ENABLE
    bool "Enable SWLA system log"
    depends on SSTAR_SWLA
    default y

config SSTAR_SWLA_USR_LOG_ENABLE
    bool "Enable SWLA user log"
    depends on SSTAR_SWLA
    default y
```

## kernel/drivers/sstar/timer/Kconfig
```kconfig
config SSTAR_TIMER
    tristate "Sigmastar Timer Driver"
    help
      Say Y here to enable the driver for the timer.
      If unsure, say Y.
    default n
```

## kernel/drivers/sstar/uart/Kconfig
```kconfig
config SSTAR_UART
    bool "Sstar Uart Driver"
    select SERIAL_CORE
    select SERIAL_CORE_CONSOLE
    default n
```
