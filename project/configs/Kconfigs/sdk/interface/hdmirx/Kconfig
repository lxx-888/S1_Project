## project/configs/Kconfigs/sdk/interface/venc/Kconfig
```kconfig
menuconfig INTERFACE_VENC
    depends on SUPPORT_VENC
    bool "venc"
    default y
    help
        whether to compile or not

if INTERFACE_VENC

config MI_VENC_KAPI
    bool "KAPI"
    default n
    help
        whether to compile or not

config config_mi_venc
    bool "mi_venc"
    default y
    help
        whether to compile or not

config mi_venc_kapi
    string
    default yes if MI_VENC_KAPI
    default no if !MI_VENC_KAPI

endif

config interface_venc
    string
    default enable if INTERFACE_VENC
    default disable if !INTERFACE_VENC
```

## project/configs/Kconfigs/sdk/interface/vif/Kconfig
```kconfig
menuconfig INTERFACE_VIF
    depends on SUPPORT_VIF
    bool "vif"
    default y
    help
        whether to compile or not

if INTERFACE_VIF

config config_mi_vif
    bool "mi_vif"
    default y
    help
        whether to compile or not

config MI_VIF_KAPI
    bool "KAPI"
    default n
    help
        whether to compile or not

config mi_vif_kapi
    string
    default yes if MI_VIF_KAPI
    default no if !MI_VIF_KAPI

config VIF_DEBUG_IF
    bool "vif_debug_interface"
    default y
    help
        whether to enable vif debug interface

config DRV_VIF_LOG_LEVEL
    int "driver layer debug level"
    default 2
    help
        vif driver layer debug level

endif
config interface_vif
    string
    default enable if INTERFACE_VIF
    default disable if !INTERFACE_VIF
```

## project/configs/Kconfigs/sdk/interface/wlan/Kconfig
```kconfig
menuconfig INTERFACE_WLAN
    depends on SUPPORT_WLAN
    bool "wlan"
    default y
    help
        whether to compile or not

config interface_wlan
    string
    default enable if INTERFACE_WLAN
    default disable if !INTERFACE_WLAN
```
