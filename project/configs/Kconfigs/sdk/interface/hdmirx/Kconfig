## project/configs/Kconfigs/sdk/interface/hdmirx/Kconfig
```kconfig
menuconfig INTERFACE_HDMIRX
    depends on SUPPORT_HDMIRX
    bool "hdmirx"
    default n
    help
        whether to compile or not

config interface_hdmirx
    string
    default enable if INTERFACE_HDMIRX
    default disable if !INTERFACE_HDMIRX
```

## project/configs/Kconfigs/sdk/interface/hvp/Kconfig
```kconfig
menuconfig INTERFACE_HVP
    depends on SUPPORT_HVP
    bool "hvp"
    default n
    help
        whether to compile or not

if INTERFACE_HVP

config config_mi_hvp
    bool "mi_hvp"
    default y
    depends on MHAL_HVP
    help
        whether to compile or not

config MHAL_HVP
    bool "mhal_HVP"
    default y
    depends on INTERFACE_HVP
    help
        whether to compile or not

config mhal_hvp
    string
    default enable if MHAL_HVP
    default disable if !MHAL_HVP

endif
config interface_hvp
    string
    default enable if INTERFACE_HVP
    default disable if !INTERFACE_HVP

config interface_hvp
    string
    default enable if INTERFACE_HVP
    default disable if !INTERFACE_HVP
```

## project/configs/Kconfigs/sdk/interface/ipu/Kconfig
```kconfig
menuconfig INTERFACE_IPU
    depends on SUPPORT_IPU
    bool "ipu"
    default y
    help
        whether to compile or not

if INTERFACE_IPU

config config_mi_ipu
    bool "mi_ipu"
    default y
    help
        whether to compile or not

endif
config interface_ipu
    string
    default enable if INTERFACE_IPU
    default disable if !INTERFACE_IPU
```

## project/configs/Kconfigs/sdk/interface/iqserver/Kconfig
```kconfig
menuconfig INTERFACE_IQSERVER
    depends on SUPPORT_IQSERVER
    bool "iqserver"
    default y
    help
        whether to compile or not

config interface_iqserver
    string
    default enable if INTERFACE_IQSERVER
    default disable if !INTERFACE_IQSERVER
```

## project/configs/Kconfigs/sdk/interface/isp/Kconfig
```kconfig
menuconfig INTERFACE_ISP
    depends on SUPPORT_ISP
    bool "isp"
    default y
    select INTERFACE_VIF
    select INTERFACE_SENSOR
    help
        whether to compile or not

if INTERFACE_ISP

config MI_ISP_KAPI
    bool "KAPI"
    default n
    help
        whether to compile or not

config mi_isp_kapi
    string
    default yes if MI_ISP_KAPI
    default no if !MI_ISP_KAPI

config config_mi_isp
    bool "mi_isp"
    default y
    help
        whether to compile or not


endif
config interface_isp
    string
    default enable if INTERFACE_ISP
    default disable if !INTERFACE_ISP
```

## project/configs/Kconfigs/sdk/interface/ispalgo/Kconfig
```kconfig
menuconfig INTERFACE_ISPALGO
    depends on SUPPORT_ISPALGO
    bool "ispalgo"
    default y
    help
        whether to compile or not

config interface_ispalgo
    string
    default enable if INTERFACE_ISPALGO
    default disable if !INTERFACE_ISPALGO
```

## project/configs/Kconfigs/sdk/interface/ive/Kconfig
```kconfig
menuconfig INTERFACE_IVE
    depends on SUPPORT_IVE
    bool "ive"
    default n
    help
        whether to compile or not

config interface_ive
    string
    default enable if INTERFACE_IVE
    default disable if !INTERFACE_IVE
```

## project/configs/Kconfigs/sdk/interface/jpd/Kconfig
```kconfig
menuconfig INTERFACE_JPD
    depends on SUPPORT_JPD
    bool "jpd"
    default y
    help
        whether to compile or not

if INTERFACE_JPD

config config_mi_jpd
    bool "mi_jpd"
    default y
    help
        whether to compile or not

config MI_JPD_KAPI
    bool "KAPI"
    default n
    help
        whether to compile or not

config mi_jpd_kapi
    string
    default yes if MI_JPD_KAPI
    default no if !MI_JPD_KAPI

endif
config interface_jpd
    string
    default enable if INTERFACE_JPD
    default disable if !INTERFACE_JPD
```

## project/configs/Kconfigs/sdk/interface/ldc/Kconfig
```kconfig
menuconfig INTERFACE_LDC
    depends on SUPPORT_LDC
    bool "ldc"
    default y
    help
        whether to compile or not

if INTERFACE_LDC

config config_mi_ldc
    bool "mi_ldc"
    default y
    help
        whether to compile or not

config MI_LDC_LDC
    bool "LDC"
    depends on ( Souffle || iford )
    default y
    help
        LDC;CustomerMap;RegionBorder

config mi_ldc_ldc
    string
    default enable if MI_LDC_LDC
    default disable if !MI_LDC_LDC

config MI_LDC_PMF
    bool "PMF"
    depends on ( Souffle || iford )
    default y
    help
        PMF(3x3 matrix)
config mi_ldc_pmf
    string
    default enable if MI_LDC_PMF
    default disable if !MI_LDC_PMF

config MI_LDC_LUT
    bool "LUT"
    depends on ( Souffle )
    default y
    help
        LUT
config mi_ldc_lut
    string
    default enable if MI_LDC_LUT
    default disable if !MI_LDC_LUT

menuconfig MI_LDC_DIS
    bool "DIS"
    depends on ( ( Souffle || iford ) && (!BOOL_RTOS_ENABLE || CONFIG_ENABLE_POWER_SAVE_AOV))
    default y
    help
        dis_gme & dis_gyro(eis)

if MI_LDC_DIS
    config MI_LDC_DISGME
    bool "dis_gme"
    depends on (Souffle && (!BOOL_RTOS_ENABLE || CONFIG_ENABLE_POWER_SAVE_AOV))
    default y
    help
        support the dis gme logic

    config MI_LDC_DISGYRO
    bool "dis_gyro(eis)"
    depends on ( ( Souffle || iford ) && (!BOOL_RTOS_ENABLE || CONFIG_ENABLE_POWER_SAVE_AOV))
    default y
    help
        support the dis gyro logic
endif # end of MI_LDC_DIS
config mi_ldc_dis
    string
    default enable if MI_LDC_DIS
    default disable if !MI_LDC_DIS

config MI_LDC_STITCH
    bool "STITCH"
    depends on (Souffle && (!BOOL_RTOS_ENABLE || CONFIG_ENABLE_POWER_SAVE_AOV))
    default y
    help
        STITCH;DpuStitch;SeamStitch;DisplacementMapQueryPoint)
config mi_ldc_stitch
    string
    default enable if MI_LDC_STITCH
    default disable if !MI_LDC_STITCH

config MI_LDC_NIR
    bool "NIR"
    depends on (Souffle && (!BOOL_RTOS_ENABLE || CONFIG_ENABLE_POWER_SAVE_AOV))
    default y
    help
        NIR
config mi_ldc_nir
    string
    default enable if MI_LDC_NIR
    default disable if !MI_LDC_NIR

config MI_LDC_DPU
    bool "DPU"
    depends on (Souffle && (!BOOL_RTOS_ENABLE || CONFIG_ENABLE_POWER_SAVE_AOV))
    default y
    help
        DPU(DpuStitch;SeamStitch;)
config mi_ldc_dpu
    string
    default enable if MI_LDC_DPU
    default disable if !MI_LDC_DPU

endif ## end of INTERFACE_LDC

config interface_ldc
    string
    default enable if INTERFACE_LDC
    default disable if !INTERFACE_LDC
```

## project/configs/Kconfigs/sdk/interface/mipitx/Kconfig
```kconfig
menuconfig INTERFACE_MIPITX
    depends on SUPPORT_MIPITX
    bool "mipitx"
    select MHAL_MIPITX
    default y
    help
        whether to compile or not

if INTERFACE_MIPITX

config config_mi_mipitx
    bool "mi_mipitx"
    depends on MHAL_MIPITX
    default y
    help
        whether to compile or not

config MHAL_MIPITX
    bool "mhal_mipitx"
    depends on INTERFACE_MIPITX
    default y
    help
        whether to compile or not

config mhal_mipitx
    string
    default enable if MHAL_MIPITX
    default disable if !MHAL_MIPITX

endif
config interface_mipitx
    string
    default enable if INTERFACE_MIPITX
    default disable if !INTERFACE_MIPITX
```

## project/configs/Kconfigs/sdk/interface/nir/Kconfig
```kconfig
menuconfig INTERFACE_NIR
    depends on SUPPORT_NIR
    bool "nir"
    default y
    help
        whether to compile or not

config interface_nir
    string
    default enable if INTERFACE_NIR
    default disable if !INTERFACE_NIR
```

## project/configs/Kconfigs/sdk/interface/pcie/Kconfig
```kconfig
menuconfig INTERFACE_PCIE
    depends on SUPPORT_PCIE
    bool "pcie"
    default n
    help
        whether to compile or not

if INTERFACE_PCIE

config config_mi_pcie
    bool "mi_pcie"
    default y
    depends on MHAL_PCIE
    help
        whether to compile or not

config MHAL_PCIE
    bool "mhal_PCIE"
    default y
    depends on INTERFACE_PCIE
    help
        whether to compile or not

config mhal_pcie
    string
    default enable if MHAL_PCIE
    default disable if !MHAL_PCIE

endif

config interface_pcie
    string
    default enable if INTERFACE_PCIE
    default disable if !INTERFACE_PCIE
```

## project/configs/Kconfigs/sdk/interface/pspi/Kconfig
```kconfig
menuconfig INTERFACE_PSPI
    depends on SUPPORT_PSPI
    bool "pspi"
    default n
    select MHAL_PSPI
    help
        whether to compile or not

if INTERFACE_PSPI

config MHAL_PSPI
    bool "mhal_pspi"
    depends on INTERFACE_PSPI
    default y
    help
        whether to compile or not

config config_mi_pspi
    bool "mi_pspi"
    default y
    depends on MHAL_PSPI
    help
        whether to compile or not

config mhal_pspi
    string
    default enable if MHAL_PSPI
    default disable if !MHAL_PSPI

endif # pspi

config interface_pspi
    string
    default enable if INTERFACE_PSPI
    default disable if !INTERFACE_PSPI
```

## project/configs/Kconfigs/sdk/interface/rgn/Kconfig
```kconfig
menuconfig INTERFACE_RGN
    depends on SUPPORT_RGN
    bool "rgn"
    default y
    select MHAL_RGN
    help
        whether to compile or not

if INTERFACE_RGN

config config_mi_rgn
    bool "mi_rgn"
    depends on MHAL_RGN
    default y
    help
        whether to compile or not

if config_mi_rgn

config MI_RGN_SUPPORT_OSD
    bool "mi_rgn_osd"
    default y
    help
        whether to compile or not

if MI_RGN_SUPPORT_OSD

config MI_RGN_SUPPORT_SW_OSD
    bool "sw_osd"
    default y
    help
        whether to compile or not

if MI_RGN_SUPPORT_SW_OSD
config MI_RGN_SUPPORT_OVERLAY_BLENDING
    bool "overlay_blending"
    default n
    help
        whether to compile or not
endif

endif

config MI_RGN_SUPPORT_MFF
    bool "mi_rgn_mff"
    default y
    help
        whether to compile or not

if MI_RGN_SUPPORT_MFF

config MI_RGN_SUPPORT_COVER
    bool "support_cover"
    default y
    help
        whether to compile or not

if MI_RGN_SUPPORT_COVER

config MI_RGN_SUPPORT_MOSAIC
    bool "mosaic"
    default y
    help
        whether to compile or not

config MI_RGN_SUPPORT_COVER_MAP
    bool "cover_map"
    default y
    help
        whether to compile or not
endif
config MI_RGN_SUPPORT_FRAME
    bool "support_frame"
    default y
    help
        whether to compile or not
endif

config MI_RGN_SUPPORT_COLOR_INVERT
    bool "mi_rgn_ci"
    default y
    help
        whether to compile or not

config MI_RGN_SUPPORT_BUF_CNT
    bool "buffer cnt"
    default y
    help
        whether to compile or not
endif

config MHAL_RGN
    bool "mhal_rgn"
    depends on INTERFACE_RGN
    default y
    help
        whether to compile or not

config mhal_rgn
    string
    default enable if MHAL_RGN
    default disable if !MHAL_RGN

endif
config interface_rgn
    string
    default enable if INTERFACE_RGN
    default disable if !INTERFACE_RGN
```

## project/configs/Kconfigs/sdk/interface/scl/Kconfig
```kconfig
menuconfig INTERFACE_SCL
    depends on SUPPORT_SCL
    bool "scl"
    default y
    select MHAL_VPE
    help
        whether to compile or not

if INTERFACE_SCL

config MI_SCL_KAPI
    bool "KAPI"
    default n
    help
        whether to compile or not

config mi_scl_kapi
    string
    default yes if MI_SCL_KAPI
    default no if !MI_SCL_KAPI

config config_mi_scl
    bool "mi_scl"
    depends on MHAL_VPE
    default y
    help
        whether to compile or not

config MHAL_VPE
    bool "mhal_vpe"
    depends on INTERFACE_SCL
    default y
    help
        whether to compile or not

config mhal_vpe
    string
    default enable if MHAL_VPE
    default disable if !MHAL_VPE

endif
config interface_scl
    string
    default enable if INTERFACE_SCL
    default disable if !INTERFACE_SCL
```

## project/configs/Kconfigs/sdk/interface/sed/Kconfig
```kconfig
menuconfig INTERFACE_SED
    depends on SUPPORT_SED
    bool "sed"
    default y
    help
        whether to compile or not

config interface_sed
    string
    default enable if INTERFACE_SED
    default disable if !INTERFACE_SED
```

## project/configs/Kconfigs/sdk/interface/sensor/Kconfig
```kconfig
menuconfig INTERFACE_SENSOR
    depends on SUPPORT_SENSOR
    bool "sensor"
    default y
    select INTERFACE_VIF
    help
        whether to compile or not

if INTERFACE_SENSOR

config MI_SENSOR_KAPI
    bool "KAPI"
    default n
    help
        whether to compile or not

config mi_sensor_kapi
    string
    default yes if MI_SENSOR_KAPI
    default no if !MI_SENSOR_KAPI

config config_mi_sensor
    bool "mi_sensor"
    default y
    help
        whether to compile or not

config SENSOR_SUPPORT_IR
    bool "sensor support IR"
    default n
    select SENSOR_SUPPORT_PWM
    help
       whether sensor support IR

config SENSOR_SUPPORT_DUALSNR_RT
    bool "sensor support dual sensor realtime"
    default n
    select SENSOR_SUPPORT_PWM
    help
       whether sensor support dual sensor realtime

config SENSOR_SUPPORT_AOV_DUALSNR_RT
    bool "sensor support aov dual sensor realtime"
    default n
    select SENSOR_SUPPORT_PWM
    help
       whether sensor support aov dual sensor realtime

config SENSOR_SUPPORT_PWM
    bool "sensor support PWM"
    default n
    help
        whether sensor support pwm

endif
config interface_sensor
    string
    default enable if INTERFACE_SENSOR
    default disable if !INTERFACE_SENSOR
```

## project/configs/Kconfigs/sdk/interface/shadow/Kconfig
```kconfig
menuconfig INTERFACE_SHADOW
    depends on SUPPORT_SHADOW
    bool "shadow"
    default y
    help
        whether to compile or not

config interface_shadow
    string
    default enable if INTERFACE_SHADOW
    default disable if !INTERFACE_SHADOW
```

## project/configs/Kconfigs/sdk/interface/sys/Kconfig
```kconfig
menuconfig INTERFACE_SYS
    depends on SUPPORT_SYS
    depends on SUPPORT_SYS
    bool "sys"
    default y
    help
        whether to compile or not

if INTERFACE_SYS
config MI_SYS_KAPI
    bool "KAPI"
    default n
    help
        whether to compile or not

config mi_sys_kapi
    string
    default yes if MI_SYS_KAPI
    default no if !MI_SYS_KAPI

config MI_SYS_DMABUF
    bool "dmabuf"
    default n
    help
        whether to compile or not

config mi_sys_dmabuf
    string
    default enable if MI_SYS_DMABUF
    default disable if !MI_SYS_DMABUF

config MI_SYS_META_POOL
    bool "meta_pool"
    default y
    help
        whether to compile or not

config mi_sys_meta_pool
    string
    default enable if MI_SYS_META_POOL
    default disable if !MI_SYS_META_POOL

config MI_SYS_SHRINKABLE_POOL
    bool "shrinkable_pool"
    default n
    help
        whether to compile or not

config mi_sys_shrinkable_pool
    string
    default enable if MI_SYS_SHRINKABLE_POOL
    default disable if !MI_SYS_SHRINKABLE_POOL

config MI_SYS_RINGHEAP_POOL
    bool "ringheap_pool"
    default y
    help
        whether to compile or not

config mi_sys_ringheap_pool
    string
    default enable if MI_SYS_RINGHEAP_POOL
    default disable if !MI_SYS_RINGHEAP_POOL
endif

config interface_sys
    string
    default enable if INTERFACE_SYS
    default disable if !INTERFACE_SYS
```

## project/configs/Kconfigs/sdk/interface/vdec/Kconfig
```kconfig
menuconfig INTERFACE_VDEC
    depends on SUPPORT_VDEC
    bool "vdec"
    default y
    select INTERFACE_VCODEC
    help
        whether to compile or not

config interface_vdec
    string
    default enable if INTERFACE_VDEC
    default disable if !INTERFACE_VDEC
```

## project/configs/Kconfigs/sdk/interface/vdf/Kconfig
```kconfig
menuconfig INTERFACE_VDF
    depends on SUPPORT_VDF
    bool "vdf"
    default y
    help
        whether to compile or not

config interface_vdf
    string
    default enable if INTERFACE_VDF
    default disable if !INTERFACE_VDF
```

## project/configs/Kconfigs/sdk/interface/vdisp/Kconfig
```kconfig
menuconfig INTERFACE_VDISP
    depends on SUPPORT_VDISP
    bool "vdisp"
    default y
    help
        whether to compile or not

config interface_vdisp
    string
    default enable if INTERFACE_VDISP
    default disable if !INTERFACE_VDISP
```
