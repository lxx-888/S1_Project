## project/configs/Kconfigs/sdk/osdk/Kconfig
```kconfig
menu "Osdk Compile Config"
comment "Osdk Compile Config"

menuconfig OSDK_DRM
    bool "drm"
    default n
    select MHAL_DISP
    select MHAL_RGN
    help
        whether to compile drm driver or not

if OSDK_DRM

config MHAL_DISP
    bool "mhal_disp"
    default y
    help
        whether to compile or not

config mhal_disp
    string
    default enable if MHAL_DISP
    default disable if !MHAL_DISP

config MHAL_RGN
    bool "mhal_rgn"
    default y
    help
        whether to compile or not

config mhal_rgn
    string
    default enable if MHAL_RGN
    default disable if !MHAL_RGN

config MHAL_HDMITX
    bool "mhal_hdmitx"
    default n
    help
        whether to compile or not

config mhal_hdmitx
    string
    default enable if MHAL_HDMITX
    default disable if !MHAL_HDMITX

endif

config osdk_drm
    string
    default enable if OSDK_DRM
    default disable if !OSDK_DRM

config GLES_LDC_ENABLE
    bool "gles_ldc"
    default n
    help
        whether use gles_ldc

endmenu
```

## project/configs/Kconfigs/sdk/verify/CardvUI/Kconfig
```kconfig
config VERIFY_CARDV_UI
    bool "cardv_ui"
    default n
    help
        whether to compile or not

config verify_cardv_ui
    string
    default enable if VERIFY_CARDV_UI
    default disable if !VERIFY_CARDV_UI
```

## project/configs/Kconfigs/sdk/verify/Cardvimpl/Kconfig
```kconfig
config VERIFY_CARDV_IMPL
    bool "cardv_impl"
    default n
    help
        whether to compile or not

config verify_cardv_impl
    string
    default enable if VERIFY_CARDV_IMPL
    default disable if !VERIFY_CARDV_IMPL
```

## project/configs/Kconfigs/sdk/verify/Kconfig
```kconfig
menu "Verify Compile Config"
source configs/Kconfigs/sdk/verify/mi_demo/Kconfig
source configs/Kconfigs/sdk/verify/sample_code/Kconfig
source configs/Kconfigs/sdk/verify/bsp_demo/Kconfig
source configs/Kconfigs/sdk/verify/sstar_ota/Kconfig
source configs/Kconfigs/sdk/verify/system_app/Kconfig
source configs/Kconfigs/sdk/verify/Cardvimpl/Kconfig
source configs/Kconfigs/sdk/verify/CardvUI/Kconfig

endmenu
```

## project/configs/Kconfigs/sdk/verify/bsp_demo/Kconfig
```kconfig
config VERIFY_BSP_DEMO
    bool "bsp_demo"
    default n
    help
        whether to compile or not

config verify_bsp_demo
    string
    default enable if VERIFY_BSP_DEMO
    default disable if !VERIFY_BSP_DEMO
```

## project/configs/Kconfigs/sdk/verify/sample_code/Kconfig
```kconfig
config VERIFY_SAMPLE_CODE
    bool "sample_code"
    default y
    help
        whether to compile or not

config verify_sample_code
    string
    default enable if VERIFY_SAMPLE_CODE
    default disable if !VERIFY_SAMPLE_CODE

config verify_release_sample_ptree
    string
    default enable if VERIFY_RELEASE_SAMPLE_PTREE
    default disable if !VERIFY_RELEASE_SAMPLE_PTREE

config verify_release_sample_amigos
    string
    default enable if VERIFY_RELEASE_SAMPLE_AMIGOS
    default disable if !VERIFY_RELEASE_SAMPLE_AMIGOS

menu "samples binary release"
    depends on VERIFY_SAMPLE_CODE

    config VERIFY_RELEASE_SAMPLE_PTREE
        bool "release ptree"
        default n
        help
            whether to release ptree's preload bin and json files or not

    config VERIFY_RELEASE_SAMPLE_AMIGOS
        bool "release amigos"
        default n
        help
            whether to release amigos's preview bin and json files or not
endmenu
```

## project/configs/Kconfigs/sdk/verify/sstar_ota/Kconfig
```kconfig
config VERIFY_SSTAR_OTA
    bool "sstar_ota"
    default y
    help
        whether to compile or not

config verify_sstar_ota
    string
    default enable if VERIFY_SSTAR_OTA
    default disable if !VERIFY_SSTAR_OTA
```

## project/configs/Kconfigs/sdk/verify/system_app/Kconfig
```kconfig
config VERIFY_SYSTEM_APP
    bool "system_app"
    default y
    help
        whether to compile or not

config verify_system_app
    string
    default enable if VERIFY_SYSTEM_APP
    default disable if !VERIFY_SYSTEM_APP
```

## project/configs/Kconfigs/secure_boot/Kconfig
```kconfig
menu "SECURE_BOOT"

choice
    prompt "SECURE_BOOT"
        default normal_boot

    config NORMAL_BOOT
        bool "normal_boot"

    config SIG
        bool "sig"

    config SIG_AES
        bool "sig_aes"

    config SIG4096
        bool "sig4096"

    config SIG4096_AES
        bool "sig4096_aes"
endchoice

config SECURE_BOOT
    string
    default normal_boot if NORMAL_BOOT
    default sig if SIG
    default sig4096 if SIG4096
    default sig_aes if SIG_AES
    default sig4096_aes if SIG4096_AES

choice
    depends on (SECURE_BOOT = sig_aes || SECURE_BOOT = sig4096_aes)
    prompt "IMAGE_AES_DETAILS"
        default IMAGE_AESKEY128_1

    config IMAGE_AESKEY128_1
        bool "aeskey128_1"

    config IMAGE_AESKEY128_2
        bool "aeskey128_2"

    config IMAGE_AESKEY128_3
        bool "aeskey128_3"

    config IMAGE_AESKEY128_4
        bool "aeskey128_4"

    config IMAGE_AESKEY128_5
        bool "aeskey128_5"

    config IMAGE_AESKEY128_6
        bool "aeskey128_6"

    config IMAGE_AESKEY128_7
        bool "aeskey128_7"

    config IMAGE_AESKEY128_8
        bool "aeskey128_8"

    config IMAGE_AESKEY256_1
        bool "aeskey256_1"

    config IMAGE_AESKEY256_2
        bool "aeskey256_2"

    config IMAGE_AESKEY256_3
        bool "aeskey256_3"

    config IMAGE_AESKEY256_4
        bool "aeskey256_4"
endchoice

config IMAGE_AES_DETAILS
    string
    default 128_1 if IMAGE_AESKEY128_1
    default 128_2 if IMAGE_AESKEY128_2
    default 128_3 if IMAGE_AESKEY128_3
    default 128_4 if IMAGE_AESKEY128_4
    default 128_5 if IMAGE_AESKEY128_5
    default 128_6 if IMAGE_AESKEY128_6
    default 128_7 if IMAGE_AESKEY128_7
    default 128_8 if IMAGE_AESKEY128_8
    default 256_1 if IMAGE_AESKEY256_1
    default 256_2 if IMAGE_AESKEY256_2
    default 256_3 if IMAGE_AESKEY256_3
    default 256_4 if IMAGE_AESKEY256_4


choice
    depends on (SECURE_BOOT != normal_boot)
    prompt "Secureboot_debugmode"
        default Debug_mode_disable

    config Debug_mode_disable
        bool "NO"
    config Debug_mode_enable
        bool "YES"

endchoice

config Secureboot_debugmode
    string
    default ENABLE if Debug_mode_enable
    default DISABLE if Debug_mode_disable

menu "IPL_With_AES"
choice
    depends on (SECURE_BOOT != normal_boot)
    prompt "IPL_ENCRYPT"
        default IPL_NO_ENCRYPT

    config IPL_NO_ENCRYPT
        bool "NO"

    config IPL_ENCRYPT_ENABLE
        bool "YES"
endchoice

config IPL_ENCRYPT
    string
    default NO if IPL_NO_ENCRYPT
    default YES if IPL_ENCRYPT_ENABLE


choice
    depends on (IPL_ENCRYPT = YES)
    prompt "IPL_AES_DETAILS"
        default IPL_AESKEY128_1

    config IPL_AESKEY128_1
        bool "aeskey128_1"

    config IPL_AESKEY128_2
        bool "aeskey128_2"

    config IPL_AESKEY128_3
        bool "aeskey128_3"

    config IPL_AESKEY128_4
        bool "aeskey128_4"

    config IPL_AESKEY128_5
        bool "aeskey128_5"

    config IPL_AESKEY128_6
        bool "aeskey128_6"

    config IPL_AESKEY128_7
        bool "aeskey128_7"

    config IPL_AESKEY128_8
        bool "aeskey128_8"

    config IPL_AESKEY256_1
        bool "aeskey256_1"

    config IPL_AESKEY256_2
        bool "aeskey256_2"

    config IPL_AESKEY256_3
        bool "aeskey256_3"

    config IPL_AESKEY256_4
        bool "aeskey256_4"
endchoice

config IPL_AES_DETAILS
    string
    default 128_1 if IPL_AESKEY128_1
    default 128_2 if IPL_AESKEY128_2
    default 128_3 if IPL_AESKEY128_3
    default 128_4 if IPL_AESKEY128_4
    default 128_5 if IPL_AESKEY128_5
    default 128_6 if IPL_AESKEY128_6
    default 128_7 if IPL_AESKEY128_7
    default 128_8 if IPL_AESKEY128_8
    default 256_1 if IPL_AESKEY256_1
    default 256_2 if IPL_AESKEY256_2
    default 256_3 if IPL_AESKEY256_3
    default 256_4 if IPL_AESKEY256_4

endmenu
endmenu
```

## project/configs/Kconfigs/uboot/Kconfig
```kconfig
menu "Uboot"

config UBOOT_CONFIG
    string "Uboot build config"
    default ""

config UBOOT_BIN
    string "uboot Bin"
    default "u-boot.sz.img.bin"

choice
    prompt "Uboot Version"
    default UBOOT_VERSION_2021

    config UBOOT_VERSION_201501
        bool "201501"

    config UBOOT_VERSION_2021
        bool "2021"
endchoice

config UBOOT_VERSION
    string
    default 2021 if UBOOT_VERSION_2021
    default 201501 if UBOOT_VERSION_201501

config UBOOT_DTBO_LIST
    depends on (PRODUCT = android)
    string "Uboot DTBO LIST"
    default ""

endmenu
```

## project/configs/Kconfigs/vmm/Kconfig
```kconfig
menu "Vmm"
    depends on (DUAL_OS_TYPE = HYP)

config VMM_LOAD_ADDR
    string "Vmm Load Addr"
    default ""

config VMM_MEM_SIZE
    string "Vmm Memory Size"
    default ""

config VMM_LIMIT_MEM_SIZE
    string "Vmm Limit Memory Size"
    default ""

endmenu
```

## project/configs/demo/defconfigs/cardv_iford.nor.uclibc-9.1.0-squashfs.ssc029c.128_defconfig.qfn128_ddr3_defconfig
```kconfig
CONFIG_iford=y
CONFIG_CARDV=y
CONFIG_BOARD="029C"
CONFIG_BOARD_NAME="CARDV-BOARD"
CONFIG_TOOLCHAIN_UCLIBC=y
CONFIG_TOOLCHAIN_REL_ARM-SIGMASTAR-LINUX-UCLIBCGNUEABIHF-9.1.0=y
CONFIG_BUSYBOX="busybox-1.20.2-arm-buildroot-linux-uclibcgnueabihf-uclibc-9.1.0-static"
CONFIG_UBOOT_CONFIG="iford_cardv_defconfig"
CONFIG_UBOOT_BIN="u-boot.xz.img.bin"
CONFIG_OPTEE_OS_MAKE_OPTION="PLATFORM=iford"
CONFIG_DRAM_SIZE="0x8000000"
CONFIG_LX_MEM_SIZE="0x8000000"
CONFIG_MMA_MEM_SIZE="0x4000000"
CONFIG_CMA_MEM_SIZE="0x200000"
CONFIG_LOGO_MEM_SIZE="0x800000"
CONFIG_FB_MEM_SIZE="0x4b0000"
CONFIG_KERNEL_VERSION_5.10=y
CONFIG_KERNEL_CONFIG="iford_cardv_ssc029c_s01a_defconfig"
CONFIG_KERNEL_BIN="uImage.xz"
CONFIG_IMAGE_CONFIG="nor-cardv.squashfs.partition.config"
CONFIG_IPL_CONFIG="IPL.iford_nor.QFN128=y.SIMPLE_AUTOK=y.bin"
CONFIG_IPL_CUST_CONFIG="IPL_CUST.iford_nor.QFN128=y.SIMPLE_AUTOK=y.bin"
CONFIG_USB_UPGRADE_IPL_CONFIG="IPL.iford_usb.QFN128=y.SIMPLE_AUTOK=y.bin"
CONFIG_USB_UPGRADE_UBOOT_CONFIG="u-boot.xz.img.bin"
CONFIG_SD_UPGRADE_IPL_CONFIG="IPL.iford_sdmmc.QFN128=y.SIMPLE_AUTOK=y.bin"
CONFIG_SD_UPGRADE_IPL_CUST_CONFIG="IPL_CUST.iford_sdmmc.QFN128=y.SIMPLE_AUTOK=y.bin"
CONFIG_FLASH_SIZE_16M=y
CONFIG_REMOVE_LIBS_LIST="libBF_2MIC_LINUX.so libBF_4MIC_LINUX.so libBF100_LINUX.so libAEC_LINUX.so libAED_LINUX.so libAGC_LINUX.so libANR_LINUX.so libAPC_LINUX.so libMD_LINUX.so libOD_LINUX.so libMIX_LINUX.so libSED_LINUX.so libSRC_LINUX.so libSSL_2MIC_LINUX.so libSSL_4MIC_LINUX.so libSSL100_LINUX.so libVAD_LINUX.so libsstaralgo_det.so libsstaralgo_fr.so libsstaralgo_hseg.so libsstaralgo_ovcls.so libVC_LINUX.so libVG_LINUX.so"
CONFIG_STRIP_OPTION="--strip-unneeded"
CONFIG_IQ0="imx307/imx307_iqfile.bin"
CONFIG_IQ1="imx307/imx307_iqfile.bin"
CONFIG_IQ2="imx307/imx307_iqfile.bin"
CONFIG_IQ3="imx307/imx307_iqfile.bin"
CONFIG_IQ_API_LIST="imx415/imx415_api.bin"
CONFIG_SENSOR_LIST="imx415_mipi.ko"
CONFIG_SENSOR0="imx415_mipi.ko"
CONFIG_SENSOR0_OPT="chmap=1"
CONFIG_CONFIG_ENABLE_MI_NORMAL_STR=y
CONFIG_DEBUG_SUPPORT=y
CONFIG_SD_UPGRADE_DEV=1
CONFIG_SSW101B_WIFI_USB=y
CONFIG_BOOTLOGO=y
# CONFIG_VERIFY_SAMPLE_CODE is not set
# CONFIG_VERIFY_SYSTEM_APP is not set
CONFIG_VERIFY_CARDV_IMPL=y
CONFIG_VERIFY_CARDV_UI=y
CONFIG_MI_DBG_MINIMAL=y
# CONFIG_MI_RGN_SUPPORT_MOSAIC is not set
# CONFIG_MI_RGN_SUPPORT_COVER_MAP is not set
# CONFIG_MI_RGN_SUPPORT_COLOR_INVERT is not set
# CONFIG_INTERFACE_SHADOW is not set
# CONFIG_INTERFACE_VDF is not set
# CONFIG_INTERFACE_WLAN is not set
# CONFIG_MI_FB_VIDEO is not set
```

## project/configs/demo/defconfigs/cardv_iford.spinand.glibc-11.1.0-squashfs.ssc029c.128.qfn128_ddr3_dualsnr_defconfig
```kconfig
CONFIG_iford=y
CONFIG_CARDV=y
CONFIG_BOARD="029C"
CONFIG_BOARD_NAME="CARDV-BOARD"
CONFIG_TOOLCHAIN_VERSION_11.1.0=y
CONFIG_TOOLCHAIN_REL_ARM-LINUX-GNUEABIHF-SIGMASTAR-11.1.0=y
CONFIG_BUSYBOX="busybox-1.20.2-arm-linux-gnueabihf-glibc-sigmastar-11.1.0-dynamic"
CONFIG_UBOOT_CONFIG="iford_spinand_dualenv_cardv_defconfig"
CONFIG_OPTEE_OS_MAKE_OPTION="PLATFORM=iford"
CONFIG_DRAM_SIZE="0x8000000"
CONFIG_LX_MEM_SIZE="0x8000000"
CONFIG_MMA_MEM_SIZE="0x4200000"
CONFIG_CMA_MEM_SIZE="0x200000"
CONFIG_LOGO_MEM_SIZE="0x800000"
CONFIG_FB_MEM_SIZE="0x4b0000"
CONFIG_KERNEL_VERSION_5.10=y
CONFIG_KERNEL_CONFIG="iford_cardv_ssc029c_s01a_spinand_dualsnr_defconfig"
CONFIG_KERNEL_BIN="uImage.xz"
CONFIG_IMAGE_CONFIG="spinand.squashfs.ab.partition.config"
CONFIG_IPL_CONFIG="IPL.iford_nand.QFN128=y.IMAGE_LOAD_SUPPORT=n.USE_IMAGE_LOAD_AB=y.SIMPLE_AUTOK=y.bin"
CONFIG_IPL_CUST_CONFIG="IPL_CUST.iford_nand.QFN128=y.IMAGE_LOAD_SUPPORT=n.USE_IMAGE_LOAD_AB=y.SIMPLE_AUTOK=y.bin"
CONFIG_USB_UPGRADE_IPL_CONFIG="IPL.iford_usb.QFN128=y.SIMPLE_AUTOK=y.bin"
CONFIG_USB_UPGRADE_UBOOT_CONFIG="u-boot_spinand.xz.img.bin"
CONFIG_SD_UPGRADE_IPL_CONFIG="IPL.iford_sdmmc.QFN128=y.SIMPLE_AUTOK=y.bin"
CONFIG_SD_UPGRADE_IPL_CUST_CONFIG="IPL_CUST.iford_sdmmc.QFN128=y.SIMPLE_AUTOK=y.bin"
CONFIG_FLASH_SIZE_16M=y
CONFIG_IQ0="imx307/imx307_iqfile.bin"
CONFIG_IQ1="imx307/imx307_iqfile.bin"
CONFIG_IQ2="imx307/imx307_iqfile.bin"
CONFIG_IQ3="imx307/imx307_iqfile.bin"
CONFIG_IQ_API_LIST="os04d10/os04d10_api.bin"
CONFIG_SENSOR_LIST="os04d10_mipi.ko tp2855_mipi.ko"
CONFIG_SENSOR0="os04d10_mipi.ko"
CONFIG_SENSOR0_OPT="chmap=5 mclk=27M"
CONFIG_CONFIG_ENABLE_MI_NORMAL_STR=y
CONFIG_DEBUG_SUPPORT=y
CONFIG_SD_UPGRADE_DEV=1
CONFIG_USE_AB_SYSTEM_BOOT=y
CONFIG_SSW101B_WIFI_USB=y
CONFIG_BOOTLOGO=y
CONFIG_VERIFY_MI_DEMO=y
CONFIG_VERIFY_RELEASE_SAMPLE_AMIGOS=y
CONFIG_VERIFY_BSP_DEMO=y
CONFIG_VERIFY_CARDV_IMPL=y
CONFIG_VERIFY_CARDV_UI=y
CONFIG_INTERFACE_IVE=y
# CONFIG_MI_RGN_SUPPORT_MOSAIC is not set
# CONFIG_MI_RGN_SUPPORT_COVER_MAP is not set
# CONFIG_MI_RGN_SUPPORT_COLOR_INVERT is not set
# CONFIG_INTERFACE_WLAN is not set
CONFIG_INTERFACE_DUMMY=y
# CONFIG_MI_FB_VIDEO is not set
```

## sdk/driver/SensorDriver/drv/Kconfig
```kconfig
config MS_SENSORDRIVER
    tristate "Sensor driver"
    default n
    help
    Enable support for sensor driver
```
