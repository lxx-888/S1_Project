## project/configs/Kconfigs/pm_rtos/Kconfig
```kconfig
menu "pm_rtos"

config BOOL_PM_RTOS_ENABLE
    bool "pm_rtos enable"
    default n
    help
        whether to compile or not

config PM_RTOS_ENABLE
    string
    default "on" if BOOL_PM_RTOS_ENABLE
    default "off" if !BOOL_PM_RTOS_ENABLE

if BOOL_PM_RTOS_ENABLE
config PM_RTOS_BIN
    string "pm_rtos Bin"
    default ""

if PM_RTOS_BIN != ""
config CM4_DEMO
    bool "run cm4 demo at startup"
    default n
endif

config PM_RTOS_TOOLCHAIN
    string "pm_rtos build toolchain"
    default "arm-none-eabi"

config PM_RTOS_CONFIG
    string "pm_rtos build config"
    default ""
endif

endmenu
```

## project/configs/Kconfigs/product/Kconfig
```kconfig
choice
    prompt "Product"
    default IPC

    config IPC
        bool "ipc"

    config NVR
        bool "nvr"

    config XVR
        bool "xvr"

    config CARDV
        bool "cardv"

    config USBCAM
        bool "usbcam"

    config DISPCAM
        bool "dispcam"

    config IPC-RTOS
        bool "ipc-rtos"

    config IPC-RTOS-SMPLH
        bool "ipc-rtos-smplh"

    config USBCAM-PURERTOS
        bool "usbcam-purertos"

    config USBCAM-RTOS
        bool "usbcam-rtos"

    config IPC-FASTBOOT
        bool "ipc-fastboot"

    config NVR-FASTBOOT
        bool "nvr-fastboot"

    config USBCAM-FASTBOOT
        bool "usbcam-fastboot"

    config ANDROID
        bool "android"

endchoice

config PRODUCT
    string
    default ipc if IPC
    default nvr if NVR
    default xvr if XVR
    default cardv if CARDV
    default usbcam if USBCAM
    default dispcam if DISPCAM
    default ipc-rtos if IPC-RTOS
    default ipc-rtos-smplh if IPC-RTOS-SMPLH
    default usbcam-rtos if USBCAM-RTOS
    default usbcam-purertos if USBCAM-PURERTOS
    default ipc-fastboot if IPC-FASTBOOT
    default nvr-fastboot if NVR-FASTBOOT
    default usbcam-fastboot if USBCAM-FASTBOOT
    default android if ANDROID
    default ipc
```

## project/configs/Kconfigs/rtos/Kconfig
```kconfig
menu "Rtos"

config BOOL_RTOS_ENABLE
    bool "Rtos enable"
    default n
    help
        whether to compile or not

config RTOS_ENABLE
    string
    default "on" if BOOL_RTOS_ENABLE
    default "off" if !BOOL_RTOS_ENABLE

if BOOL_RTOS_ENABLE
config RTOS_BIN
    string "rtos Bin"
    default "rtos.sz"

choice
    prompt "RtosType"
    default BOOL_DUAL_OS

    config BOOL_DUAL_OS
        bool "dualos"

    config BOOL_PURE_RTOS
        bool "pure rtos"
endchoice

config DUAL_OS
    string
    default "on" if BOOL_DUAL_OS
    default "off" if !BOOL_DUAL_OS

config DUAL_OS_TYPE
    depends on BOOL_DUAL_OS
    string "LH or HYP of Dualos Type"
    default "LH" if BOOL_DUAL_OS
    default "off" if !BOOL_DUAL_OS

config PURE_RTOS
    string
    default "on" if BOOL_PURE_RTOS
    default "off" if !BOOL_PURE_RTOS

config RTOS_TOOLCHAIN
    string "Rtos build toolchain"
    default "arm-eabi"

config RTOS_CONFIG
    string "Rtos build config"
    default ""

config CONFIG_MI_SDK_SUPPORT
    bool "Support MI SDK in RTOS"
    default y

config CONFIG_SENSOR_DRIVER_SUPPORT
    bool "Support Sensor driver in RTOS"
    default y

config CONFIG_MI_SYSCALL_L2R_DESTROY_SUPPORT
    bool "Support Linux destroy rtos mi resource by MI_SYCALL"
    depends on BOOL_DUAL_OS
    default n

source configs/Kconfigs/rtos/earlyinit/Kconfig

source configs/Kconfigs/rtos/application/Kconfig

config RTOS_MASTER_HW_CORE
    string "RTOS Master HW core ID"
    default "1"

config BOOL_FAST_DEMO
    bool "Fast Demo"
    default n

config FAST_DEMO
    string
    default "on" if BOOL_FAST_DEMO
    default "off"

config SENSOR_TYPE
    string "Sensor Type"
    default ""

config SENSOR_TYPE1
    string "Sensor1 Type"
    default ""

config SENSOR_TYPE2
    string "Sensor2 Type"
    default ""

config PRELOAD_FILE
    string "Preload Setting file"
    default "PreloadSetting.txt"

config DLA_FIRMWARE_LIST
    string "dla firmware"
    default ""

endif

endmenu
```

## project/configs/Kconfigs/rtos/application/Kconfig
```kconfig
menu "Rtos Application Options"

config CONFIG_APPLICATION_AUDIO
    bool "Support audio application"
    default n

config CONFIG_APPLICATION_BENCH
    bool "Support bench application"
    default n

config CONFIG_APPLICATION_BOOTLOADER
    bool "Support bootloader application"
    default n

config CONFIG_COREMARK_SUPPORT
    bool "Support coremark application"
    default n

menu "Support pipeline demo applications"

config CONFIG_APPLICATION_SELECTOR
    bool "Support application selector"

config CONFIG_APPLICATION_CARDV
    bool "Support CarCam application"
    depends on CONFIG_MI_SDK_SUPPORT

config CONFIG_APPLICATION_USB_GADGET
    bool "Support USB gadget application"
    select CONFIG_USB_GADGET_SUPPORT
    default n
    menu "USB_GADGET applicattion config"
        depends on CONFIG_MI_SDK_SUPPORT && CONFIG_USB_GADGET_SUPPORT
        config CONFIG_IPU_IN_RTOS_ENABLE
            bool "Support IPU in USB gadget application"
            default n
            depends on CONFIG_USB_GADGET_SUPPORT
        config CONFIG_IPU_DETECT_STREAM
            int "Support IPU Detect Stream Number"
            depends on CONFIG_IPU_IN_RTOS_ENABLE
            default 0
        config CONFIG_FD3A_IN_RTOS_ENABLE
            bool "Support FD3A by IPU"
            depends on CONFIG_IPU_IN_RTOS_ENABLE
            default n
        config CONFIG_MISC_AUTHENTICATE
            bool "Support MISC partition signature verification"
            default n
    endmenu

config CONFIG_USB_GADGET_SUPPORT
    bool "Support Cust USB gadget"
    default n if !CONFIG_APPLICATION_USB_GADGET
    default y if CONFIG_APPLICATION_USB_GADGET

config CONFIG_APPLICATION_IPC
    bool "Support IPC application"
    default n if !CONFIG_MI_SDK_SUPPORT
    default y if CONFIG_MI_SDK_SUPPORT
    select CONFIG_APPLICATION_SELECTOR
    menu "IPC application config"
        depends on CONFIG_MI_SDK_SUPPORT && CONFIG_APPLICATION_IPC
        config CONFIG_ENABLE_MI_SDK_PIPELINE_FLOW
            bool "enable MI_SDK_PIPELINE"
            depends on CONFIG_APPLICATION_IPC
            default n
        config CONFIG_AI_APC_ENABLE
            bool "Support AI APC in IPC application"
            depends on CONFIG_APPLICATION_IPC
            default n
        config CONFIG_SED_ENABLE
            bool "Support SED in IPC application"
            depends on CONFIG_APPLICATION_IPC
            default n
        config CONFIG_IPU_IN_RTOS_ENABLE
            bool "Support IPU in IPC application"
            depends on CONFIG_APPLICATION_IPC || CONFIG_APPLICATION_USB_GADGET
            default n
        config CONFIG_OSD_USE_ARGB1555
            bool "Support OSD ARGB1555 in IPC application"
            depends on CONFIG_APPLICATION_IPC
            default n
        config CONFIG_OSD_USE_BMP
            bool "Support OSD BMP in IPC application"
            depends on CONFIG_APPLICATION_IPC
            default n
        config CONFIG_LDC_IN_RTOS_ENABLE
            bool "Support LDC in IPC application"
            depends on CONFIG_APPLICATION_IPC
            default n
        config CONFIG_VDF_IN_RTOS_ENABLE
            bool "Support VDF in IPC application"
            depends on CONFIG_APPLICATION_IPC
            default n
        config CONFIG_PANEL_IN_RTOS_ENABLE
        bool "Support PANEL in IPC application"
        depends on CONFIG_APPLICATION_IPC
        default n
        choice
            prompt "LDC calibration file format"
            default CONFIG_LDC_USE_BIN
            depends on CONFIG_APPLICATION_IPC && LDC_IN_RTOS_ENABLE
            config CONFIG_LDC_USE_CFG
                bool "Use config"
            config CONFIG_LDC_USE_BIN
                bool "Use bin"
        endchoice
    endmenu

config CONFIG_BSP_MENU
    bool "Support Auto Bsp Test"

config CONFIG_PIPELINE_TREE
    bool "Support pipeline tree(PTREE)"

config CONFIG_APPLICATION_SAMPLE
    bool "Applications supported in sdk/verify/sample_code"
    depends on CONFIG_MI_SDK_SUPPORT
    select CONFIG_APPLICATION_SELECTOR
    menu "Applications configuration"
        depends on CONFIG_APPLICATION_SAMPLE
        config CONFIG_APPLICATION_CM4
            bool "Support CM4 application"
        config CONFIG_APPLICATION_PRELOAD_SAMPLE
            bool "Support PRELOAD SAMPLE application"
        config CONFIG_APPLICATION_DUALOS_SAMPLE
            bool "Support DUALOS SAMPLE application"
        config CONFIG_APPLICATION_PTREE
            bool "Support PTREE application"
            select CONFIG_PIPELINE_TREE
        choice
            prompt "Pipeline tree configuration source"
            default CONFIG_PIPELINE_TREE_USING_JSON
            depends on CONFIG_APPLICATION_PTREE
            config CONFIG_PIPELINE_TREE_USING_BINARY
                bool "Support BINARY in pipeline tree"
            config CONFIG_PIPELINE_TREE_USING_JSON
                bool "Support JSON in pipeline tree"
            config CONFIG_PIPELINE_TREE_USING_INI
                bool "Support INI in pipeline tree"
        endchoice
        config CONFIG_PIPELINE_TREE_FILE
            string "Pipeline tree file"
            depends on CONFIG_PIPELINE_TREE_USING_JSON || CONFIG_PIPELINE_TREE_USING_INI
            default "1snr_isp_scl_venc_ptree.json"
    endmenu

config CONFIG_RTOS_APPLICATION
    string
    default "app_selector" if CONFIG_APPLICATION_SELECTOR
    default "dualos_camera" if CONFIG_APPLICATION_IPC
    default "sample_code" if CONFIG_APPLICATION_SAMPLE
    default "usb_gadget_app" if CONFIG_APPLICATION_USB_GADGET
    default "rtos_bsp_demo" if CONFIG_BSP_MENU
    default "coremark" if CONFIG_COREMARK_SUPPORT

endmenu

choice
    prompt "Camera setting storage"
    default CONFIG_LOAD_CAMERA_SETTING_FROM_MISC

    config CONFIG_LOAD_CAMERA_SETTING_FROM_MISC
        bool "misc"

    config CONFIG_LOAD_CAMERA_SETTING_FROM_BOOTENV
        bool "bootenv"

endchoice

config CONFIG_CUS3A_SUPPORT
    bool "Support CUS3A"
    depends on CONFIG_MI_SDK_SUPPORT
    default n

config CONFIG_CUS3A_AF_ENABLE
    hex "CUS3A AF enable map"
    depends on CONFIG_MI_SDK_SUPPORT
    default 0

config CONFIG_CUST_ISP_SUPPORT
    bool "Support Cust ISP"
    depends on CONFIG_MI_SDK_SUPPORT
    default n

config CONFIG_LPC_SUPPORT
    bool "Support LPC driver"
    default n

if CONFIG_USB_GADGET_SUPPORT
    source configs/Kconfigs/rtos/application/usb_gadget_app/Kconfig
endif

config CONFIG_APPLICATION_MBX_TEST
    bool "Support mbx test application"
    default n

endmenu
```

## project/configs/Kconfigs/rtos/application/usb_gadget_app/Kconfig
```kconfig
menu "USB gadget options"
config CONFIG_USB_COMPOSITE_DEV_HAS_UVC_FUNC
    bool "Composite device supports UVC function"
    default y
    select USB_GADGET_UVC_SUPPORT
    help
      USB composite device supports UVC functions

config CONFIG_USB_COMPOSITE_DEV_HAS_UAC_FUNC
    bool "Composite device supports UAC function"
    default n
    select USB_GADGET_UAC_SUPPORT
    help
      USB composite device supports UAC functions

config CONFIG_USB_COMPOSITE_DEV_HAS_HID_FUNC
    bool "Composite device supports HID function"
    default n
    select USB_GADGET_HID_SUPPORT
    help
      USB composite device supports HID functions

config CONFIG_USB_COMPOSITE_DEV_HAS_MSC_FUNC
    bool "Composite device supports Mass Storage function"
    default n
    select USB_GADGET_MSDC_SUPPORT
    help
      USB composite device supports Mass Storage functions

config CONFIG_USB_COMPOSITE_DEV_HAS_CDC_FUNC
    bool "Composite device supports Cummunication Device function"
    default n
    select USB_GADGET_CDC_SUPPORT
    help
      USB composite device supports Communication Device functions

config CONFIG_USB_GADGET_STR_SUPPORT
    bool "Support USB Suspend To RAM feature"
    default n

config CONFIG_USB_GADGET_VBUS_DETECT
    bool "Enable Vbus detection by GPIO"
    default n

menu "USB classes to support"

config CONFIG_USB_GADGET_CDC_SUPPORT
    bool "Support CDC class"
    default n

config CONFIG_USB_GADGET_HID_SUPPORT
    bool "Support HID class"
    default n

choice
    prompt "Select HID usage"
    default CONFIG_USB_GADGET_HID_KEYBOARD
    depends on USB_GADGET_HID_SUPPORT

    config CONFIG_USB_GADGET_HID_KEYBOARD
        bool "as a keyboard"

    config CONFIG_USB_GADGET_HID_MOUSE
        bool "as a mouse"

    config CONFIG_USB_GADGET_HID_MEDIA
        bool "as a media control"
endchoice

config CONFIG_USB_GADGET_MSDC_SUPPORT
    bool "Support MSC class"
    default n

config CONFIG_USB_GADGET_UAC_SUPPORT
    bool "Support UAC class"
    default n

if CONFIG_USB_GADGET_UAC_SUPPORT
menu "UAC gadget options"

config CONFIG_USB_GADGET_UAC_MIC_SUPPORT
    bool "Support UAC MIC"
    default n

config CONFIG_USB_GADGET_UAC_SPK_SUPPORT
    bool "Support UAC speaker"
    default n

config CONFIG_USB_GADGET_UAC_LATENCY_FINE_TUNE
    bool "Supports UAC latency fine tune (TEAMS.SPEC.105ms)"
    default n

config CONFIG_USB_GADGET_UAC_VERSION
    int "Supports UAC vesion"
    default 1

endmenu
endif

config CONFIG_USB_GADGET_UVC_SUPPORT
    bool "Support UVC class"
    default y

if CONFIG_USB_GADGET_UVC_SUPPORT
menu "UVC gadget options"
config CONFIG_USB_GADGET_UVC_STREAM_NUM
    int "Number of UVC video streams"
    depends on CONFIG_USB_GADGET_UVC_SUPPORT
    default 1

choice
    prompt "Multiple UVC video streams"
    default CONFIG_UVC_MULTI_STREAM_BY_MULTI_INTERFACE

    config CONFIG_UVC_MULTI_STREAM_BY_MULTI_FUNCTION
        bool "by multiple UVC function"

    config CONFIG_UVC_MULTI_STREAM_BY_MULTI_INTERFACE
        bool "by multiple Video Stream interfaces"
endchoice

config CONFIG_USB_GADGET_UVC_INTERRUPT_EP_SUPPORT
    bool "Support UVC status interrupt"
    default n

config CONFIG_UVC_HEADER_METADATA
    bool "Support window hello matadata header"
    default n

endmenu
endif
endmenu
endmenu
```
