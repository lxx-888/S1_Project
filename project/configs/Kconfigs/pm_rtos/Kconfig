## project/configs/Kconfigs/rtos/earlyinit/Kconfig
```kconfig
menu "Earlyinit Options"

choice
    prompt "Select Earlyinit Mode"
    default CONFIG_NO_EARLYINIT_SUPPORT

    config CONFIG_NO_EARLYINIT_SUPPORT
        bool "No earlyinit support"
    config CONFIG_SENSOR_EARLYINIT_SUPPORT
        bool "Init sensor from rtos boot"
    config CONFIG_SENSOR_IPL_EARLYINIT_SUPPORT
        bool "Init sensor and vif from IPL"
endchoice

config CONFIG_EARLYINIT_SETTING_JSON
    string "Set Earlyinit Setting Default Json Name"
    default "single_sensor_realtime.json"
    help
        set the json name that will be converted into header file,
        and it will be selected as default.

config CONFIG_EARLYINIT_SETTING_JSON_LIST
    string "Set Earlyinit Setting Built-in Json Name List"
    default ""
    help
        set the json name list that will be converted into header file.

config CONFIG_EARLYINIT_SETTING_FS
    bool "Support Dynamically Load Earlyinit Setting From File System"
    default n
    depends on CONFIG_SENSOR_EARLYINIT_SUPPORT
    help
        dynamically load earlyinit setting from file system if enable.

config CONFIG_SENSOR_EARLYINIT_ENABLE
    hex "Bitmap for early init enable"
    depends on CONFIG_SENSOR_EARLYINIT_SUPPORT||CONFIG_SENSOR_IPL_EARLYINIT_SUPPORT
    default 0x01

config CONFIG_IPL_SENSOR_EARLYINIT_PIPELINE_SUPPORT
    bool "Support Vif pipe line create"
    depends on CONFIG_SENSOR_IPL_EARLYINIT_SUPPORT
    default y

config CONFIG_SENSOR_EARLYINIT_LOG_LEVEL
    int "EarlyInit log level"
    depends on CONFIG_SENSOR_EARLYINIT_SUPPORT||CONFIG_SENSOR_IPL_EARLYINIT_SUPPORT
    help
        0:Disable all, 1:Error only, 2:Error and Info, 3:Enable all
    default 1

config CONFIG_EARLYINIT_SENSOR_CM4_SUPPORT
    bool "Support sensor CM4"
    depends on CONFIG_SENSOR_EARLYINIT_SUPPORT||CONFIG_SENSOR_IPL_EARLYINIT_SUPPORT
    default n

config CONFIG_EARLYINIT_SENSOR_MIPIRX_2LANE_SUPPORT
    bool "Support MIPI RX 2Lane mode"
    depends on CONFIG_SENSOR_EARLYINIT_SUPPORT||CONFIG_SENSOR_IPL_EARLYINIT_SUPPORT
    default n

config CONFIG_EARLYINIT_SENSOR_LIGHTSENSOR_SUPPORT
    bool "Support earlyinit light sensor enable"
    depends on CONFIG_SENSOR_EARLYINIT_SUPPORT||CONFIG_SENSOR_IPL_EARLYINIT_SUPPORT
    default n

config CONFIG_EARLYINIT_SENSOR_COLD_BOOT_SKIP
    bool "Support skip earlyinit in cold boot"
    default n

config CONFIG_EARLYINIT_SENSOR_2_2_LANE_SUPPORT
    bool "Support MIPI 2+2 lane mode"
    depends on CONFIG_SENSOR_EARLYINIT_SUPPORT||CONFIG_SENSOR_IPL_EARLYINIT_SUPPORT
    default n

endmenu
```

## project/configs/Kconfigs/sdk/Kconfig
```kconfig
menu "Sdk Config"
source configs/Kconfigs/sdk/verify/Kconfig

source configs/Kconfigs/sdk/interface/Kconfig

source configs/Kconfigs/sdk/osdk/Kconfig

# source configs/Kconfigs/sdk/mhal/Kconfig

endmenu
```

## project/configs/Kconfigs/sdk/interface/Kconfig
```kconfig
menu "Interface Compile Config"
comment "Interface Compile Config"

config ENABLE_UT_API
    bool "enable ut api"
    default n
    help
        whether to compile or not

config enable_ut_api
    string
    default enable if ENABLE_UT_API
    default disable if !ENABLE_UT_API

source "configs/Kconfigs/sdk/interface/ability/Kconfig"
source "configs/Kconfigs/sdk/interface/codesize/Kconfig"
source "configs/Kconfigs/sdk/interface/aio/Kconfig"
source "configs/Kconfigs/sdk/interface/ai/Kconfig"
source "configs/Kconfigs/sdk/interface/ao/Kconfig"
source "configs/Kconfigs/sdk/interface/aqserver/Kconfig"
source "configs/Kconfigs/sdk/interface/cipher/Kconfig"
source "configs/Kconfigs/sdk/interface/common/Kconfig"
source "configs/Kconfigs/sdk/interface/cus3a/Kconfig"
source "configs/Kconfigs/sdk/interface/debug/Kconfig"
source "configs/Kconfigs/sdk/interface/disp/Kconfig"
source "configs/Kconfigs/sdk/interface/gfx/Kconfig"
source "configs/Kconfigs/sdk/interface/hdmi/Kconfig"
source "configs/Kconfigs/sdk/interface/ipu/Kconfig"
source "configs/Kconfigs/sdk/interface/iqserver/Kconfig"
source "configs/Kconfigs/sdk/interface/isp/Kconfig"
source "configs/Kconfigs/sdk/interface/ispalgo/Kconfig"
source "configs/Kconfigs/sdk/interface/ive/Kconfig"
source "configs/Kconfigs/sdk/interface/jpd/Kconfig"
source "configs/Kconfigs/sdk/interface/ldc/Kconfig"
source "configs/Kconfigs/sdk/interface/mipitx/Kconfig"
source "configs/Kconfigs/sdk/interface/rgn/Kconfig"
source "configs/Kconfigs/sdk/interface/sed/Kconfig"
source "configs/Kconfigs/sdk/interface/sensor/Kconfig"
source "configs/Kconfigs/sdk/interface/shadow/Kconfig"
source "configs/Kconfigs/sdk/interface/sys/Kconfig"
source "configs/Kconfigs/sdk/interface/vdec/Kconfig"
source "configs/Kconfigs/sdk/interface/vdf/Kconfig"
source "configs/Kconfigs/sdk/interface/vdisp/Kconfig"
source "configs/Kconfigs/sdk/interface/venc/Kconfig"
source "configs/Kconfigs/sdk/interface/vif/Kconfig"
source "configs/Kconfigs/sdk/interface/scl/Kconfig"
source "configs/Kconfigs/sdk/interface/wlan/Kconfig"
source "configs/Kconfigs/sdk/interface/pcie/Kconfig"
source "configs/Kconfigs/sdk/interface/dsp/Kconfig"
source "configs/Kconfigs/sdk/interface/dpu/Kconfig"
source "configs/Kconfigs/sdk/interface/dummy/Kconfig"
source "configs/Kconfigs/sdk/interface/fb/Kconfig"
source "configs/Kconfigs/sdk/interface/nir/Kconfig"
source "configs/Kconfigs/sdk/interface/hvp/Kconfig"
source "configs/Kconfigs/sdk/interface/pspi/Kconfig"
source "configs/Kconfigs/sdk/interface/hdmirx/Kconfig"
endmenu
```

## project/configs/Kconfigs/sdk/interface/ability/Kconfig
```kconfig
config SUPPORT_AI
    bool
    default y
config SUPPORT_AIO
    bool
    default y
config SUPPORT_AO
    bool
    default y
config SUPPORT_CIPHER
    bool
    default n
config SUPPORT_COMMON
    bool
    default y
config SUPPORT_CUS3A
    bool
    default y
config SUPPORT_DEBUG
    bool
    default y
config SUPPORT_DISP
    bool
    default y
config SUPPORT_DPU
    bool
    default n
config SUPPORT_DSP
    bool
    default n
config SUPPORT_DUMMY
    bool
    default y
config SUPPORT_FB
    bool
    default y
config SUPPORT_GFX
    bool
    default n
config SUPPORT_HDMI
    bool
    default n
config SUPPORT_HDMIRX
    bool
    default n
config SUPPORT_HVP
    bool
    default n
config SUPPORT_IPU
    bool
    default y
config SUPPORT_IQSERVER
    bool
    default y
config SUPPORT_ISP
    bool
    default y
config SUPPORT_ISPALGO
    bool
    default y
config SUPPORT_IVE
    bool
    default y
config SUPPORT_JPD
    bool
    default n
config SUPPORT_LDC
    bool
    default y
config SUPPORT_MIPITX
    bool
    default n
config SUPPORT_NIR
    bool
    default n
config SUPPORT_PCIE
    bool
    default n
config SUPPORT_PSPI
    bool
    default n
config SUPPORT_RGN
    bool
    default y
config SUPPORT_SCL
    bool
    default y
config SUPPORT_SED
    bool
    default n
config SUPPORT_SENSOR
    bool
    default y
config SUPPORT_SHADOW
    bool
    default y
config SUPPORT_SYS
    bool
    default y
config SUPPORT_VDEC
    bool
    default n
config SUPPORT_VDF
    bool
    default y
config SUPPORT_VDISP
    bool
    default y
config SUPPORT_VENC
    bool
    default y
config SUPPORT_VIF
    bool
    default y
config SUPPORT_WLAN
    bool
    default y
```

## project/configs/Kconfigs/sdk/interface/ai/Kconfig
```kconfig
menuconfig INTERFACE_AI
    depends on SUPPORT_AI
    bool "ai"
    default y
    select INTERFACE_AIO
    help
        whether to compile or not

if INTERFACE_AI

config MI_AI_KAPI
    bool "KAPI"
    default n
    help
        whether to compile or not

config mi_ai_kapi
    string
    default yes if MI_AI_KAPI
    default no if !MI_AI_KAPI

config config_mi_ai
    bool "mi_ai"
    default y
    help
        whether to compile or not

endif

config interface_ai
    string
    default enable if INTERFACE_AI
    default disable if !INTERFACE_AI
```

## project/configs/Kconfigs/sdk/interface/aio/Kconfig
```kconfig
menuconfig INTERFACE_AIO
    depends on SUPPORT_AIO
    bool "aio"
    option modules
    default y
    help
        whether to compile or not


if INTERFACE_AIO

config config_mi_ai
    bool "mi_ai"
    default y

endif # aio

config interface_aio
    string
    default enable if INTERFACE_AIO
    default disable if !INTERFACE_AIO
```

## project/configs/Kconfigs/sdk/interface/ao/Kconfig
```kconfig
menuconfig INTERFACE_AO
    depends on SUPPORT_AO
    bool "ao"
    default y
    select INTERFACE_AOO
    help
        whether to compile or not

if INTERFACE_AO

config MI_AO_KAPI
    bool "KAPI"
    default n
    help
        whether to compile or not

config mi_ao_kapi
    string
    default yes if MI_AO_KAPI
    default no if !MI_AO_KAPI

config config_mi_ao
    bool "mi_ao"
    default y
    help
        whether to compile or not

endif

config interface_ao
    string
    default enable if INTERFACE_AO
    default disable if !INTERFACE_AO
```

## project/configs/Kconfigs/sdk/interface/aqserver/Kconfig
```kconfig
menuconfig INTERFACE_AQSERVER
    bool "aqserver"
    default n
    help
        whether to compile or not

if INTERFACE_AQSERVER
config config_alg_apc
    bool "alg_apc"
    default n
    help
        whether to compile or not

endif

config interface_aqserver
    string
    default enable if INTERFACE_AQSERVER
    default disable if !INTERFACE_AQSERVER
```

## project/configs/Kconfigs/sdk/interface/cipher/Kconfig
```kconfig
menuconfig INTERFACE_CIPHER
    depends on SUPPORT_CIPHER
    bool "cipher"
    default y
    help
        whether to compile or not

config interface_cipher
    string
    default enable if INTERFACE_CIPHER
    default disable if !INTERFACE_CIPHER
```

## project/configs/Kconfigs/sdk/interface/codesize/Kconfig
```kconfig
menu "MI debug level for code size verify config"
    choice
        prompt "Valid mi log level"
        default MI_DBG_ALL
        config MI_DBG_MINIMAL
            bool "Keep ERR&WRN(brief version)"
        config MI_DBG_NONE
            bool "MI_DBG_NONE"
        config MI_DBG_ERR
            bool "MI_DBG_ERR"
        config MI_DBG_WRN
            bool "MI_DBG_WRN"
        config MI_DBG_API
            bool "MI_DBG_API"
        config MI_DBG_KMSG
            bool "MI_DBG_KMSG"
        config MI_DBG_INFO
            bool "MI_DBG_INFO"
        config MI_DBG_DEBUG
            bool "MI_DBG_DEBUG"
        config MI_DBG_TRACE
            bool "MI_DBG_TRACE"
        config MI_DBG_ALL
            bool "MI_DBG_ALL"
    endchoice
    choice
        prompt "MI USER LIB OPTIMAZITION"
        default MI_USER_LIB_OPT_O3
        config MI_USER_LIB_OPT_Os
            bool "Os"
        config MI_USER_LIB_OPT_O3
            bool "O3"
    endchoice
    config ENABLE_MI_KAPI
        bool "enable mi kapi for mi interface called from kernel space"
        default y
    config ENABLE_MI_LOG_FUNCTION
        bool "enable mi log __FUNCTION__ info"
        default y
    config ENABLE_MI_LOG_FILE
        bool "enable mi log __FILE__ info"
        default y
endmenu

config MI_DBG_LEVEL
    int
    default -1 if  MI_DBG_MINIMAL
    default 0 if  MI_DBG_NONE
    default 1 if  MI_DBG_ERR
    default 2 if  MI_DBG_WRN
    default 3 if  MI_DBG_API
    default 4 if  MI_DBG_KMSG
    default 5 if  MI_DBG_INFO
    default 6 if  MI_DBG_DEBUG
    default 7 if  MI_DBG_TRACE
    default 8 if  MI_DBG_ALL
config MI_USER_LIB_OPT
    string
    default "Os" if  MI_USER_LIB_OPT_Os
    default "O3" if  MI_USER_LIB_OPT_O3
```

## project/configs/Kconfigs/sdk/interface/common/Kconfig
```kconfig
menuconfig INTERFACE_COMMON
    depends on SUPPORT_COMMON
    bool "common"
    default y
    help
        whether to compile or not

if INTERFACE_COMMON
config MI_COMMON_APITIME
    bool "apitime"
    default n
    help
        whether to compile or not

config mi_common_apitime
    string
    default enable if MI_COMMON_APITIME
    default disable if !MI_COMMON_APITIME

config mi_common_rgnsub
    string
    default enable if (INTERFACE_LDC || INTERFACE_VDISP)
    default disable if !(INTERFACE_LDC || INTERFACE_VDISP)

config SUPPORT_CJSON_WRITE
    bool "cjson write"
    default n

config mi_common_cjson_write
    string
    default enable if SUPPORT_CJSON_WRITE
    default disable if !SUPPORT_CJSON_WRITE
endif

config interface_common
    string
    default enable if INTERFACE_COMMON
    default disable if !INTERFACE_COMMON
```

## project/configs/Kconfigs/sdk/interface/cus3a/Kconfig
```kconfig
menuconfig INTERFACE_CUS3A
    depends on SUPPORT_CUS3A
    bool "cus3a"
    default y
    help
        whether to compile or not

config interface_cus3a
    string
    default enable if INTERFACE_CUS3A
    default disable if !INTERFACE_CUS3A
```

## project/configs/Kconfigs/sdk/interface/debug/Kconfig
```kconfig
menuconfig INTERFACE_DEBUG
    depends on SUPPORT_DEBUG
    bool "debug"
    default y
    help
        whether to compile or not

if INTERFACE_DEBUG
config MI_DEBUG_TRACE_CAM_OS_MEM
    bool "trace_cam_os_mem"
    default n

config mi_debug_trace_cam_os_mem
    string
    default enable if MI_DEBUG_TRACE_CAM_OS_MEM
    default disable if !MI_DEBUG_TRACE_CAM_OS_MEM
endif

config interface_debug
    string
    default enable if INTERFACE_DEBUG
    default disable if !INTERFACE_DEBUG
```

## project/configs/Kconfigs/sdk/interface/disp/Kconfig
```kconfig
menuconfig INTERFACE_DISP
    depends on SUPPORT_DISP
    bool "disp"
    default y
    help
        whether to compile or not

if INTERFACE_DISP

config config_mi_disp
    bool "mi_disp"
    default y
    help
        whether to compile or not

endif

config interface_disp
    string
    default enable if INTERFACE_DISP
    default disable if !INTERFACE_DISP
```

## project/configs/Kconfigs/sdk/interface/dpu/Kconfig
```kconfig
menuconfig INTERFACE_DPU
    depends on SUPPORT_DPU
    bool "dpu"
    default n
    help
        whether to compile or not

config interface_dpu
    string
    default enable if INTERFACE_DPU
    default disable if !INTERFACE_DPU
```

## project/configs/Kconfigs/sdk/interface/dsp/Kconfig
```kconfig
menuconfig INTERFACE_DSP
    depends on SUPPORT_DSP
    bool "dsp"
    default y
    help
        whether to compile or not

config interface_dsp
    string
    default enable if INTERFACE_DSP
    default disable if !INTERFACE_DSP
```

## project/configs/Kconfigs/sdk/interface/dummy/Kconfig
```kconfig
menuconfig INTERFACE_DUMMY
    depends on SUPPORT_DUMMY
    bool "dummy"
    default n
    help
        whether to compile or not

config interface_dummy
    string
    default enable if INTERFACE_DUMMY
    default disable if !INTERFACE_DUMMY
```

## project/configs/Kconfigs/sdk/interface/fb/Kconfig
```kconfig
menuconfig INTERFACE_FB
    depends on SUPPORT_FB
    bool "fb"
    default y
    select MHAL_RGN
    help
        whether to compile or not

if INTERFACE_FB

config MI_FB_KAPI
    bool "KAPI"
    default y
    help
        whether to compile or not

config mi_fb_kapi
    string
    default yes if MI_FB_KAPI
    default no if !MI_FB_KAPI


config MI_FB_NORMAL
    bool "disp_path"
    default y
    select INTERFACE_DISP
    help
        whether to compile or not

config MI_FB_VIDEO
    bool "video_path"
    default y
    select INTERFACE_RGN
    help
        whether to compile or not

endif

config interface_fb
    string
    default enable if INTERFACE_FB
    default disable if !INTERFACE_FB
```

## project/configs/Kconfigs/sdk/interface/gfx/Kconfig
```kconfig
menuconfig INTERFACE_GFX
    depends on SUPPORT_GFX
    bool "gfx"
    default y
    select MHAL_GE
    help
        whether to compile or not

if INTERFACE_GFX

config config_mi_gfx
    bool "mi_gfx"
    default y
    depends on MHAL_GE
    help
        whether to compile or not

config MHAL_GE
    bool "mhal_ge"
    default y
    depends on INTERFACE_GFX
    help
        whether to compile or not

config mhal_ge
    string
    default enable if MHAL_GE
    default disable if !MHAL_GE

endif
config interface_gfx
    string
    default enable if INTERFACE_GFX
    default disable if !INTERFACE_GFX
```
