/*
 * audio_lineout.c - Sigmastar
 *
 * Copyright (c) [2019~2022] SigmaStar Technology.
 *
 *
 * This software is licensed under the terms of the GNU General Public
 * License version 2, as published by the Free Software Foundation, and
 * may be copied, distributed, and modified under those terms.
 *
 * This program is distributed in the hope that it will be useful,
 * but WITHOUT ANY WARRANTY; without even the implied warranty of
 * MERCHANTABILITY or FITNESS FOR A PARTICULAR PURPOSE.  See the
 * GNU General Public License version 2 for more details.
 *
 */

#include "mhal_audio.h"
#include "hal_audio_common.h"
#include "audio_test_type.h"

#include <common.h>
#include <malloc.h>
#include <cpu_func.h>

#define MIU_OFFSET 0x20000000

extern void Chip_Flush_Memory(void);

#if 1
u8 tone_48k[] = {
    0x00, 0x00, 0x00, 0x00, 0x5F, 0x08, 0x60, 0x08, 0x9B, 0x10, 0x9A, 0x10, 0x8D, 0x18, 0x8C, 0x18, 0x13, 0x20, 0x13,
    0x20, 0x0D, 0x27, 0x0D, 0x27, 0x5C, 0x2D, 0x5D, 0x2D, 0xE5, 0x32, 0xE4, 0x32, 0x8F, 0x37, 0x8E, 0x37, 0x44, 0x3B,
    0x44, 0x3B, 0xF7, 0x3D, 0xF7, 0x3D, 0x9A, 0x3F, 0x99, 0x3F, 0x27, 0x40, 0x26, 0x40, 0x9A, 0x3F, 0x99, 0x3F, 0xF6,
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    0xC2, 0x09, 0xC2, 0xBB, 0xC4, 0xBC, 0xC4};
#else
u8 tone_48k[] = {
#if 0
    1,    2,    3,    4,    5,    6,    7,    8,    9,    10,   11,   12,   13,   14,   15,   16,   17,   18,   19,
    20,   21,   22,   23,   24,   25,   26,   27,   28,   29,   30,   31,   32,   33,   34,   35,   36,   37,   38,
    39,   40,   1,    2,    3,    4,    5,    6,    7,    8,    9,    10,   11,   12,   13,   14,   15,   16,   17,
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    33,   34,   35,   36,   37,   38,   39,   40,
#endif
    0xFA, 0xFB, 0xFC, 0xFD, 0xFE, 0xFF, 0xFA, 0xFB, 0xFC, 0xFD, 0xFE, 0xFF, 0xFA, 0xFB, 0xFC, 0xFD, 0xFE, 0xFF, 0xFA,
    0xFB, 0xFC, 0xFD, 0xFE, 0xFF, 0xFA, 0xFB, 0xFC, 0xFD, 0xFE, 0xFF, 0xFA, 0xFB, 0xFC, 0xFD, 0xFE, 0xFF, 0xFA, 0xFB,
    0xFC, 0xFD, 0xFE, 0xFF, 0xFA, 0xFB, 0xFC, 0xFD, 0xFE, 0xFF, 0xFA, 0xFB, 0xFC, 0xFD, 0xFE, 0xFF, 0xFA, 0xFB, 0xFC,
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    0xFD, 0xFE, 0xFF, 0xFA, 0xFB, 0xFC, 0xFD, 0xFE, 0xFF, 0xFA, 0xFB, 0xFC, 0xFD, 0xFE, 0xFF};
#endif

static u8 tone_48k_mono[] = {
#if 1 // 1K sine , 48K sample rate
    0x00, 0x00, 0x5F, 0x08, 0x9B, 0x10, 0x8D, 0x18, 0x13, 0x20, 0x0D, 0x27, 0x5C, 0x2D, 0xE5, 0x32, 0x8F, 0x37,
    0x44, 0x3B, 0xF7, 0x3D, 0x9A, 0x3F, 0x27, 0x40, 0x9A, 0x3F, 0xF6, 0x3D, 0x45, 0x3B, 0x8F, 0x37, 0xE5, 0x32,
    0x5C, 0x2D, 0x0E, 0x27, 0x13, 0x20, 0x8C, 0x18, 0x9A, 0x10, 0x60, 0x08, 0x00, 0x00, 0xA1, 0xF7, 0x66, 0xEF,
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    0x73, 0xE7, 0xED, 0xDF, 0xF3, 0xD8, 0xA3, 0xD2, 0x1B, 0xCD, 0x71, 0xC8, 0xBC, 0xC4, 0x09, 0xC2, 0x66, 0xC0,

#if TEST_AO_SPECIAL_SINE
//
#else
    0xD9, 0xBF, 0x66, 0xC0, 0x09, 0xC2, 0xBB, 0xC4, 0x72, 0xC8, 0x1B, 0xCD, 0xA4, 0xD2, 0xF2, 0xD8, 0xEC, 0xDF,
    0x73, 0xE7, 0x66, 0xEF, 0xA1, 0xF7,
#endif

#else
    0x00, 0x00, 0xf9, 0x18, 0xfb, 0x30, 0x1c, 0x47, 0x82, 0x5a, 0x6d, 0x6a, 0x41, 0x76, 0x8a, 0x7d, 0xff, 0x7f, 0x8b,
    0x7d, 0x42, 0x76, 0x6f, 0x6a, 0x84, 0x5a, 0x1f, 0x47, 0xfe, 0x30, 0xfc, 0x18, 0x03, 0x00, 0x0a, 0xe7, 0x07, 0xcf,
    0xe6, 0xb8, 0x80, 0xa5, 0x95, 0x95, 0xc0, 0x89, 0x76, 0x82, 0x00, 0x80, 0x75, 0x82, 0xbc, 0x89, 0x90, 0x95, 0x7a,
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    0x95, 0x7a, 0xa5, 0xde, 0xb8, 0xff, 0xce, 0x02, 0xe7
#endif
};

static u8 tone_48k_noninterleave[] = {
    0x00, 0x00, 0xf9, 0x18, 0xfb, 0x30, 0x1c, 0x47, 0x82, 0x5a, 0x6d, 0x6a, 0x41, 0x76, 0x8a, 0x7d, 0xff, 0x7f, 0x8b,
    0x7d, 0x42, 0x76, 0x6f, 0x6a, 0x84, 0x5a, 0x1f, 0x47, 0xfe, 0x30, 0xfc, 0x18, 0x03, 0x00, 0x0a, 0xe7, 0x07, 0xcf,
    0xe6, 0xb8, 0x80, 0xa5, 0x95, 0x95, 0xc0, 0x89, 0x76, 0x82, 0x00, 0x80, 0x75, 0x82, 0xbc, 0x89, 0x90, 0x95, 0x7a,
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    0x76, 0x82, 0x00, 0x80, 0x75, 0x82, 0xbc, 0x89, 0x90, 0x95, 0x7a, 0xa5, 0xde, 0xb8, 0xff, 0xce, 0x02, 0xe7};

struct pcm_data
{
    MS_U32 dev_id;
    MS_U32 playback;
};

static struct pcm_data pPcmData = {
    .dev_id   = 0,
    .playback = TRUE,
};

typedef enum
{
    AUD_BENCH_CH_CAPTURE,
    AUD_BENCH_CH_PLAYBACK,
    AUD_BENCH_CH_MAX,

} AudBenchChannel_e;

typedef struct _AoConfig_s
{
    unsigned int dmaId;
    unsigned int mode;
    int          fd;
    // pthread_t tid;
    _AUDPcmCfg_t sPcmCfg;
} _AioConfig_t;

#define BENCH_AUDIO_MAX_DEV_NUM 2
#define BENCH_DEV_NUM           2
_AioConfig_t _AioChn[BENCH_AUDIO_MAX_DEV_NUM];

static void _AudyUbootchInit(void)
{
    int DevId;
#if 1
    for (DevId = 0; DevId < BENCH_DEV_NUM; DevId++)
    {
        _AioChn[DevId].dmaId = AUD_AO_DMA_A;
        _AioChn[DevId].fd    = 0;
        _AioChn[DevId].mode  = AUD_BENCH_CH_PLAYBACK;
        // _AioChn[DevId].tid = 0;
        _AioChn[DevId].sPcmCfg.nRate                                    = 48000;
        _AioChn[DevId].sPcmCfg.nBitWidth                                = 16;
        _AioChn[DevId].sPcmCfg.n16Channels                              = 2;
        _AioChn[DevId].sPcmCfg.nInterleaved                             = 1;
        _AioChn[DevId].sPcmCfg.n32PeriodSize                            = 1024;
        _AioChn[DevId].sPcmCfg.n32StartThres                            = 1 << 30;
        _AioChn[DevId].sPcmCfg.nTimeMs                                  = 10000;
        _AioChn[DevId].sPcmCfg.n8IsOnlyEvenCh                           = 0;
        _AioChn[DevId].sPcmCfg.nWrSize                                  = 0;
        _AioChn[DevId].sPcmCfg.nChMode                                  = AUD_AO_CH_MODE_STEREO;
        _AioChn[DevId].sPcmCfg.nI2sConfig                               = 0;
        _AioChn[DevId].sPcmCfg.sI2s.nTdmMode                            = 0;
        _AioChn[DevId].sPcmCfg.sI2s.nMsMode                             = 0;
        _AioChn[DevId].sPcmCfg.sI2s.nBitWidth                           = 0;
        _AioChn[DevId].sPcmCfg.sI2s.nFmt                                = 0;
        _AioChn[DevId].sPcmCfg.sI2s.u16Channels                         = 0;
        _AioChn[DevId].sPcmCfg.sI2s.e4WireMode                          = 0;
        _AioChn[DevId].sPcmCfg.sI2s.eMck                                = 0;
        _AioChn[DevId].sPcmCfg.nSpecialDumpChannels                     = 0;
        _AioChn[DevId].sPcmCfg.aoUseFile                                = 0;
        _AioChn[DevId].sPcmCfg.aiAttach.enAiDma                         = 0;
        _AioChn[DevId].sPcmCfg.aiAttach.aenAiIf[AUD_AI_DMA_CH_SLOT_0_1] = AUD_AI_IF_NONE;
        _AioChn[DevId].sPcmCfg.aiAttach.aenAiIf[AUD_AI_DMA_CH_SLOT_2_3] = AUD_AI_IF_NONE;
        _AioChn[DevId].sPcmCfg.aiAttach.aenAiIf[AUD_AI_DMA_CH_SLOT_4_5] = AUD_AI_IF_NONE;
        _AioChn[DevId].sPcmCfg.aiAttach.aenAiIf[AUD_AI_DMA_CH_SLOT_6_7] = AUD_AI_IF_NONE;
        _AioChn[DevId].sPcmCfg.aoAttachL.enAoDma                        = AUD_AO_DMA_A;
        _AioChn[DevId].sPcmCfg.aoAttachL.enAoIf[0]                      = AUD_AO_IF_DAC_A_0;
        _AioChn[DevId].sPcmCfg.aoAttachL.nAoAttachNum                   = 1;
        _AioChn[DevId].sPcmCfg.aoAttachR.enAoDma                        = AUD_AO_DMA_A;
        _AioChn[DevId].sPcmCfg.aoAttachR.enAoIf[0]                      = AUD_AO_IF_DAC_B_0;
        _AioChn[DevId].sPcmCfg.aoAttachR.nAoAttachNum                   = 1;
    }
#else
    for (DevId = 0; DevId < BENCH_DEV_NUM; DevId++)
    {
        _AioChn[DevId].dmaId = AUD_AO_DMA_A;
        _AioChn[DevId].fd    = 0;
        _AioChn[DevId].mode  = AUD_BENCH_CH_PLAYBACK;
        // _AioChn[DevId].tid = 0;
        _AioChn[DevId].sPcmCfg.nRate                                    = 48000;
        _AioChn[DevId].sPcmCfg.nBitWidth                                = 16;
        _AioChn[DevId].sPcmCfg.n16Channels                              = 2;
        _AioChn[DevId].sPcmCfg.nInterleaved                             = 1;
        _AioChn[DevId].sPcmCfg.n32PeriodSize                            = 1024;
        _AioChn[DevId].sPcmCfg.n32StartThres                            = 1 << 30;
        _AioChn[DevId].sPcmCfg.nTimeMs                                  = 10000;
        _AioChn[DevId].sPcmCfg.n8IsOnlyEvenCh                           = 0;
        _AioChn[DevId].sPcmCfg.nWrSize                                  = 0;
        _AioChn[DevId].sPcmCfg.nChMode                                  = AUD_AO_CH_MODE_STEREO;
        _AioChn[DevId].sPcmCfg.nI2sConfig                               = 1;
        _AioChn[DevId].sPcmCfg.sI2s.nTdmMode                            = 0;
        _AioChn[DevId].sPcmCfg.sI2s.nMsMode                             = 0;
        _AioChn[DevId].sPcmCfg.sI2s.nBitWidth                           = 0;
        _AioChn[DevId].sPcmCfg.sI2s.nFmt                                = 0;
        _AioChn[DevId].sPcmCfg.sI2s.u16Channels                         = 2;
        _AioChn[DevId].sPcmCfg.sI2s.e4WireMode                          = 0;
        _AioChn[DevId].sPcmCfg.sI2s.eMck                                = 6;
        _AioChn[DevId].sPcmCfg.sI2s.nRate                               = 48000;
        _AioChn[DevId].sPcmCfg.nSpecialDumpChannels                     = 0;
        _AioChn[DevId].sPcmCfg.aoUseFile                                = 0;
        _AioChn[DevId].sPcmCfg.aiAttach.enAiDma                         = 0;
        _AioChn[DevId].sPcmCfg.aiAttach.aenAiIf[AUD_AI_DMA_CH_SLOT_0_1] = AUD_AI_IF_NONE;
        _AioChn[DevId].sPcmCfg.aiAttach.aenAiIf[AUD_AI_DMA_CH_SLOT_2_3] = AUD_AI_IF_NONE;
        _AioChn[DevId].sPcmCfg.aiAttach.aenAiIf[AUD_AI_DMA_CH_SLOT_4_5] = AUD_AI_IF_NONE;
        _AioChn[DevId].sPcmCfg.aiAttach.aenAiIf[AUD_AI_DMA_CH_SLOT_6_7] = AUD_AI_IF_NONE;
        _AioChn[DevId].sPcmCfg.aoAttachL.enAoDma                        = AUD_AO_DMA_A;
        _AioChn[DevId].sPcmCfg.aoAttachL.enAoIf[0]                      = AUD_AO_IF_I2S_TX_A_0;
        _AioChn[DevId].sPcmCfg.aoAttachL.nAoAttachNum                   = 1;
        _AioChn[DevId].sPcmCfg.aoAttachR.enAoDma                        = AUD_AO_DMA_A;
        _AioChn[DevId].sPcmCfg.aoAttachR.enAoIf[0]                      = AUD_AO_IF_I2S_TX_A_1;
        _AioChn[DevId].sPcmCfg.aoAttachR.nAoAttachNum                   = 1;
    }
#endif
}

// static char testd[128 * 1024 * 2] __attribute__((aligned(64)));
struct dma_buffer
{
    unsigned char *area;  /* virtual pointer */
    unsigned long  addr;  /* physical address */
    unsigned long  bytes; /* buffer size in bytes */
};

struct dma_buffer buf_AI;
struct dma_buffer buf_AO_u;

static int AudioOpen(void)
{
    /*memory alloc size should page align
      max size = 65535*8 byte          */

    int size = 512 * 1024;
    int ret  = 0;

    memset(&buf_AO_u, 0, sizeof(struct dma_buffer));

    buf_AO_u.area = calloc(1, size);
    if (!buf_AO_u.area)
    {
        printf("[ERROR] AO buffer allocate fail \n");
        return -1;
    }

    // mmu_set_region_dcache_behaviour((unsigned long)buf_AO_u.area, size, DCACHE_OFF);

    memset(buf_AO_u.area, 0x00, size);

    buf_AO_u.addr  = (unsigned long)buf_AO_u.area - MIU_OFFSET;
    buf_AO_u.bytes = size;

    printf("AO dma buffer size 0x%lx\n", buf_AO_u.bytes);
    printf("physical dma address 0x%lx\n", buf_AO_u.addr);
    printf("virtual dma address 0x%lx\n", (unsigned long)buf_AO_u.area);

    _AudyUbootchInit();

    return ret;
}

static int AudioRelease(void)
{
    free(buf_AO_u.area);

    return 0;
}

typedef struct ao_info
{
    int          dmaId;
    int          total_size;
    u8 *         pDataArray;
    int          nArrSize;
    int          nStartThres;
    char         play_wav;
    char         fileName[100];
    char         nAoThreadFinish;
    struct file *ao_file;
    unsigned int u32BufferSize;

} _AO_Info_t;

static void _Msleep(U32 u32MilliSeconds)
{
    udelay(u32MilliSeconds * 1000);
}

int _ubootAoRun(void *data)
{
    //
    _AO_Info_t *pstAoInfo = (_AO_Info_t *)data;

    //
    int size = 0;
    int flag = 1;
    int ret  = 0;

    //
    int          dmaId;
    int          total_size;
    u8 *         pDataArray;
    int          nArrSize;
    int          nStartThres;
    struct file *ao_file;
    int          nErrCount  = 0;
    int          nFullCount = 0;
    int          nTimeOut;
    int          nCurDatalen;
    unsigned int nDmaSize;
    //
    dmaId       = pstAoInfo->dmaId;
    total_size  = pstAoInfo->total_size;
    pDataArray  = pstAoInfo->pDataArray;
    nArrSize    = pstAoInfo->nArrSize;
    nStartThres = pstAoInfo->nStartThres;
    ao_file     = pstAoInfo->ao_file;
    nDmaSize    = pstAoInfo->u32BufferSize;

    while (total_size > nArrSize)
    {
        if ((size >= 10 * 1024) && (flag == 1))
        {
            ret = MHAL_AUDIO_AO_Start(dmaId);
            if (ret)
            {
                printf("MHAL_AUDIO_StartPcmOut fail !!! ret = %d\n", ret);
                goto fail;
            }
            else
            {
                printf("AO DMA Start ! current size = %d\n", size);
            }

            flag = 0;
        }

        ret = MHAL_AUDIO_AO_GetCurrDataLen(dmaId, &nCurDatalen);
        // printf("MHAL_AUDIO_AO_GetCurrDataLen is %d, nDmaSize is %d\n", nCurDatalen, nDmaSize);
        if (ret < 0)
        {
            printf("MHAL_AUDIO_AO_GetCurrDataLen is %d, nDmaSize is %d\n", nCurDatalen, nDmaSize);
            // goto fail;
        }
        if (nDmaSize - nCurDatalen >= 3 * nArrSize)
        {
            nFullCount = 0;
            ret        = MHAL_AUDIO_AO_Write_Data(dmaId, pDataArray, nArrSize); // FALSE
            if (ret >= 0)
            {
                // printf("write success\n");
                size += nArrSize;
                total_size -= nArrSize;
            }
            else
            {
                nErrCount++;
                printf("MHAL_AUDIO_WriteDataOut fail !!! ret = %d\n", ret);
                if (nErrCount >= 10)
                {
                    goto fail;
                }
                if (MHAL_AUDIO_AO_IsXrun(dmaId))
                {
                    printf("line %d AO Empty ! XRUN !!!\n", __LINE__);
                    flag = 1;
                    size = 0;
                }
            }
        }
        else
        {
            _Msleep(1);
            nFullCount++;
            if (nFullCount >= 10)
            {
                // printf("AO full check clk !!!\n");
                // goto fail;
            }
        }
    }

fail:
    pstAoInfo->nAoThreadFinish = 1;

    return 0;
}

static int AudioPlayIoctl(void)
{
    _AUDPcmCfg_t             sPcmCfg;
    struct AUD_GainCfg_s     sGainCfg;
    struct AUD_SineGen_Cfg_s sSineGenCfg;
    MHAL_AUDIO_PcmCfg_t      tPcm;
    MHAL_AUDIO_I2sCfg_t      tI2sCfg;
    MHAL_SineGen_Cfg_t       tSineGen;
    MHAL_AO_Attach_t         tAoAttach;

    int                           dmaId = 0;
    int                           ret;
    int                           total_size = 0;
    u8 *                          pDataArray;
    int                           nArrSize;
    int                           nStartThres;
    _AO_Info_t                    stAoInfo;
    u8                            aoInterface = E_MHAL_AO_IF_NONE;
    int                           i;
    struct AUD_InterfaceMuteCfg_s sInterfaceMuteCfg;
    struct AUD_DpgaMuteCfg_s      sDpgaMuteCfg;
    struct file *                 ao_file;

    memset(&stAoInfo, 0, sizeof(stAoInfo));

    memcpy(&sPcmCfg, &_AioChn[0].sPcmCfg, sizeof(_AUDPcmCfg_t));

    if (sPcmCfg.nRate == 8000)
        tPcm.enRate = E_MHAL_AUDIO_RATE_8K;
    else if (sPcmCfg.nRate == 11000 || sPcmCfg.nRate == 11025)
        tPcm.enRate = E_MHAL_AUDIO_RATE_11K;
    else if (sPcmCfg.nRate == 12000)
        tPcm.enRate = E_MHAL_AUDIO_RATE_12K;
    else if (sPcmCfg.nRate == 16000)
        tPcm.enRate = E_MHAL_AUDIO_RATE_16K;
    else if (sPcmCfg.nRate == 22000 || sPcmCfg.nRate == 22050)
        tPcm.enRate = E_MHAL_AUDIO_RATE_22K;
    else if (sPcmCfg.nRate == 24000)
        tPcm.enRate = E_MHAL_AUDIO_RATE_24K;
    else if (sPcmCfg.nRate == 32000)
        tPcm.enRate = E_MHAL_AUDIO_RATE_32K;
    else if (sPcmCfg.nRate == 44000 || sPcmCfg.nRate == 44100)
        tPcm.enRate = E_MHAL_AUDIO_RATE_44K;
    else if (sPcmCfg.nRate == 48000)
        tPcm.enRate = E_MHAL_AUDIO_RATE_48K;
    else if (sPcmCfg.nRate == 96000)
        tPcm.enRate = E_MHAL_AUDIO_RATE_96K;
    else if (sPcmCfg.nRate == 192000)
        tPcm.enRate = E_MHAL_AUDIO_RATE_192K;
    else
    {
        printf("AUDRV_PCM_IOCTL sample rate %d not support!!!\n", sPcmCfg.nRate);
        return -EFAULT;
    }

    if (sPcmCfg.nBitWidth == 16)
        tPcm.enWidth = E_MHAL_AUDIO_BITWIDTH_16;
    else if (sPcmCfg.nBitWidth == 32)
        tPcm.enWidth = E_MHAL_AUDIO_BITWIDTH_32;
    else
    {
        printf("AUDRV_PCM_IOCTL bitwidth %d not support!!!\n", sPcmCfg.nBitWidth);
        return -EFAULT;
    }

    if (sPcmCfg.n16Channels == 1)
    {
        printf("use it 111\n");
        pDataArray = tone_48k_mono;
        nArrSize   = sizeof(tone_48k_mono);
    }
    else if (sPcmCfg.n16Channels == 2)
    {
        if (sPcmCfg.nInterleaved)
        {
            printf("use it \n");
            pDataArray = tone_48k;
            nArrSize   = sizeof(tone_48k);
        }
        else
        {
            pDataArray = tone_48k_noninterleave;
            nArrSize   = sizeof(tone_48k_noninterleave);
        }
    }
    else
    {
        printf("AUDRV_PCM_IOCTL channel %d not support!!!\n", sPcmCfg.n16Channels);
        return -EFAULT;
    }

    tPcm.u16Channels   = sPcmCfg.n16Channels; // not used now
    tPcm.bInterleaved  = sPcmCfg.nInterleaved;
    tPcm.pu8DmaArea    = buf_AO_u.area;
    tPcm.phyDmaAddr    = buf_AO_u.addr;
    tPcm.u32BufferSize = buf_AO_u.bytes;
    tPcm.u32PeriodSize = sPcmCfg.n32PeriodSize; // 1024*2*2*6;

    tPcm.enChMode       = sPcmCfg.nChMode;        // audio 3.0 new item momo enable bit
    tPcm.u8IsOnlyEvenCh = sPcmCfg.n8IsOnlyEvenCh; // audio 3.0 new item enable momo when = 1

    ret = MHAL_AUDIO_AO_Config(dmaId, &tPcm);
    if (ret)
    {
        printf("MHAL_AUDIO_AO_Config error=%d!!!\n", ret);
        return -EFAULT;
    }
    ret = MHAL_AUDIO_AO_Open(dmaId);
    if (ret)
    {
        printf("MHAL_AUDIO_AO_Open error=%d!!!\n", ret);
        goto fail;
    }

    if (sPcmCfg.nI2sConfig)
    {
        if (sPcmCfg.sI2s.nTdmMode == 1)
        {
            if (sPcmCfg.sI2s.nMsMode == 0)
            {
                tI2sCfg.enMode = E_MHAL_AUDIO_MODE_TDM_MASTER;
            }
            else
            {
                tI2sCfg.enMode = E_MHAL_AUDIO_MODE_TDM_SLAVE;
            }
        }
        else if (sPcmCfg.sI2s.nTdmMode == 0)
        {
            if (sPcmCfg.sI2s.nMsMode == 0)
            {
                tI2sCfg.enMode = E_MHAL_AUDIO_MODE_I2S_MASTER;
            }
            else
            {
                tI2sCfg.enMode = E_MHAL_AUDIO_MODE_I2S_SLAVE;
            }
        }
        else
        {
            printf("AUDRV_PCM_IOCTL I2S mode not support!!!\n");
            return -EFAULT;
        }

        tI2sCfg.enWidth = (sPcmCfg.sI2s.nBitWidth ? E_MHAL_AUDIO_BITWIDTH_32 : E_MHAL_AUDIO_BITWIDTH_16);

        tI2sCfg.enFmt = (sPcmCfg.sI2s.nFmt ? E_MHAL_AUDIO_I2S_FMT_LEFT_JUSTIFY : E_MHAL_AUDIO_I2S_FMT_I2S);

        tI2sCfg.u16Channels = sPcmCfg.sI2s.u16Channels;

        tI2sCfg.enMck = sPcmCfg.sI2s.eMck;

        tI2sCfg.en4WireMode = sPcmCfg.sI2s.e4WireMode;

        tI2sCfg.enRate = sPcmCfg.sI2s.nRate;

        for (i = 0; i < AUD_AIO_MAX_AO_INTERFACE; i++)
        {
            if (sPcmCfg.aoAttachL.enAoIf[i] > AUD_AO_IF_ECHO_A_1)
            {
                ret = MHAL_AUDIO_AO_If_Setting(sPcmCfg.aoAttachL.enAoIf[i], &tI2sCfg);
                if (ret)
                {
                    printf("MHAL_AUDIO_ConfigI2sOut error=%d!!!\n", ret);
                    goto fail;
                }
            }
        }
        for (i = 0; i < AUD_AIO_MAX_AO_INTERFACE; i++)
        {
            if (sPcmCfg.aoAttachR.enAoIf[i] > AUD_AO_IF_ECHO_A_1)
            {
                ret = MHAL_AUDIO_AO_If_Setting(sPcmCfg.aoAttachR.enAoIf[i], &tI2sCfg);
                if (ret)
                {
                    printf("MHAL_AUDIO_ConfigI2sOut error=%d!!!\n", ret);
                    goto fail;
                }
            }
        }
    }

    tAoAttach.enAoDma  = sPcmCfg.aoAttachL.enAoDma;
    tAoAttach.nAoDmaCh = sPcmCfg.aoAttachL.nAoDmaCh;
    for (i = 0; i < sPcmCfg.aoAttachL.nAoAttachNum; i++)
    {
        tAoAttach.enAoIf = sPcmCfg.aoAttachL.enAoIf[i];
        ret              = MHAL_AUDIO_AO_Attach(&tAoAttach);
        if (ret)
        {
            printf("MHAL_AUDIO_AO_AttachL error=%d!!!\n", ret);
            goto fail;
        }
    }

    tAoAttach.enAoDma  = sPcmCfg.aoAttachR.enAoDma;
    tAoAttach.nAoDmaCh = sPcmCfg.aoAttachR.nAoDmaCh;
    for (i = 0; i < sPcmCfg.aoAttachR.nAoAttachNum; i++)
    {
        tAoAttach.enAoIf = sPcmCfg.aoAttachR.enAoIf[i];
        ret              = MHAL_AUDIO_AO_Attach(&tAoAttach);
        if (ret)
        {
            printf("MHAL_AUDIO_AO_AttachL error=%d!!!\n", ret);
            goto fail;
        }
    }

    if (sPcmCfg.nI2sConfig)
    {
        total_size = sPcmCfg.nTimeMs * (sPcmCfg.sI2s.nRate / 1000) * sPcmCfg.n16Channels * (sPcmCfg.nBitWidth / 8);
    }
    else
    {
        total_size = sPcmCfg.nTimeMs * (sPcmCfg.nRate / 1000) * sPcmCfg.n16Channels * (sPcmCfg.nBitWidth / 8);
    }

    printf("AO total_size %d[%d %d %d %d]!!!\n", total_size, sPcmCfg.nTimeMs,
           sPcmCfg.nI2sConfig ? sPcmCfg.sI2s.nRate : sPcmCfg.nRate, sPcmCfg.n16Channels, sPcmCfg.nBitWidth);

    if (sPcmCfg.n16Channels == 1 || sPcmCfg.n8IsOnlyEvenCh == 1)
    {
        nStartThres = (buf_AO_u.bytes / 2) - (sPcmCfg.n32PeriodSize * 4);
    }
    else
    {
        nStartThres = (buf_AO_u.bytes / 1) - (sPcmCfg.n32PeriodSize * 4);
    }

    printf("AO threshold size %d\n", nStartThres);

    if (sPcmCfg.sGainCfg.nGainEn)
    {
        if ((MHAL_AUDIO_AO_Dpga_Gain(dmaId, 0, sPcmCfg.sGainCfg.nDpgaGain[0], sPcmCfg.sGainCfg.nGainFading) != 0)
            || (MHAL_AUDIO_AO_Dpga_Gain(dmaId, 1, sPcmCfg.sGainCfg.nDpgaGain[1], sPcmCfg.sGainCfg.nGainFading) != 0))
        {
            printf("TEST_DPGA_GAIN_FADING - MHAL_AUDIO_SetGainOut -20 fail !!!\n");
            return -EFAULT;
        }
    }

    stAoInfo.dmaId         = dmaId;
    stAoInfo.total_size    = total_size;
    stAoInfo.pDataArray    = pDataArray;
    stAoInfo.nStartThres   = nStartThres;
    stAoInfo.ao_file       = ao_file;
    stAoInfo.u32BufferSize = tPcm.u32BufferSize;
    if (sPcmCfg.nWrSize)
    {
        stAoInfo.nArrSize = sPcmCfg.nWrSize;
    }
    else
    {
        stAoInfo.nArrSize = nArrSize;
    }

    _ubootAoRun(&stAoInfo);

    //
fail:

#if TEST_AO_HOT_STOP
    //
#else
    ret = MHAL_AUDIO_AO_Stop(dmaId);
    if (ret)
    {
        printf("MHAL_AUDIO_AO_Stop error=%d!!!\n", ret);
        // return -EFAULT;
    }
#endif
    tAoAttach.enAoDma  = sPcmCfg.aoAttachL.enAoDma;
    tAoAttach.nAoDmaCh = sPcmCfg.aoAttachL.nAoDmaCh;
    for (i = 0; i < sPcmCfg.aoAttachL.nAoAttachNum; i++)
    {
        tAoAttach.enAoIf = sPcmCfg.aoAttachL.enAoIf[i];
        ret              = MHAL_AUDIO_AO_Detach(&tAoAttach);
        if (ret)
        {
            printf("MHAL_AUDIO_AO_DetachL error=%d!!!\n", ret);
        }
    }

    tAoAttach.enAoDma  = sPcmCfg.aoAttachR.enAoDma;
    tAoAttach.nAoDmaCh = sPcmCfg.aoAttachR.nAoDmaCh;
    for (i = 0; i < sPcmCfg.aoAttachR.nAoAttachNum; i++)
    {
        tAoAttach.enAoIf = sPcmCfg.aoAttachR.enAoIf[i];
        ret              = MHAL_AUDIO_AO_Detach(&tAoAttach);
        if (ret)
        {
            printf("MHAL_AUDIO_AO_DetachL error=%d!!!\n", ret);
        }
    }

    if (sPcmCfg.aoUseFile)
    {
        //  filp_close(ao_file, NULL);
    }

    ret = MHAL_AUDIO_AO_Close(dmaId);
    if (ret)
    {
        printf("MHAL_AUDIO_AO_Close error=%d!!!\n", ret);
        return -EFAULT;
    }

    //
    printf("Ao PCM Test Finish !\n");
    return 0;
}

void lineout_gain(int nGain)
{
    int dev = pPcmData.dev_id;

    // MHAL_AUDIO_SetGainOut(dev, nGain, 0, E_MHAL_AUDIO_GAIN_FADING_7);
    // MHAL_AUDIO_SetGainOut(dev, nGain, 1, E_MHAL_AUDIO_GAIN_FADING_7);
    printf("AO dpga Gain %d!!!\n", nGain);
}

void lineout_start(void)
{
    int Ret = 0;

    Ret = AudioOpen();
    if (Ret != 0)
    {
        printf("[ERROR] AudioOpen fail \n");
    }

    MHAL_AUDIO_Init(NULL);

    Ret = AudioPlayIoctl();

    if (Ret != 0)
    {
        printf("[ERROR] AudioPlayIoctl fail \n");
    }

    AudioRelease();
}
