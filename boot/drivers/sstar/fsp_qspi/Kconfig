## boot/drivers/sstar/mcu/Kconfig
```kconfig
config SSTAR_MCU
    bool "Sigmastar MCU"
    depends on DM
    default n
    help
      Enable MCU configuration driver pass parameters to MCU only

config IR_KEY_NR
    int "Number of IR key for wakeup"
    depends on SSTAR_MCU
    default 3
    help
      Define number of IR key for wakeup system should match with
      configuration of MCU.
```

## boot/drivers/sstar/rpmb/Kconfig
```kconfig
menuconfig SSTAR_RPMB
	bool "SigmaStar RPMB support"
	default n

if SSTAR_RPMB
config RPMB_KEY_FILE
	string "RPMB key path"
	default "drivers/sstar/rpmb/default.rpmbkey"
	help
	  Specify binary rpmb key file path
endif
```

## boot/drivers/sstar/rtc/Kconfig
```kconfig
config SSTAR_RTC
    select DM_RTC
    select CMD_SSTAR_RTC
    tristate "Sstar RTC Driver"
    default n

config SSTAR_RTC_WITH_PWC
    bool "Sstar RTC With PWC"
    depends on SSTAR_RTC
    default n

choice
    prompt "Sstar PWC IO Mode"
    depends on SSTAR_RTC_WITH_PWC
    default SSTAR_PWC_IO_INTERRUPT

config SSTAR_PWC_IO_POLLING
    bool "Polling Mode"

config SSTAR_PWC_IO_INTERRUPT
    bool "Interrupt Mode"

endchoice

config SSTAR_RTC_WITH_ALARM
    bool "Sstar RTC With Alarm"
    depends on SSTAR_RTC
    default n

config SSTAR_RTC_WITH_OFFSET
    bool "Sstar RTC With Offset"
    depends on SSTAR_RTC
    default n
```

## boot/drivers/sstar/usb/Kconfig
```kconfig
config SSTAR_USB_DWC3
	bool "DesignWare USB3 Host/Gadget Support on SigmaStar Platforms"
	depends on ARCH_SSTAR
	select USB
	select USB_DWC3
	select DM_USB
	select DM_DMA
	select REGMAP
	select SYSCON
	help
	  Support of USB3 Host/Gadget functionality in SigmaStar Platforms.

if SSTAR_USB_DWC3
choice
	bool "DWC3 Mode Selection"

config SSTAR_USB_DWC3_HOST
	bool "Host only mode"
	select USB_DWC3_HOST
	help
	  Select this when you want to use DWC3 in host mode only,
	  thereby the gadget feature will be regressed.

config SSTAR_USB_DWC3_GADGET
	bool "Gadget only mode"
	select MISC
	select USB_GADGET
	select DM_USB_GADGET
	select USB_DWC3_GADGET
	select USB_DWC3_GENERIC
	help
	  Select this when you want to use DWC3 in gadget mode only,
	  thereby the host feature will be regressed.
endchoice

config SSTAR_USB_PHY
	bool "Infinity/Mercury SoC series USB PHY driver"
	help
	  Enable USB PHY support for Infinity/Mercury SoC series.
	  This driver provides PHY interface for USB 3.0 DRD controller
	  present on Infinity/Mercury SoC series.
endif

config SSTAR_USB_EHCI
	bool "SigmaStar USB2.0 Host Controller"
	depends on USB_EHCI_HCD
	select CMD_USB

config SSTAR_USB_RESET
	bool "SigmaStar USB Reset Control"
	select DM_RESET
	default y if USB
```

## boot/drivers/sstar/usb/gadget/udc/usb20/Kconfig
```kconfig
config SSTAR_USB_GADGET_MSB250X
	bool "SigmaStar USB 2.0 Device Controller"
	select USB_GADGET
	select DM_USB_GADGET
	help
	  SigmaStar USB device

config USB_FPGA_VERIFICATION
	bool "FPGA verification only"
	depends on SSTAR_USB_GADGET_MSB250X
	default n

config SSTAR_UTMI_POWERON
	bool "Power on UTMI first"
	depends on SSTAR_USB_GADGET_MSB250X
	default y
```

## boot/fs/firmwarefs/Kconfig
```kconfig
config FS_FIRMWAREFS
	bool "Support Firmware FileSystem"
	default n

config FIRMWAREFS_ON_EMMC
	bool "Use firmwarefs on emmc/sdcard device"
	depends on FS_FIRMWAREFS
	default y
```

## kernel/arch/arm/configs/iford_ssc029a_s01a_emmc_MPLL_defconfig
```kconfig
# CONFIG_LOCALVERSION_AUTO is not set
CONFIG_KERNEL_XZ=y
# CONFIG_SWAP is not set
CONFIG_SYSVIPC=y
CONFIG_POSIX_MQUEUE=y
# CONFIG_CROSS_MEMORY_ATTACH is not set
CONFIG_NO_HZ=y
CONFIG_HIGH_RES_TIMERS=y
CONFIG_PREEMPT=y
CONFIG_LOG_BUF_SHIFT=15
CONFIG_CGROUPS=y
CONFIG_NAMESPACES=y
CONFIG_CC_OPTIMIZE_FOR_SIZE=y
# CONFIG_FHANDLE is not set
# CONFIG_BASE_FULL is not set
# CONFIG_ADVISE_SYSCALLS is not set
CONFIG_KALLSYMS_ALL=y
CONFIG_EMBEDDED=y
CONFIG_PERF_EVENTS=y
# CONFIG_VM_EVENT_COUNTERS is not set
# CONFIG_SLUB_DEBUG is not set
CONFIG_ARCH_SSTAR=y
CONFIG_MODULES_AREA_SIZE=0x01000000
CONFIG_SSTAR_DTB_NAME="iford-ssc029a-s01a"
CONFIG_SSTAR_SHORT_NAME="IFORD"
CONFIG_ARCH_IFORD=y
CONFIG_ARM_THUMBEE=y
# CONFIG_CACHE_L2X0 is not set
CONFIG_SMP=y
CONFIG_HAVE_ARM_ARCH_TIMER=y
CONFIG_THUMB2_KERNEL=y
CONFIG_HIGHMEM=y
# CONFIG_HIGHPTE is not set
CONFIG_ZBOOT_ROM_TEXT=0
CONFIG_ZBOOT_ROM_BSS=0
CONFIG_ARM_APPENDED_DTB=y
CONFIG_ARM_ATAG_DTB_COMPAT=y
CONFIG_CPU_FREQ_STAT=y
CONFIG_CPU_FREQ_DEFAULT_GOV_ONDEMAND=y
CONFIG_CPU_FREQ_GOV_POWERSAVE=y
CONFIG_CPU_FREQ_GOV_USERSPACE=y
CONFIG_NEON=y
CONFIG_KERNEL_MODE_NEON=y
# CONFIG_SUSPEND is not set
CONFIG_PM=y
CONFIG_JUMP_LABEL=y
# CONFIG_SECCOMP is not set
# CONFIG_STRICT_KERNEL_RWX is not set
CONFIG_MODULES=y
CONFIG_MODULE_FORCE_LOAD=y
CONFIG_MODULE_UNLOAD=y
# CONFIG_BLK_DEV_BSG is not set
CONFIG_PARTITION_ADVANCED=y
CONFIG_SSTAR_EMMC_PARTITION=y
CONFIG_CMA=y
CONFIG_CMA_DEBUG=y
CONFIG_CMA_DEBUGFS=y
CONFIG_CMA_AREAS=1
CONFIG_UNIX=y
CONFIG_IP_MULTICAST=y
CONFIG_IP_ADVANCED_ROUTER=y
CONFIG_IP_ROUTE_MULTIPATH=y
CONFIG_IP_ROUTE_VERBOSE=y
CONFIG_SYN_COOKIES=y
# CONFIG_INET_DIAG is not set
CONFIG_TCP_CONG_ADVANCED=y
# CONFIG_TCP_CONG_BIC is not set
# CONFIG_TCP_CONG_WESTWOOD is not set
# CONFIG_TCP_CONG_HTCP is not set
# CONFIG_IPV6 is not set
CONFIG_CFG80211=m
CONFIG_CFG80211_WEXT=y
CONFIG_UEVENT_HELPER=y
CONFIG_UEVENT_HELPER_PATH="/sbin/mdev"
CONFIG_DEVTMPFS=y
CONFIG_DEVTMPFS_MOUNT=y
# CONFIG_STANDALONE is not set
# CONFIG_PREVENT_FIRMWARE_BUILD is not set
CONFIG_FW_LOADER=m
# CONFIG_ALLOW_DEV_COREDUMP is not set
CONFIG_MTD=y
CONFIG_MTD_CMDLINE_PARTS=y
# CONFIG_MTD_OF_PARTS is not set
CONFIG_MTD_BLOCK=y
CONFIG_MTD_PHYSMAP=y
CONFIG_MTD_PHYSMAP_OF=y
CONFIG_MTD_PLATRAM=y
# CONFIG_BLK_DEV is not set
CONFIG_EEPROM_AT24=m
CONFIG_EEPROM_LEGACY=m
CONFIG_BLK_DEV_SD=y
CONFIG_ATA=y
CONFIG_SATA_AHCI_PLATFORM=y
# CONFIG_NET_CORE is not set
# CONFIG_ETHERNET is not set
CONFIG_PHYLIB=y
CONFIG_ICPLUS_PHY=y
CONFIG_INPUT_MOUSEDEV=y
CONFIG_INPUT_MOUSEDEV_PSAUX=y
CONFIG_INPUT_EVDEV=y
# CONFIG_VT is not set
# CONFIG_LEGACY_PTYS is not set
CONFIG_I2C=y
# CONFIG_I2C_COMPAT is not set
CONFIG_I2C_CHARDEV=y
# CONFIG_I2C_HELPER_AUTO is not set
CONFIG_SPI=y
CONFIG_SPI_SPIDEV=y
CONFIG_GPIOLIB=y
CONFIG_GPIO_SYSFS=y
# CONFIG_HWMON is not set
CONFIG_WATCHDOG=y
CONFIG_WATCHDOG_CORE=y
CONFIG_WATCHDOG_NOWAYOUT=y
CONFIG_WATCHDOG_PRETIMEOUT_GOV=y
CONFIG_FB=y
CONFIG_UHID=y
CONFIG_USB=m
CONFIG_USB_ANNOUNCE_NEW_DEVICES=y
CONFIG_USB_EHCI_HCD=m
CONFIG_USB_EHCI_ROOT_HUB_TT=y
CONFIG_USB_STORAGE=m
CONFIG_MMC=y
CONFIG_UIO=y
CONFIG_UIO_PDRV_GENIRQ=y
CONFIG_STAGING=y
# CONFIG_IOMMU_SUPPORT is not set
CONFIG_SSTAR_DRIVERS=y
CONFIG_SSTAR_UART=y
CONFIG_SSTAR_MEASURE_CLK=y
CONFIG_SSTAR_PWM=y
CONFIG_SSTAR_MSPI=y
CONFIG_SSTAR_BDMA=y
CONFIG_SSTAR_BDMA_LINE_OFFSET_ON=y
CONFIG_SSTAR_BDMA_BLIT_WRAPPER=y
CONFIG_SSTAR_CPU_FREQ=y
CONFIG_SSTAR_SDMMC=y
CONFIG_SSTAR_SELECT_EMMC=y
CONFIG_SSTAR_I2C=y
CONFIG_SSTAR_RTC=y
CONFIG_PM_CLK_SRC_24M=y
CONFIG_SSTAR_WATCHDOG=y
CONFIG_SSTAR_TIMER=y
CONFIG_MSTAR_MMAHEAP=y
CONFIG_SSTAR_NETPHY=y
# CONFIG_SSTAR_VOLTAGE_CTRL is not set
CONFIG_SSTAR_EMAC=y
# CONFIG_SSTAR_FLASH is not set
CONFIG_SSTAR_USB2_PHY=m
CONFIG_SSTAR_CRYPTO=y
CONFIG_SSTAR_AESDMA_INTR=y
CONFIG_SSTAR_RNG=y
CONFIG_CRYPTODEV=y
CONFIG_SSTAR_SEM=y
CONFIG_SSTAR_UPDATE_DQ=m
CONFIG_EXT4_FS=y
CONFIG_EXT4_FS_POSIX_ACL=y
CONFIG_EXT4_FS_SECURITY=y
CONFIG_JBD2_DEBUG=y
CONFIG_FS_ENCRYPTION=y
CONFIG_FUSE_FS=y
CONFIG_MSDOS_FS=m
CONFIG_VFAT_FS=m
CONFIG_NTFS_FS=m
CONFIG_TMPFS=y
CONFIG_TMPFS_POSIX_ACL=y
CONFIG_CONFIGFS_FS=y
CONFIG_JFFS2_FS=y
# CONFIG_JFFS2_FS_WRITEBUFFER is not set
CONFIG_SQUASHFS=y
CONFIG_SQUASHFS_FILE_DIRECT=y
CONFIG_SQUASHFS_LZO=y
CONFIG_SQUASHFS_XZ=y
CONFIG_SQUASHFS_4K_DEVBLK_SIZE=y
CONFIG_SQUASHFS_EMBEDDED=y
CONFIG_NFS_FS=m
CONFIG_CIFS=m
CONFIG_CIFS_WEAK_PW_HASH=y
# CONFIG_CIFS_DEBUG is not set
CONFIG_NLS=y
CONFIG_NLS_CODEPAGE_437=y
CONFIG_NLS_ISO8859_1=y
CONFIG_NLS_UTF8=m
CONFIG_ENCRYPTED_KEYS=y
CONFIG_CRYPTO_SEQIV=y
CONFIG_CRYPTO_ECHAINIV=m
CONFIG_CRYPTO_CMAC=y
CONFIG_CRYPTO_MD4=y
CONFIG_CRYPTO_MD5=y
CONFIG_CRYPTO_DES=y
CONFIG_CRYPTO_DEFLATE=y
CONFIG_CRYPTO_LZO=y
# CONFIG_CRYPTO_HW is not set
# CONFIG_XZ_DEC_X86 is not set
# CONFIG_XZ_DEC_POWERPC is not set
# CONFIG_XZ_DEC_IA64 is not set
# CONFIG_XZ_DEC_SPARC is not set
CONFIG_DMA_CMA=y
CONFIG_CMA_SIZE_MBYTES=2
CONFIG_CMA_ALIGNMENT=4
CONFIG_MESSAGE_LOGLEVEL_DEFAULT=3
# CONFIG_DEBUG_BUGVERBOSE is not set
CONFIG_DEBUG_INFO=y
CONFIG_FRAME_WARN=4096
CONFIG_DEBUG_FS=y
# CONFIG_SCHED_DEBUG is not set
# CONFIG_DEBUG_PREEMPT is not set
CONFIG_DEBUG_RT_MUTEXES=y
CONFIG_DEBUG_SPINLOCK=y
CONFIG_DEBUG_MUTEXES=y
CONFIG_STACKTRACE=y
# CONFIG_RCU_TRACE is not set
# CONFIG_FTRACE is not set
CONFIG_DEBUG_LL=y
CONFIG_DEBUG_SSTAR_UART=y
CONFIG_EARLY_PRINTK=y
```

## kernel/arch/arm/configs/iford_ssz029c_s01b_nor_demo_defconfig
```kconfig
# CONFIG_LOCALVERSION_AUTO is not set
CONFIG_KERNEL_XZ=y
# CONFIG_SWAP is not set
CONFIG_SYSVIPC=y
# CONFIG_CROSS_MEMORY_ATTACH is not set
CONFIG_NO_HZ=y
CONFIG_HIGH_RES_TIMERS=y
CONFIG_PREEMPT=y
CONFIG_LOG_BUF_SHIFT=15
CONFIG_LOG_CPU_MAX_BUF_SHIFT=15
CONFIG_PRINTK_SAFE_LOG_BUF_SHIFT=12
CONFIG_CGROUPS=y
CONFIG_NAMESPACES=y
# CONFIG_UTS_NS is not set
# CONFIG_IPC_NS is not set
# CONFIG_PID_NS is not set
CONFIG_BLK_DEV_INITRD=y
# CONFIG_RD_BZIP2 is not set
# CONFIG_RD_LZMA is not set
# CONFIG_RD_XZ is not set
# CONFIG_RD_LZO is not set
# CONFIG_RD_LZ4 is not set
# CONFIG_RD_ZSTD is not set
CONFIG_CC_OPTIMIZE_FOR_SIZE=y
# CONFIG_UID16 is not set
# CONFIG_SYSFS_SYSCALL is not set
# CONFIG_FHANDLE is not set
# CONFIG_ELF_CORE is not set
# CONFIG_BASE_FULL is not set
# CONFIG_EPOLL is not set
# CONFIG_SIGNALFD is not set
# CONFIG_TIMERFD is not set
# CONFIG_SHMEM is not set
# CONFIG_AIO is not set
# CONFIG_IO_URING is not set
# CONFIG_ADVISE_SYSCALLS is not set
CONFIG_EMBEDDED=y
# CONFIG_VM_EVENT_COUNTERS is not set
# CONFIG_SLUB_DEBUG is not set
CONFIG_ARCH_SSTAR=y
CONFIG_SSTAR_CLK_IGNORE_UNUSED=y
CONFIG_MODULES_AREA_SIZE=0x01000000
CONFIG_SSTAR_DTB_NAME="iford-ssz029c-s01a-dualos_demo"
CONFIG_SSTAR_SHORT_NAME="IFORD"
CONFIG_ARCH_IFORD=y
# CONFIG_SS_MIU_ARBITRATION is not set
CONFIG_ARM_THUMBEE=y
# CONFIG_CACHE_L2X0 is not set
CONFIG_SMP=y
CONFIG_HAVE_ARM_ARCH_TIMER=y
CONFIG_THUMB2_KERNEL=y
CONFIG_PARAVIRT_TIME_ACCOUNTING=y
CONFIG_ZBOOT_ROM_TEXT=0
CONFIG_ZBOOT_ROM_BSS=0
CONFIG_ARM_APPENDED_DTB=y
CONFIG_ARM_ATAG_DTB_COMPAT=y
CONFIG_NEON=y
CONFIG_KERNEL_MODE_NEON=y
CONFIG_PM_WAKELOCKS=y
CONFIG_PM_WAKELOCKS_LIMIT=50
CONFIG_JUMP_LABEL=y
# CONFIG_SECCOMP is not set
# CONFIG_STRICT_KERNEL_RWX is not set
# CONFIG_STRICT_MODULE_RWX is not set
CONFIG_MODULES=y
CONFIG_MODULE_FORCE_LOAD=y
CONFIG_MODULE_UNLOAD=y
# CONFIG_BLK_DEV_BSG is not set
# CONFIG_BLK_DEBUG_FS is not set
# CONFIG_MQ_IOSCHED_KYBER is not set
CONFIG_CMA=y
CONFIG_CMA_AREAS=1
CONFIG_UNIX=y
CONFIG_IP_MULTICAST=y
CONFIG_SYN_COOKIES=y
# CONFIG_INET_DIAG is not set
# CONFIG_IPV6 is not set
CONFIG_CFG80211=m
# CONFIG_CFG80211_DEFAULT_PS is not set
CONFIG_CFG80211_WEXT=y
# CONFIG_ETHTOOL_NETLINK is not set
CONFIG_UEVENT_HELPER=y
CONFIG_UEVENT_HELPER_PATH="/sbin/mdev"
CONFIG_DEVTMPFS=y
CONFIG_DEVTMPFS_MOUNT=y
# CONFIG_STANDALONE is not set
# CONFIG_PREVENT_FIRMWARE_BUILD is not set
CONFIG_FW_LOADER=m
# CONFIG_ALLOW_DEV_COREDUMP is not set
CONFIG_MTD=y
CONFIG_MTD_CMDLINE_PARTS=y
# CONFIG_MTD_OF_PARTS is not set
CONFIG_MTD_BLOCK=y
CONFIG_MTD_PHYSMAP=y
CONFIG_MTD_PHYSMAP_OF=y
CONFIG_MTD_PLATRAM=y
# CONFIG_BLK_DEV is not set
CONFIG_EEPROM_AT24=m
CONFIG_EEPROM_LEGACY=m
# CONFIG_NET_CORE is not set
# CONFIG_ETHERNET is not set
CONFIG_PHYLIB=y
# CONFIG_USB_NET_DRIVERS is not set
# CONFIG_WLAN is not set
CONFIG_INPUT_EVDEV=m
CONFIG_KEYBOARD_ATKBD=m
CONFIG_MOUSE_PS2=m
CONFIG_SERIO=m
# CONFIG_VT is not set
# CONFIG_LEGACY_PTYS is not set
CONFIG_I2C=y
# CONFIG_I2C_COMPAT is not set
CONFIG_I2C_CHARDEV=y
# CONFIG_I2C_HELPER_AUTO is not set
CONFIG_GPIOLIB=y
CONFIG_GPIO_SYSFS=y
# CONFIG_GPIO_CDEV is not set
# CONFIG_HWMON is not set
CONFIG_WATCHDOG=y
CONFIG_WATCHDOG_CORE=y
CONFIG_WATCHDOG_NOWAYOUT=y
CONFIG_FB=y
CONFIG_UHID=m
CONFIG_USB=m
CONFIG_USB_ANNOUNCE_NEW_DEVICES=y
CONFIG_USB_EHCI_HCD=m
CONFIG_USB_EHCI_ROOT_HUB_TT=y
CONFIG_MMC=m
CONFIG_UIO=m
CONFIG_UIO_PDRV_GENIRQ=m
# CONFIG_VIRTIO_MENU is not set
# CONFIG_VHOST_MENU is not set
CONFIG_STAGING=y
# CONFIG_IOMMU_SUPPORT is not set
CONFIG_SSTAR_DRIVERS=y
CONFIG_SSTAR_UART=y
CONFIG_SSTAR_PWM=y
CONFIG_SSTAR_BDMA=y
CONFIG_SSTAR_BDMA_LINE_OFFSET_ON=y
CONFIG_SSTAR_BDMA_BLIT_WRAPPER=y
CONFIG_SSTAR_CPU_FREQ=y
CONFIG_SSTAR_I2C=y
CONFIG_SSTAR_RTC=y
CONFIG_SSTAR_TIMER=y
CONFIG_MSTAR_MMAHEAP=y
CONFIG_SSTAR_NETPHY=m
# CONFIG_SSTAR_VOLTAGE_CTRL is not set
CONFIG_SSTAR_EMAC=m
CONFIG_SSTAR_FSP_QSPI=y
CONFIG_SSTAR_NOR=y
CONFIG_SSTAR_USB2_PHY=m
CONFIG_SSTAR_CRYPTO=y
CONFIG_SSTAR_AESDMA_INTR=y
CONFIG_SSTAR_RNG=y
CONFIG_CRYPTODEV=y
CONFIG_FUSE_FS=m
CONFIG_MSDOS_FS=m
CONFIG_VFAT_FS=m
CONFIG_NTFS_FS=m
CONFIG_CONFIGFS_FS=y
CONFIG_JFFS2_FS=y
# CONFIG_JFFS2_FS_WRITEBUFFER is not set
CONFIG_SQUASHFS=y
CONFIG_SQUASHFS_FILE_DIRECT=y
# CONFIG_SQUASHFS_ZLIB is not set
CONFIG_SQUASHFS_XZ=y
CONFIG_SQUASHFS_4K_DEVBLK_SIZE=y
CONFIG_SQUASHFS_EMBEDDED=y
CONFIG_NFS_FS=m
CONFIG_CIFS=m
CONFIG_CIFS_WEAK_PW_HASH=y
# CONFIG_CIFS_DEBUG is not set
CONFIG_NLS=y
CONFIG_NLS_CODEPAGE_437=y
CONFIG_NLS_ISO8859_1=y
CONFIG_NLS_UTF8=m
CONFIG_LSM=""
CONFIG_CRYPTO_SEQIV=m
CONFIG_CRYPTO_ECHAINIV=m
CONFIG_CRYPTO_LZO=y
# CONFIG_CRYPTO_HW is not set
CONFIG_CRC16=y
# CONFIG_XZ_DEC_X86 is not set
# CONFIG_XZ_DEC_POWERPC is not set
# CONFIG_XZ_DEC_IA64 is not set
# CONFIG_XZ_DEC_ARM is not set
# CONFIG_XZ_DEC_ARMTHUMB is not set
# CONFIG_XZ_DEC_SPARC is not set
CONFIG_DMA_CMA=y
CONFIG_CMA_SIZE_MBYTES=2
CONFIG_CMA_ALIGNMENT=4
CONFIG_MESSAGE_LOGLEVEL_DEFAULT=3
# CONFIG_SYMBOLIC_ERRNAME is not set
# CONFIG_DEBUG_BUGVERBOSE is not set
CONFIG_DEBUG_INFO=y
CONFIG_FRAME_WARN=4096
CONFIG_DEBUG_FS=y
# CONFIG_DEBUG_MISC is not set
# CONFIG_SCHED_DEBUG is not set
# CONFIG_DEBUG_PREEMPT is not set
CONFIG_DEBUG_RT_MUTEXES=y
CONFIG_DEBUG_SPINLOCK=y
CONFIG_DEBUG_MUTEXES=y
CONFIG_STACKTRACE=y
# CONFIG_RCU_TRACE is not set
# CONFIG_FTRACE is not set
CONFIG_DEBUG_LL=y
CONFIG_DEBUG_SSTAR_UART=y
CONFIG_EARLY_PRINTK=y
```
