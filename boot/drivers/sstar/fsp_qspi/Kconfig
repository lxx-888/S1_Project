## kernel/drivers/sstar/Kconfig
```kconfig
menuconfig SSTAR_DRIVERS
    bool "Sstar SoC platform drivers"
    select RT_MUTEXES
    depends on ARCH_SSTAR
    default n

menuconfig CAM_DRIVERS
    bool "SStar Cam drivers"
    depends on SSTAR_DRIVERS
    default n
if ( CAM_DRIVERS )
source "drivers/sstar/camdriver/Kconfig"
endif

menuconfig DLA_DRIVER
    bool "SStar DLA driver"
    depends on SSTAR_DRIVERS
    default n
if ( DLA_DRIVER )
source "drivers/sstar/cambricon/Kconfig"
endif

if ( SSTAR_DRIVERS )
source "drivers/sstar/irqchip/Kconfig"
source "drivers/sstar/clocksource/Kconfig"
source "drivers/sstar/msys/Kconfig"
source "drivers/sstar/uart/Kconfig"
source "drivers/sstar/clk/Kconfig"
source "drivers/sstar/flash_isp/Kconfig"
source "drivers/sstar/pwm/Kconfig"
source "drivers/sstar/xor_dma/Kconfig"
source "drivers/sstar/spinand/Kconfig"
source "drivers/sstar/mspi/Kconfig"
source "drivers/sstar/pspi/Kconfig"
source "drivers/sstar/bdma/Kconfig"
source "drivers/sstar/miu/Kconfig"
source "drivers/sstar/camclk/Kconfig"
source "drivers/sstar/cpufreq/Kconfig"
source "drivers/sstar/sdmmc/Kconfig"
source "drivers/sstar/ir/Kconfig"
source "drivers/sstar/i2c/Kconfig"
source "drivers/sstar/gpio/Kconfig"
source "drivers/sstar/padmux/Kconfig"
source "drivers/sstar/rtc/Kconfig"
source "drivers/sstar/watchdog/Kconfig"
source "drivers/sstar/timer/Kconfig"
source "drivers/sstar/sar/Kconfig"
source "drivers/sstar/sar_key/Kconfig"
source "drivers/sstar/mma_heap/Kconfig"
source "drivers/sstar/netphy/Kconfig"
source "drivers/sstar/voltage/Kconfig"
source "drivers/sstar/voltage_idac/Kconfig"
source "drivers/sstar/iopower/Kconfig"
source "drivers/sstar/fcie/Kconfig"
source "drivers/sstar/power/Kconfig"
source "drivers/sstar/emac/Kconfig"
source "drivers/sstar/proxyfs/Kconfig"
source "drivers/sstar/gyro/Kconfig"
source "drivers/sstar/keypad/Kconfig"
source "drivers/sstar/sysdesc/Kconfig"
source "drivers/sstar/rpmsg/Kconfig"
source "drivers/sstar/fsp_qspi/Kconfig"
source "drivers/sstar/flash/Kconfig"
source "drivers/sstar/copro/Kconfig"
source "drivers/sstar/drm/Kconfig"
source "drivers/sstar/usb/Kconfig"
source "drivers/sstar/crypto/Kconfig"
source "drivers/sstar/devfreq/Kconfig"
config CAM_DEVICE_WRAPPER
    tristate "cam device wrapper"
    default y
source "drivers/sstar/mcu/Kconfig"
source "drivers/sstar/ut/Kconfig"
source "drivers/sstar/riu/Kconfig"
source "drivers/sstar/sem/Kconfig"
source "drivers/sstar/mbx/Kconfig"
source "drivers/sstar/miu_dq/Kconfig"
source "drivers/sstar/swla/Kconfig"
endif

config TRACE_CAM_OS_MEM
    bool "SStar trace cam_os_wrapper memory function"
    depends on SSTAR_DRIVERS
    default n
```

## kernel/drivers/sstar/bdma/Kconfig
```kconfig
config SSTAR_BDMA
	bool "Sstar BDMA"
	default n

config SSTAR_BDMA_LINE_OFFSET_ON
	bool "Sstar BDMA Line Offset On"
	depends on SSTAR_BDMA
	default n

config SSTAR_BDMA_BLIT_WRAPPER
	bool "Sstar BDMA Blit Wrapper"
	depends on SSTAR_BDMA
	default n
```

## kernel/drivers/sstar/cam_os_wrapper/Kconfig
```kconfig
config TRACE_CAM_OS_MEM
        bool "Sigmastar trace cam_os_wrapper memory function"
        depends on SSTAR_DRIVERS
        default y
```

## kernel/drivers/sstar/clk/Kconfig
```kconfig
config SSTAR_MEASURE_CLK
    tristate "Sstar CLK support peripheral clock measure function"

config SSTAR_CLK_OS_MANAGE
    tristate "Sstar CLK OS Manage"
    default n
```

## kernel/drivers/sstar/cpufreq/Kconfig
```kconfig
config SSTAR_CPU_FREQ
	tristate "CPU frequency scaling driver"
    select CPU_FREQ
    select CPU_FREQ_GOV_ONDEMAND
    select PM_OPP

if SSTAR_CPU_FREQ && (SSTAR_VOLTAGE_IDAC_CTRL || SSTAR_VOLTAGE_CTRL)
config SSTAR_CPUFREQ_DVS
    bool "cpufreq supports voltage scaling"
	default y
endif
```

## kernel/drivers/sstar/devfreq/Kconfig
```kconfig
menuconfig SSTAR_DEVFREQ
	tristate "SStar generic frequency scaling driver"
	select PM_DEVFREQ
	help
	  Support voltage and frequency scaling (DVFS) for non-CPU devices

if SSTAR_DEVFREQ

config SSTAR_DDRFREQ
	tristate "SStar DDR frequency scaling driver"
	select DEVFREQ_GOV_USERSPACE
	select DEVFREQ_GOV_SIMPLE_ONDEMAND
	help
	  Support adjusting DRAM frequency dynamically

endif # SSTAR_DEVFREQ
```

## kernel/drivers/sstar/emac/Kconfig
```kconfig
config SSTAR_EMAC
select NET
select NET_ETHERNET
select MII
select PACKET
select USE_POLICY_FWD
select INET
select NETDEVICES

tristate "SSTAR_EMAC"
default n

help
Enable compilation option for driver EMAC

if SSTAR_PADMUX
config EMAC0_PHY_RESET_HOLD_MS
int "Set emac0 phy reset padmux low in millisecond"
default 20
help
    Set emac0 phy reset padmux low in millisecond

config EMAC0_PHY_RESET_WAIT_READY_MS
int "Set emac0 phy reset padmux high wait ready in millisecond"
default 50
help
    Set emac0 phy reset padmux high wait ready in millisecond

config EMAC1_PHY_RESET_HOLD_MS
int "Set emac1 phy reset padmux low in millisecond"
default 20
help
    Set emac1 phy reset padmux low in millisecond

config EMAC1_PHY_RESET_WAIT_READY_MS
int "Set emac1 phy reset padmux high wait ready in millisecond"
default 50
help
    Set emac1 phy reset padmux high wait ready in millisecond
endif

if SSTAR_EMAC
config EMAC_SUPPLY_RNG
bool "Supply to random number generator device"
default n
help
    Supply to random number generator device

config SSTAR_HW_TX_CHECKSUM
bool "Supply to hardware TX checksum"
default n
help
    Supply to hardware TX checksum

config K3_RX_SWPATCH
bool "Supply to K3 RX SW Patch"
default n
help
    Supply to K3 RX frame drop due to padding 4 bytes issue

config DISCONNECT_DELAY_S
int "Disconnect delay in second"
default 1
help
    Disconnect delay in second

config SSTAR_EEE
bool "Supply to EEE function"
default n
help
    Supply to EEE function

config EMAC_PHY_RESTART_AN
bool "Supply to phy restart AN"
default n
help
    Supply to phy restart AN
endif
```

## kernel/drivers/sstar/flash/Kconfig
```kconfig
config SSTAR_FLASH
        tristate 'SigmaStar FLASH'
        default y

config SSTAR_NAND
        tristate "SPINAND"
        depends on SSTAR_FLASH
        default n

config SSTAR_NOR
        tristate "SPINOR"
        depends on SSTAR_FLASH
        default n

config SSTAR_SOC_ECC
        bool "SOC ECC"
        depends on SSTAR_FLASH && SSTAR_NAND

config SSTAR_FLASH_WRITE_BACK
        bool "FLASH WRITE BCAK"
        depends on SSTAR_FLASH
        default n
```
