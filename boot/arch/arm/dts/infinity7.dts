/*
* infinity7.dts- Sigmastar
*
* Copyright (c) [2019~2020] SigmaStar Technology.
*
*
* This software is licensed under the terms of the GNU General Public
* License version 2, as published by the Free Software Foundation, and
* may be copied, distributed, and modified under those terms.
*
* This program is distributed in the hope that it will be useful,
* but WITHOUT ANY WARRANTY; without even the implied warranty of
* MERCHANTABILITY or FITNESS FOR A PARTICULAR PURPOSE.  See the
* GNU General Public License version 2 for more details.
*
*/


/dts-v1/;
/memreserve/ 0x1000040000 0x00040000;
#include "infinity7.dtsi"
#include "infinity7-padmux.dtsi"

/ {
    model = "INFINITY7 EVB";
    compatible = "sstar,infinity7";
    #address-cells = <2>;
    #size-cells = <2>;

    /*
     * There are two methods to transmit DDR parameters to kernel:
     * 1) "LX_MEM=start_addr,len" parameters in bootargs, which has higher priority, will cover memory node parameters in dts;
     * 2) memory mode paramters in dts file, which has lower priority, only as spare parameter.
     */
    memory {
        device_type = "memory";
        #address-cells = <2>;
        #size-cells = <2>;
        reg = <0x00000010 0x00000000 0x00000001 0x00000000>;
    };

    // mmc aliases
    aliases {
        mmc0 = &sstar_mmc3;
        mmc1 = &sstar_mmc0;
        mmc2 = &sstar_mmc1;
    };

	soc {
	    #include "infinity7-clks-u-boot.dtsi"
    };
};
