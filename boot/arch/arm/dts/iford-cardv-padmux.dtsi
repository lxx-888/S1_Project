/*
 * iford-cardv-padmux.dtsi- Sigmastar
 *
 * Copyright (c) [2019~2020] SigmaStar Technology.
 *
 *
 * This software is licensed under the terms of the GNU General Public
 * License version 2, as published by the Free Software Foundation, and
 * may be copied, distributed, and modified under those terms.
 *
 * This program is distributed in the hope that it will be useful,
 * but WITHOUT ANY WARRANTY; without even the implied warranty of
 * MERCHANTABILITY or FITNESS FOR A PARTICULAR PURPOSE.  See the
 * GNU General Public License version 2 for more details.
 *
 */
#include "../../../drivers/sstar/include/iford/padmux.h"
#include "../../../drivers/sstar/include/drv_puse.h"

/ {
    soc {
         padmux {
            compatible = "sstar,padmux";
            schematic =
#ifdef CONFIG_SSTAR_SELECT_EMMC
                //EMMC
                <PAD_GPIO1             PINMUX_FOR_EMMC4B_MODE_1        MDRV_PUSE_SDIO0_D1>,
                <PAD_GPIO2             PINMUX_FOR_EMMC4B_MODE_1        MDRV_PUSE_SDIO0_D0>,
                <PAD_GPIO3             PINMUX_FOR_EMMC4B_MODE_1        MDRV_PUSE_SDIO0_CLK>,
                <PAD_GPIO4             PINMUX_FOR_EMMC4B_MODE_1        MDRV_PUSE_SDIO0_CMD>,
                <PAD_GPIO5             PINMUX_FOR_EMMC4B_MODE_1        MDRV_PUSE_SDIO0_D3>,
                <PAD_GPIO6             PINMUX_FOR_EMMC4B_MODE_1        MDRV_PUSE_SDIO0_D2>,
                <PAD_PM_GPIO11         PINMUX_FOR_GPIO_MODE            MDRV_PUSE_SDIO0_PWR>,
                <PAD_GPIO7             PINMUX_FOR_EMMC_RST_MODE_1      MDRV_PUSE_SDIO0_CDZ>,
#endif
#if 0
                //SDMMC0
                <PAD_SD0_D1              PINMUX_FOR_SD0_MODE_1           MDRV_PUSE_SDIO0_D1>,
                <PAD_SD0_D0              PINMUX_FOR_SD0_MODE_1           MDRV_PUSE_SDIO0_D0>,
                <PAD_SD0_CLK             PINMUX_FOR_SD0_MODE_1           MDRV_PUSE_SDIO0_CLK>,
                <PAD_SD0_CMD             PINMUX_FOR_SD0_MODE_1           MDRV_PUSE_SDIO0_CMD>,
                <PAD_SD0_D3              PINMUX_FOR_SD0_MODE_1           MDRV_PUSE_SDIO0_D3>,
                <PAD_SD0_D2              PINMUX_FOR_SD0_MODE_1           MDRV_PUSE_SDIO0_D2>,
                <PAD_PM_GPIO11           PINMUX_FOR_GPIO_MODE            MDRV_PUSE_SDIO0_PWR>,
                <PAD_SD0_CDZ             PINMUX_FOR_SD0_CDZ_MODE_1       MDRV_PUSE_SDIO0_CDZ>,
#endif
#if 0
                // EMMC1
                <PAD_PM_SDIO_D1              PINMUX_FOR_PM_SDIO_MODE_1               MDRV_PUSE_SDIO1_D1>,
                <PAD_PM_SDIO_D0              PINMUX_FOR_PM_SDIO_MODE_1               MDRV_PUSE_SDIO1_D0>,
                <PAD_PM_SDIO_CLK             PINMUX_FOR_PM_SDIO_MODE_1               MDRV_PUSE_SDIO1_CLK>,
                <PAD_PM_SDIO_CMD             PINMUX_FOR_PM_SDIO_MODE_1               MDRV_PUSE_SDIO1_CMD>,
                <PAD_PM_SDIO_D3              PINMUX_FOR_PM_SDIO_MODE_1               MDRV_PUSE_SDIO1_D3>,
                <PAD_PM_SDIO_D2              PINMUX_FOR_PM_SDIO_MODE_1               MDRV_PUSE_SDIO1_D2>,
                <PAD_PM_GPIO12               PINMUX_FOR_GPIO_MODE                    MDRV_PUSE_SDIO1_PWR>,
                <PAD_PM_GPIO6                PINMUX_FOR_PM_SDIO_RSTN_MODE_1          MDRV_PUSE_SDIO1_CDZ>,
#endif
#if 1
                // TTL16
                <PAD_GPIO0          PINMUX_FOR_TTL16_MODE_1         MDRV_PUSE_TTL16_LVSYNC>,
                <PAD_GPIO1          PINMUX_FOR_TTL16_MODE_1         MDRV_PUSE_TTL16_LHSYNC>,
                <PAD_GPIO2          PINMUX_FOR_TTL16_MODE_1         MDRV_PUSE_TTL16_LDE>,
                <PAD_GPIO3          PINMUX_FOR_TTL16_MODE_1         MDRV_PUSE_TTL16_LCK>,
                <PAD_GPIO4          PINMUX_FOR_TTL16_MODE_1         MDRV_PUSE_TTL16_B4>,
                <PAD_GPIO5          PINMUX_FOR_TTL16_MODE_1         MDRV_PUSE_TTL16_B3>,
                <PAD_GPIO6          PINMUX_FOR_TTL16_MODE_1         MDRV_PUSE_TTL16_B2>,
                <PAD_GPIO7          PINMUX_FOR_TTL16_MODE_1         MDRV_PUSE_TTL16_B1>,
                <PAD_GPIO8          PINMUX_FOR_TTL16_MODE_1         MDRV_PUSE_TTL16_B0>,
                <PAD_GPIO9          PINMUX_FOR_TTL16_MODE_1         MDRV_PUSE_TTL16_G5>,
                <PAD_GPIO10         PINMUX_FOR_TTL16_MODE_1         MDRV_PUSE_TTL16_G4>,
                <PAD_GPIO11         PINMUX_FOR_TTL16_MODE_1         MDRV_PUSE_TTL16_G3>,
                <PAD_SD0_CDZ        PINMUX_FOR_TTL16_MODE_1         MDRV_PUSE_TTL16_G2>,
                <PAD_SD0_D1         PINMUX_FOR_TTL16_MODE_1         MDRV_PUSE_TTL16_G1>,
                <PAD_SD0_D0         PINMUX_FOR_TTL16_MODE_1         MDRV_PUSE_TTL16_G0>,
                <PAD_SD0_CLK        PINMUX_FOR_TTL16_MODE_1         MDRV_PUSE_TTL16_R4>,
                <PAD_SD0_CMD        PINMUX_FOR_TTL16_MODE_1         MDRV_PUSE_TTL16_R3>,
                <PAD_SD0_D3         PINMUX_FOR_TTL16_MODE_1         MDRV_PUSE_TTL16_R2>,
                <PAD_SD0_D2         PINMUX_FOR_TTL16_MODE_1         MDRV_PUSE_TTL16_R1>,
                <PAD_FUART_RTS      PINMUX_FOR_TTL16_MODE_1         MDRV_PUSE_TTL16_R0>,
#endif
#if 1
                // SDMMC1
                <PAD_PM_PSPI0_DI         PINMUX_FOR_PM_SDIO_MODE_3           MDRV_PUSE_SDIO1_D1>,
                <PAD_PM_PSPI0_DO         PINMUX_FOR_PM_SDIO_MODE_3           MDRV_PUSE_SDIO1_D0>,
                <PAD_PM_PSPI0_CK         PINMUX_FOR_PM_SDIO_MODE_3           MDRV_PUSE_SDIO1_CLK>,
                <PAD_PM_PSPI0_CZ         PINMUX_FOR_PM_SDIO_MODE_3           MDRV_PUSE_SDIO1_CMD>,
                <PAD_PM_GPIO10           PINMUX_FOR_PM_SDIO_MODE_3           MDRV_PUSE_SDIO1_D3>,
                <PAD_PM_GPIO9            PINMUX_FOR_PM_SDIO_MODE_3           MDRV_PUSE_SDIO1_D2>,
                <PAD_PM_GPIO5            PINMUX_FOR_GPIO_MODE                MDRV_PUSE_SDIO1_PWR>,
                <PAD_PM_PSPI0_INT        PINMUX_FOR_PM_SDIO_CDZ_MODE_2       MDRV_PUSE_SDIO1_CDZ>,
#endif

                <GPIO_NR                 PINMUX_FOR_UNKNOWN_MODE         MDRV_PUSE_NA>;
            status = "okay"; // ok or disable
        };

    };

};
