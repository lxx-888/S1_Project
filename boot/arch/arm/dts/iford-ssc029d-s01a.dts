/*
* iford-ssc029d-s01a.dts- Sigmastar
*
* Copyright (c) [2019~2020] SigmaStar Technology.
*
*
* This software is licensed under the terms of the GNU General Public
* License version 2, as published by the Free Software Foundation, and
* may be copied, distributed, and modified under those terms.
*
* This program is distributed in the hope that it will be useful,
* but WITHOUT ANY WARRANTY; without even the implied warranty of
* MERCHANTABILITY or FITNESS FOR A PARTICULAR PURPOSE.  See the
* GNU General Public License version 2 for more details.
*
*/


/dts-v1/;
#if defined(CONFIG_SSTAR_FORCE_RELOC_ADDR) && (CONFIG_SSTAR_FORCE_RELOC_ADDR > 0x0)
/memreserve/ CONFIG_SSTAR_FORCE_RELOC_ADDR 0x00040000;
#else
/memreserve/ 0x20FC0000 0x00040000;
#endif
#include "iford.dtsi"
#include "iford-ssc029d-s01a-padmux.dtsi"

/ {
    model = "IFORD";
    compatible = "sstar,iford";
    #address-cells = <1>;
    #size-cells = <1>;

    /*
     * There are two methods to transmit DDR parameters to kernel:
     * 1) "LX_MEM=start_addr,len" parameters in bootargs, which has higher priority, will cover memory node parameters in dts;
     * 2) memory mode paramters in dts file, which has lower priority, only as spare parameter.
     */
    memory {
        device_type = "memory";
        #address-cells = <1>;
        #size-cells = <1>;
        reg = <0x20000000 0x10000000>;
    };

    // mmc aliases
    aliases {
        mmc0 = &sstar_mmc1; //FCIE
        mmc1 = &sstar_mmc0; //SDIO
    };

    soc {
        #include "iford-clks-u-boot.dtsi"
    };
};
