## boot/arch/arm/mach-sstar/Kconfig
```kconfig
if ARCH_SSTAR

menu "SigmaStar arch features support"
	depends on ARCH_SSTAR

choice
	prompt "Select architecture"
	default SSTAR_ARM32

	config SSTAR_ARM32
		bool "SigmaStar ARM32"
		select CPU_V7A

	config SSTAR_ARM64
		bool "SigmaStar ARM64"
		select ARM64
endchoice

config SYS_CONFIG_NAME
	default $(SSTAR_CHIP_NAME)

config SYS_SOC
	default $(SSTAR_CHIP_NAME)

config SSTAR_BOOTING_PERF
	bool "booting time"
	default n

config SSTAR_VERSION_FPGA
	bool "FPGA version"
	default n

config SSTAR_VERSION_PZ1
	bool "Palladium version"
	default n
	help
	  This will disable some board settings.
	  And it will enable the system DCache to speed up kernel loading.

config SSTAR_BOOT_DEV
	string "boot device"
	default "mmc"
	help
	  specify boot device type

config SSTAR_BOOT_DEV_ID
	int "boot device id"
	default 0
	help
	  specify boot device id

config SSTAR_ENV_PART_NAME
	string "env patition name"
	default "env"
	help
	  secify the real 'env' partition name in partition table

config SSTAR_LOGO_PART_NAME
        string "logo patition name"
        default "logo"
        help
          secify the real 'logo' partition name in partition table

config SSTAR_MISC_PART_NAME
	string "misc patition name"
	default "misc"
	help
	  secify the real 'misc' partition name in partition table

config SSTAR_DTBO_PART_NAME
	string "dtbo patition name"
	default "dtbo"
	help
	  secify the real 'dtbo' partition name in partition table

config SSTAR_BUILTIN_KERNEL_DTB
	bool "Built-in dtb support"
	default y
	help
	  When Kernel use SigmaStar built-in dtb, uboot should pass
	  atags instead fdt to kernel from x0.

config SSTAR_KERNEL_ADDR_OFFSET
	hex "Address offset between kernel and uboot"
	default 0x0
	help
	  In some special cases, such as infinity7 we load kernel/fdt/initrd at
	  address base 0x20000000 but jump address base 0x1000000000 to start
	  kernel(those starting addr are mapped to same physical address).
	  uImage and android bootimage header only support spcify 32-bit wide
	  address for kernel&fdt&initrd. enable this config to support add
	  offset to those addr. use this config, must set env initrd_high and
	  fdt_high to -1UL to avoid initrd/fdt reloacate.

config SSTAR_DISABLE_FIXUP_DTB_MEMORY_NODE
	bool "disable fixup 'memory' node"
	default n
	help
	  Before cmd boot<i|z|m> jump Linux will fixup memory node, set the
	  memory node to the DRAM range used by uboot. enable this config to
	  disable this feature.

config SSTAR_UBOOT_DTB_OVERLAY
	bool "Uboot DTB overlay"
	select SSTAR_DTB_OVERLAY_SUPPORT
	default n
	help
	  Select this config to enable uboot dtb overlay feature, this feature
	  will load fdt table from 'dtbo' partition. all dtbo specify in env
	  'uboot_dtbo_list' will be overlay to uboot dtb. If your driver cares
	  about the result of dtb overlay, please try to get property from
	  the device node after 'board_init'.

config SSTAR_KERNEL_DTB_OVERLAY
	bool "Kernel DTB overlay"
	select SSTAR_DTB_OVERLAY_SUPPORT
	default n
	help
	  Select this config to enable kernel dtb overlay feature, this feature
	  will load fdt table from 'dtbo' partition. all dtbo specify in env
	  'kernel_dtbo_list' will be overlay to kernel dtb.

config SSTAR_DTB_OVERLAY_SUPPORT
	bool
	select OF_LIBFDT_OVERLAY
	select CMD_ADTIMG
	default n

config SSTAR_RAM_SIZE
	hex "DRAM size managed by system"
	default 0x4000000
	help
	  DRAM size managed by system can not equal to actual
	  DRAM size.

config SSTAR_USE_TOOLCHAIN_DEFAULT_FLOAT_ABI
	bool "Use toolchain default float ABI"
	default n
	help
	  Enable uboot to use the same float ABI as toolchain

config SSTAR_DISABLE_CODE_RELOC
	bool "Disable code relocate at board_init_f"
	default y
	help
	  Support uboot keep stay at TEXT_START, no
	  been relocate boot flow

endmenu
endif
```

## boot/arch/arm/mach-sstar/Kconfig.Android
```kconfig
menu "SigmaStar Android Support"
config SSTAR_ANDROID_BOOTLOADER
	bool "SigmaStar Android Bootloader customized part"
	default n
	depends on ANDROID_BOOTLOADER
	help
	  If enabled, insert SigmaStar additional code into common
	  android bootloader flow to support SigmaStar android bootloader
	  flow.

config SSTAR_ANDROID_AB
	bool "SigmaStar Android A/B updates"
	depends on ANDROID_AB
	default n
	help
	  If enabled, support SigmaStar additional code for
	  Android A/B update.
endmenu
```

## boot/arch/arm/mach-sstar/iford/Kconfig
```kconfig
if SSTAR_IFORD

config SSTAR_CHIP_ID
	string "SigmaStar chip id"
	default "IFORD"

config SYS_CONFIG_NAME
	default "iford"
	help
	  To load the "include/configs/iford.h"

config SYS_SOC
	default "iford"
	help
	  To generate correct  "arch/arm/include/asm/arch"

endif
```

## boot/arch/arm/mach-sstar/infinity6c/Kconfig
```kconfig
if SSTAR_INFINITY6C

config SSTAR_CHIP_ID
	string "SigmaStar chip id"
	default "I6C"

config SYS_CONFIG_NAME
	default "infinity6c"
	help
	  To load the "include/configs/infinity6c.h"

config SYS_SOC
	default "infinity6c"
	help
	  To generate correct  "arch/arm/include/asm/arch"

endif
```

## boot/cmd/sstar/Kconfig
```kconfig
menu "SigmaStar android commands"
config CMD_SSTAR_AB_RESET
	bool "ab_reset"
	default n
	depends on ANDROID_AB
	help
	  Init ab control block at Android "misc" partition

config CMD_SSTAR_RPMB
	bool "rpmb"
	default n
	depends on SSTAR_RPMB
	help
	  Support operations for eMMC rpmb part
endmenu

menu "SigmaStar cmmon commands"
config CMD_SSTAR_ESTAR
	bool "estar"
	default n
	help
	  support SigmaStar cmd estar

if CMD_SSTAR_ESTAR
config SSTAR_ESTAR_LOAD_SCRIPT_ADDR
	hex "Cmd estar load script addr"
	default 0x21000000
endif

config CMD_SSTAR_AIO
	bool "aio"
	depends on SSTAR_AIO
	help
	  SigmaStar support cmd aio

config CMD_SSTAR_UART
	bool "uart"
	default n
	help
	  SigmaStar support cmd uart

config CMD_SSTAR_RIU
	bool "riu"
	default n
	help
	  SigmaStar support cmd riu

config CMD_SSTAR_DEBUG
	bool "debug"
	default n
	help
	  SigmaStar support cmd debug

config CMD_SSTAR_MMC
	bool "emmc/dstar/sdstar/emmcstar/..."
	select SSTAR_MMC_HOST
	select SSTAR_EMMC_PARTTION
	select CMD_MMC
	default n
	help
	  SigmaStar support cmd emmc, emmcstar, emmc_get_cust, emmc_wp, bootbp

config CMD_SSTAR_MMC_FDISK
	bool "fdisk"
	select DOS_PARTITION
	select SSTAR_MMC_HOST
	select CMD_MMC
	select CMD_FAT
	select FAT_WRITE
	default n
	help
	  SigmaStar support cmd fdisk

config CMD_SSTAR_SIGAUTH
	bool "sigauth"
	depends on SSTAR_AESDMA
	default y
	help
	  SigmaStar support cmd sigauth

config CMD_SSTAR_AES
	bool "AES"
	depends on SSTAR_AESDMA
	default y
	help
	  SigmaStar support verify aesdma.

config CMD_SSTAR_VERSIG
	bool "versig"
	depends on OPTEE
	default n
	help
	  SigmaStar support cmd versig

menu "SigmaStar usbstar commands"
config CMD_SSTAR_USBSTAR
	bool "usbstar"
	default n
	select CMD_FAT
	select DOS_PARTITION
	select USB_STORAGE
	help
	  SigmaStar support download image through usb host

config SSTAR_AUTOBOOT_RUN_USBSTAR_BY_GPIO
	bool "autoboot usbstar by gpio"
	depends on CMD_SSTAR_USBSTAR
	default n
	help
	  Sigmastar run usbstar command in autoboot by gpio

config SSTAR_AUTOBOOT_RUN_USBSTAR_GPIO_NUM
	int "GPIO NUM"
	depends on SSTAR_AUTOBOOT_RUN_USBSTAR_BY_GPIO
	default "0"
	help
	  Sigmastar run usbstar command in autoboot gpio num

config SSTAR_AUTOBOOT_RUN_USBSTAR_BY_ENV
	bool "autoboot usbstar by env(auto_usbstar)"
	depends on CMD_SSTAR_USBSTAR
	default n
	help
	  Sigmastar run usbstar command in autoboot by env

config CMD_SSTAR_USBSTAR_USB2
	bool "usb2.0"
	depends on CMD_SSTAR_USBSTAR
	select USB_EHCI_HCD
	select SSTAR_USB_EHCI
	default y
	help
	  cmd usbstar usb2.0 host

config CMD_SSTAR_USBSTAR_USB3
	bool "usb3.0"
	depends on CMD_SSTAR_USBSTAR
	select USB_XHCI_HCD
	select USB_XHCI_DWC3
	select USB_XHCI_DWC3_OF_SIMPLE
	select SSTAR_USB_DWC3
	select SSTAR_USB_PHY
	default n
	help
	  cmd usbstar usb3.0 host
endmenu

config CMD_SSTAR_SPINAND
	bool "spinand"
	depends on SSTAR_NAND
	default n
	help
	  SigmaStar support copy data from the current Flash to another Flash

config CMD_SSTAR_FLASH_PROGRAMMER
	bool "flash_program"
	default n
	help
	  SigmaStar support flash programmer

config CMD_SSTAR_FLASH_AUTOK
	bool "flash_autok"
	default y
	help
	  SigmaStar support flash autok

config CMD_SSTAR_OTP
	bool "otpctrl/otpread"
	default y
	help
	  SigmaStar support write/read OTP.

config CMD_SSTAR_JPD
	bool "jpd"
	default n
	help
	  SigmaStar support decode JPEG.

config CMD_SSTAR_DISP
	bool "disp"
	default n
	help
	  SigmaStar support cmd disp

config CMD_SSTAR_RGN
	bool "rgn"
	default n
	help
	  SigmaStar support cmd rgn

config CMD_SSTAR_BOOTLOGO
	bool "bootlogo"
	default n
	help
	  SigmaStar support cmd bootlogo.

choice
	prompt "Bootlogo Parser mode"
	default SSTAR_BOOTLOGO_DTS_PARSER

config SSTAR_BOOTLOGO_CONFIGFILE_PARSER
	bool "CONFIGFILE"
	depends on SSTAR_CJSON_PARSER

config SSTAR_BOOTLOGO_DTS_PARSER
	bool "DTS"
	depends on SSTAR_CJSON_PARSER
endchoice

config SSTAR_BOOTLOGO_UT
	bool "Bootlogo UT support"
	depends on CMD_SSTAR_BOOTLOGO
	default n

config CMD_SSTAR_BOOT_AB
	bool "Boot ab support"
	default n

config CMD_SSTAR_RNDIS
	bool "rndis"
	default n
	help
	  SigmaStar support rndis command to initial USB ethernet RNDIS

config CMD_SSTAR_UFU
	bool "ufu"
	default n

config SSTAR_AUTOBOOT_RUN_UFU_ALWAYS
	bool "autoboot ufu always"
	depends on CMD_SSTAR_UFU
	default n
	help
	  Sigmastar force to run ufu command in autoboot

config SSTAR_AUTOBOOT_RUN_UFU_BY_GPIO
	bool "autoboot ufu by gpio"
	depends on CMD_SSTAR_UFU
	default n
	help
	  Sigmastar run ufu command in autoboot by gpio

config SSTAR_AUTOBOOT_RUN_UFU_BY_ENV
	bool "autoboot ufu by env(ota_upgrade_status)"
	depends on CMD_SSTAR_UFU
	default n
	help
	  Sigmastar run ufu command in autoboot by env

choice
	bool "UDC selection"
	depends on CMD_SSTAR_UFU || CMD_SSTAR_RNDIS
	default SSTAR_UDC_MSB250X

config SSTAR_UDC_MSB250X
	bool "USB2.0 port(msb250x)"
	select SSTAR_USB_GADGET_MSB250X
	help
	  sigmaster usb device controller msb250x

config SSTAR_UDC_DWC3
	bool "USB3.0 port(dwc3)"
	select SSTAR_USB_DWC3_GADGET

endchoice

config CMD_SSTAR_VENDOR
	bool "vendor partition"
	default n
	help
	  usb tool write vendor info
choice
	bool "vendor flash selection"
	depends on CMD_SSTAR_VENDOR
	default SSTAR_VENDOR_SPINAND

config SSTAR_VENDOR_SPINAND
	bool "spinand"
	help
	  vendor spinand

config SSTAR_VENDOR_SPINOR
	bool "spinor"
	help
	  vendor spinor

config SSTAR_VENDOR_EMMC
	bool "emmc"
	help
	  vendor emmc
endchoice

config CMD_SSTAR_ACM
        bool "acm"
	select USB_GADGET_DOWNLOAD
	select USB_FUNCTION_ACM
        default n
        help
          SigmaStar support cmd usb cdc acm

config CMD_SSTAR_SRCFG
	bool "srcfg"
	default n
	help
	  SigmaStar support cmd srcfg

config CMD_SSTAR_GMAC
	bool "gmac"
	default n
	help
	  SigmaStar gmac cmd

config CMD_SSTAR_PCIE
	bool "pcie"
	default n
	depends on SSTAR_PCIE_ENDPOINT
	help
	  SigmaStar PCIe endpoint cmd

config CMD_SSTAR_FWFS
	bool "fwfs"
	default n
	depends on FS_FIRMWAREFS
	help
	  SigmaStar firmware filesystem cmd

config CMD_SSTAR_PM
	bool "pm"
	default n
	help
	  Sigmastar power management cmd

config CMD_SSTAR_LOADOS
	bool "loados"
	default n
	help
	  SigmaStar support loados

config CMD_SSTAR_CHKOTP
	bool "chkotp"
	default n
	help
	  SigmaStar trim test

config CMD_SSTAR_CPUWAIT
	bool "cpuwait"
	default n
	help
	  SigmaStar cpu wait

config CMD_SSTAR_RTC
	bool "rtcpwc"
	default n
	help
	  Sigmastar rtcpwc cmd

config CMD_SSTAR_DDR_OTT
	bool "ddr_ott"
	default n
	help
	  SigmaStar ott(DDR one-time training) cmd

choice
	prompt "ddrtrain data locattion"
	depends on CMD_SSTAR_DDR_OTT
	default SSTAR_DDRTRAIN_INFO_STORE_IN_FIXED_BLOCK
	help
	  Specify ddrtrain data store location in boot
	  device.

config SSTAR_DDRTRAIN_INFO_STORE_IN_FIXED_BLOCK
	bool "fixed block offset"
	help
	  Select this to indicate that "ddrtrain_info" is store
	  in the specified fixed offset of the boot device, set
	  offset in SSTAR_DDRTRAIN_INFO_BLOCK_OFFSET.

config SSTAR_DDRTRAIN_INFO_STORE_IN_PARTITION
	bool "partition"
	help
	  Select this to indicate that "ddrtrain_info" is store
	  in the specified partition of the boot device, set
	  partition name in SSTAR_DDRTRAIN_INFO_PARTITION.

endchoice

config SSTAR_DDRTRAIN_INFO_BLOCK_OFFSET
	hex "block offset"
	depends on SSTAR_DDRTRAIN_INFO_STORE_IN_FIXED_BLOCK

config SSTAR_DDRTRAIN_INFO_PARTITION
	string "partition name"
	depends on SSTAR_DDRTRAIN_INFO_STORE_IN_PARTITION

endmenu
```

## boot/common/secureboot/Kconfig
```kconfig
menuconfig SSTAR_SIGN_IMAGES
	bool "SigmaStar sign images"
	default n
	help
	  enable this to sign bootloader.img

if SSTAR_SIGN_IMAGES
config SECURE_BOOT_DEBUG_MODE
	bool "secure boot debug mode"
	default n
	help
	  enable this to set debug flag to IPL for debug, it means that
	  Whether or not e-fuse is executed, the secure boot flow will
	  be performed.

config IPL_PRIVKEY_FILE
	string "sign IPL key"
	default "common/secureboot/default/private_otp_rsa2048.pem"
	help
	  specify the rsa private key path for signing IPL.bin

config IPLCUST_PUBKEY_FILE
	string "verify IPL_CUST key"
	default "common/secureboot/default/public_rsa2048.pem"
	help
	  specify the rsa public key path for verifing IPL_CUST.bin,
	  this public key will insert into IPL.bin

config IPLCUST_PRIVKEY_FILE
	string "sign IPL_CUST key"
	default "common/secureboot/default/private_rsa2048.pem"
	help
	  specify the rsa private key path for signing IPL_CUST.bin

config UBOOT_PUBKEY_FILE
	string "verify UBOOT key"
	default "common/secureboot/default/public_rsa2048.pem"
	help
	  specify the rsa public key path for verifing u-boot.*.img.bin,
	  this public key will insert into IPL_CUST.bin

config UBOOT_PRIVKEY_FILE
	string "sign U-boot key"
	default "common/secureboot/default/private_rsa2048.pem"
	help
	  specify the rsa private key path for signing u-boot.*.img.bin

endif
#endmenu SSTAR_SIGN_IMAGES
```

## boot/configs/iford_lh_defconfig
```kconfig
CONFIG_ARM=y
CONFIG_SYS_ARCH_TIMER=y
CONFIG_ARM_SMCCC=y
CONFIG_ARCH_SSTAR=y
CONFIG_SYS_TEXT_BASE=0x23E00000
CONFIG_NR_DRAM_BANKS=1
CONFIG_ENV_SIZE=0x1000
CONFIG_ENV_OFFSET=0x0
CONFIG_ENV_SECT_SIZE=0x1000
CONFIG_DM_GPIO=y
CONFIG_DEFAULT_DEVICE_TREE="iford"
# CONFIG_SSTAR_DISABLE_CODE_RELOC is not set
# CONFIG_SYS_MALLOC_F is not set
# CONFIG_EXPERT is not set
CONFIG_BOOTDELAY=0
# CONFIG_CMD_BDI is not set
# CONFIG_CMD_CONSOLE is not set
# CONFIG_CMD_BOOTD is not set
CONFIG_BOOTM_SS_RTOS=y
CONFIG_BOOTM_LINUX_NS=y
# CONFIG_BOOTM_NETBSD is not set
# CONFIG_BOOTM_PLAN9 is not set
# CONFIG_BOOTM_RTEMS is not set
# CONFIG_BOOTM_VXWORKS is not set
# CONFIG_CMD_ELF is not set
# CONFIG_CMD_FDT is not set
# CONFIG_CMD_IMI is not set
# CONFIG_CMD_XIMG is not set
# CONFIG_CMD_FLASH is not set
CONFIG_CMD_GPIO=y
CONFIG_CMD_PWM=y
# CONFIG_CMD_LOADB is not set
# CONFIG_CMD_LOADS is not set
CONFIG_CMD_WDT=y
# CONFIG_CMD_ECHO is not set
# CONFIG_CMD_ITEST is not set
# CONFIG_CMD_SOURCE is not set
# CONFIG_CMD_SETEXPR is not set
CONFIG_CMD_DHCP=y
# CONFIG_CMD_NFS is not set
CONFIG_CMD_MDIO=y
CONFIG_CMD_PING=y
CONFIG_CMD_CACHE=y
# CONFIG_CMD_DATE is not set
CONFIG_MP=y
CONFIG_CMD_MTDPARTS=y
CONFIG_CMD_SSTAR_ESTAR=y
CONFIG_CMD_SSTAR_RIU=y
CONFIG_CMD_SSTAR_DEBUG=y
CONFIG_CMD_SSTAR_MMC=y
CONFIG_CMD_SSTAR_MMC_FDISK=y
CONFIG_CMD_SSTAR_UFU=y
CONFIG_CMD_SSTAR_LOADOS=y
CONFIG_CMD_SSTAR_CPUWAIT=y
CONFIG_PARTITION_UUIDS=y
CONFIG_OF_CONTROL=y
CONFIG_ENV_IS_IN_SPI_FLASH=y
CONFIG_DM=y
CONFIG_DM_I2C=y
CONFIG_MTD=y
CONFIG_MTD_NOR_FLASH=y
CONFIG_PHYLIB=y
CONFIG_PHY_GIGE=y
CONFIG_PHY=y
CONFIG_DM_PWM=y
CONFIG_SPI=y
CONFIG_DM_SPI=y
CONFIG_USB=y
CONFIG_WATCHDOG_TIMEOUT_MSECS=2000
CONFIG_WDT=y
CONFIG_SSTAR_DRIVERS=y
CONFIG_SSTAR_CLK=y
CONFIG_SSTAR_PADMUX=y
CONFIG_SSTAR_EMAC=y
CONFIG_SSTAR_XZDEC=y
CONFIG_SSTAR_FSP_QSPI=y
CONFIG_SSTAR_FLASH=y
CONFIG_SSTAR_NOR=y
CONFIG_SSTAR_RTC=y
CONFIG_XZ=y
CONFIG_MZ=y
CONFIG_LZMA=y
# CONFIG_EFI_LOADER is not set
# CONFIG_TOOLS_LIBCRYPTO is not set
```
