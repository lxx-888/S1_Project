## boot/configs/infinity6f_ssm000a_s01a_fastboot_defconfig
```kconfig
CONFIG_ARM=y
CONFIG_SYS_ARCH_TIMER=y
CONFIG_ARM_SMCCC=y
CONFIG_ARCH_SSTAR=y
CONFIG_SYS_TEXT_BASE=0x23E00000
CONFIG_NR_DRAM_BANKS=1
CONFIG_ENV_SIZE=0x1000
CONFIG_ENV_OFFSET=0x0
CONFIG_ENV_SECT_SIZE=0x1000
CONFIG_DM_GPIO=y
CONFIG_DEFAULT_DEVICE_TREE="infinity6f-ssm000a-s01a"
CONFIG_SSTAR_BOOTING_PERF=y
# CONFIG_SSTAR_DISABLE_CODE_RELOC is not set
# CONFIG_SYS_MALLOC_F is not set
# CONFIG_EXPERT is not set
# CONFIG_ANDROID_BOOT_IMAGE is not set
CONFIG_BOOTDELAY=0
# CONFIG_CMD_BDI is not set
# CONFIG_CMD_CONSOLE is not set
# CONFIG_CMD_BOOTD is not set
# CONFIG_BOOTM_NETBSD is not set
# CONFIG_BOOTM_PLAN9 is not set
# CONFIG_BOOTM_RTEMS is not set
# CONFIG_BOOTM_VXWORKS is not set
# CONFIG_CMD_ELF is not set
# CONFIG_CMD_FDT is not set
# CONFIG_CMD_IMI is not set
# CONFIG_CMD_XIMG is not set
# CONFIG_CMD_FLASH is not set
CONFIG_CMD_GPIO=y
CONFIG_CMD_PWM=y
CONFIG_CMD_I2C=y
# CONFIG_CMD_LOADB is not set
# CONFIG_CMD_LOADS is not set
# CONFIG_CMD_ECHO is not set
# CONFIG_CMD_ITEST is not set
# CONFIG_CMD_SOURCE is not set
# CONFIG_CMD_SETEXPR is not set
CONFIG_CMD_DHCP=y
# CONFIG_CMD_NFS is not set
CONFIG_CMD_PING=y
CONFIG_CMD_CACHE=y
CONFIG_CMD_MTDPARTS=y
CONFIG_CMD_SSTAR_ESTAR=y
CONFIG_CMD_SSTAR_RIU=y
CONFIG_CMD_SSTAR_DEBUG=y
CONFIG_CMD_SSTAR_MMC=y
CONFIG_CMD_SSTAR_MMC_FDISK=y
CONFIG_CMD_SSTAR_SRCFG=y
CONFIG_PARTITION_UUIDS=y
CONFIG_OF_CONTROL=y
CONFIG_ENV_IS_IN_SPI_FLASH=y
CONFIG_DM=y
CONFIG_DEVRES=y
CONFIG_USB_FUNCTION_FASTBOOT=y
CONFIG_FASTBOOT_BUF_ADDR=0x21000000
CONFIG_FASTBOOT_FLASH=y
CONFIG_FASTBOOT_FLASH_SSTAR_CUS=y
CONFIG_FASTBOOT_SSTAR_CMDS=y
CONFIG_DM_I2C=y
CONFIG_MTD=y
CONFIG_MTD_NOR_FLASH=y
CONFIG_PHY_SSTAR=y
CONFIG_DM_PWM=y
CONFIG_SPI=y
CONFIG_DM_SPI=y
CONFIG_USB=y
CONFIG_USB_GADGET_VENDOR_NUM=0x18D1
CONFIG_USB_GADGET_PRODUCT_NUM=0x0D02
# CONFIG_WATCHDOG is not set
# CONFIG_WATCHDOG_AUTOSTART is not set
CONFIG_WATCHDOG_TIMEOUT_MSECS=2000
CONFIG_SSTAR_DRIVERS=y
# CONFIG_SSTAR_AESDMA is not set
CONFIG_SSTAR_CLK=y
CONFIG_SSTAR_IIC=y
CONFIG_SSTAR_PADMUX=y
CONFIG_SSTAR_GMAC=y
CONFIG_SSTAR_WDT=y
CONFIG_SSTAR_XZDEC=y
CONFIG_SSTAR_CAMDRIVER=y
CONFIG_SSTAR_VIF=y
CONFIG_SSTAR_FSP_QSPI=y
CONFIG_SSTAR_FLASH=y
CONFIG_SSTAR_NOR=y
CONFIG_SSTAR_USB_GADGET_MSB250X=y
CONFIG_XZ=y
CONFIG_MZ=y
CONFIG_LZMA=y
# CONFIG_EFI_LOADER is not set
# CONFIG_TOOLS_LIBCRYPTO is not set
```

## boot/configs/infinity6f_ssm000a_s01a_sdmmc_defconfig
```kconfig
CONFIG_ARM=y
CONFIG_SYS_ARCH_TIMER=y
CONFIG_ARM_SMCCC=y
CONFIG_ARCH_SSTAR=y
CONFIG_SYS_TEXT_BASE=0x23E00000
CONFIG_NR_DRAM_BANKS=1
CONFIG_ENV_SIZE=0x1000
CONFIG_ENV_OFFSET=0x4F000
CONFIG_DM_GPIO=y
CONFIG_DEFAULT_DEVICE_TREE="infinity6f-ssm000a-s01a"
CONFIG_SSTAR_BOOTING_PERF=y
CONFIG_SSTAR_ENV_PART_NAME=""
# CONFIG_SSTAR_DISABLE_CODE_RELOC is not set
# CONFIG_EXPERT is not set
CONFIG_BOOTDELAY=0
# CONFIG_CMD_BDI is not set
# CONFIG_CMD_CONSOLE is not set
# CONFIG_CMD_BOOTD is not set
# CONFIG_BOOTM_NETBSD is not set
# CONFIG_BOOTM_PLAN9 is not set
# CONFIG_BOOTM_RTEMS is not set
# CONFIG_BOOTM_VXWORKS is not set
# CONFIG_CMD_ELF is not set
# CONFIG_CMD_FDT is not set
# CONFIG_CMD_IMI is not set
# CONFIG_CMD_XIMG is not set
# CONFIG_CMD_FLASH is not set
CONFIG_CMD_GPIO=y
CONFIG_CMD_PWM=y
CONFIG_CMD_I2C=y
# CONFIG_CMD_LOADB is not set
# CONFIG_CMD_LOADS is not set
# CONFIG_CMD_ECHO is not set
# CONFIG_CMD_ITEST is not set
# CONFIG_CMD_SOURCE is not set
CONFIG_CMD_SETEXPR_FMT=y
CONFIG_CMD_DHCP=y
# CONFIG_CMD_NFS is not set
CONFIG_CMD_PING=y
CONFIG_CMD_CACHE=y
CONFIG_CMD_MTDPARTS=y
CONFIG_CMD_SSTAR_ESTAR=y
CONFIG_CMD_SSTAR_RIU=y
CONFIG_CMD_SSTAR_DEBUG=y
CONFIG_CMD_SSTAR_MMC=y
CONFIG_CMD_SSTAR_MMC_FDISK=y
CONFIG_CMD_SSTAR_UFU=y
CONFIG_SSTAR_AUTOBOOT_RUN_UFU_BY_ENV=y
CONFIG_CMD_SSTAR_SRCFG=y
CONFIG_CMD_SSTAR_LOADOS=y
CONFIG_PARTITION_UUIDS=y
CONFIG_OF_CONTROL=y
CONFIG_ENV_IS_IN_MMC=y
CONFIG_DM=y
CONFIG_DEVRES=y
CONFIG_DM_I2C=y
CONFIG_MTD=y
CONFIG_PHY_SSTAR=y
CONFIG_DM_PWM=y
CONFIG_SPECIFY_CONSOLE_INDEX=y
CONFIG_DM_SERIAL=y
CONFIG_SPI=y
CONFIG_DM_SPI=y
CONFIG_USB=y
# CONFIG_WATCHDOG is not set
# CONFIG_WATCHDOG_AUTOSTART is not set
CONFIG_WATCHDOG_TIMEOUT_MSECS=2000
CONFIG_SSTAR_DRIVERS=y
CONFIG_SSTAR_CLK=y
CONFIG_SSTAR_IIC=y
CONFIG_SSTAR_PADMUX=y
CONFIG_SSTAR_GMAC=y
CONFIG_SSTAR_WDT=y
CONFIG_SSTAR_XZDEC=y
CONFIG_SSTAR_CAMDRIVER=y
CONFIG_SSTAR_VIF=y
CONFIG_SSTAR_FSP_QSPI=y
CONFIG_SSTAR_FLASH=y
CONFIG_XZ=y
CONFIG_MZ=y
CONFIG_LZMA=y
# CONFIG_EFI_LOADER is not set
# CONFIG_TOOLS_LIBCRYPTO is not set
```

## boot/configs/infinity6f_ssm000c_s01a_spinand_defconfig
```kconfig
CONFIG_ARM=y
CONFIG_SYS_ARCH_TIMER=y
CONFIG_ARM_SMCCC=y
CONFIG_ARCH_SSTAR=y
CONFIG_SYS_TEXT_BASE=0x23E00000
CONFIG_NR_DRAM_BANKS=1
CONFIG_ENV_SIZE=0x1000
CONFIG_ENV_OFFSET=0x0
CONFIG_DM_GPIO=y
CONFIG_DEFAULT_DEVICE_TREE="infinity6f-ssm000c-s01a"
CONFIG_SSTAR_BOOTING_PERF=y
CONFIG_SSTAR_USE_TOOLCHAIN_DEFAULT_FLOAT_ABI=y
# CONFIG_SSTAR_DISABLE_CODE_RELOC is not set
# CONFIG_EXPERT is not set
CONFIG_BOOTDELAY=0
# CONFIG_CMD_BDI is not set
# CONFIG_CMD_CONSOLE is not set
# CONFIG_CMD_BOOTD is not set
# CONFIG_BOOTM_NETBSD is not set
# CONFIG_BOOTM_PLAN9 is not set
# CONFIG_BOOTM_RTEMS is not set
# CONFIG_BOOTM_VXWORKS is not set
# CONFIG_CMD_ELF is not set
# CONFIG_CMD_FDT is not set
# CONFIG_CMD_IMI is not set
# CONFIG_CMD_XIMG is not set
# CONFIG_CMD_FLASH is not set
CONFIG_CMD_GPIO=y
CONFIG_CMD_PWM=y
CONFIG_CMD_I2C=y
# CONFIG_CMD_LOADB is not set
# CONFIG_CMD_LOADS is not set
CONFIG_CMD_NAND=y
# CONFIG_CMD_ECHO is not set
# CONFIG_CMD_ITEST is not set
# CONFIG_CMD_SOURCE is not set
# CONFIG_CMD_SETEXPR is not set
CONFIG_CMD_DHCP=y
# CONFIG_CMD_NFS is not set
CONFIG_CMD_PING=y
CONFIG_CMD_CACHE=y
CONFIG_CMD_MTDPARTS=y
CONFIG_CMD_UBI=y
CONFIG_CMD_SSTAR_ESTAR=y
CONFIG_CMD_SSTAR_RIU=y
CONFIG_CMD_SSTAR_DEBUG=y
CONFIG_CMD_SSTAR_MMC=y
CONFIG_CMD_SSTAR_MMC_FDISK=y
CONFIG_CMD_SSTAR_UFU=y
CONFIG_CMD_SSTAR_SRCFG=y
CONFIG_CMD_SSTAR_LOADOS=y
CONFIG_PARTITION_UUIDS=y
CONFIG_OF_CONTROL=y
CONFIG_ENV_IS_IN_NAND=y
CONFIG_DM=y
CONFIG_DEVRES=y
CONFIG_DM_I2C=y
CONFIG_MTD=y
CONFIG_MTD_RAW_NAND=y
CONFIG_PHY_SSTAR=y
CONFIG_DM_PWM=y
CONFIG_SPECIFY_CONSOLE_INDEX=y
CONFIG_DM_SERIAL=y
CONFIG_SPI=y
CONFIG_DM_SPI=y
CONFIG_USB=y
# CONFIG_WATCHDOG is not set
# CONFIG_WATCHDOG_AUTOSTART is not set
CONFIG_WATCHDOG_TIMEOUT_MSECS=2000
CONFIG_SSTAR_DRIVERS=y
CONFIG_SSTAR_CLK=y
CONFIG_SSTAR_IIC=y
CONFIG_SSTAR_PADMUX=y
CONFIG_SSTAR_GMAC=y
CONFIG_SSTAR_IMAGE_POSTFIX="_spinand"
CONFIG_SSTAR_WDT=y
CONFIG_SSTAR_XZDEC=y
CONFIG_SSTAR_CAMDRIVER=y
CONFIG_SSTAR_VIF=y
CONFIG_SSTAR_FSP_QSPI=y
CONFIG_SSTAR_FLASH=y
CONFIG_SSTAR_NAND=y
CONFIG_XZ=y
CONFIG_MZ=y
CONFIG_LZMA=y
# CONFIG_EFI_LOADER is not set
# CONFIG_TOOLS_LIBCRYPTO is not set
```

## boot/configs/infinity7_android_defconfig
```kconfig
CONFIG_ARM=y
# CONFIG_STATIC_RELA is not set
CONFIG_SYS_ARM_MMU=y
# CONFIG_SYS_ARCH_TIMER is not set
CONFIG_ARCH_SSTAR=y
CONFIG_SYS_TEXT_BASE=0x2FE00000
CONFIG_SYS_MALLOC_F_LEN=0x8000
CONFIG_NR_DRAM_BANKS=1
CONFIG_ENV_SIZE=0x1000
CONFIG_ENV_OFFSET=0x4F000
CONFIG_DM_GPIO=y
CONFIG_DEFAULT_DEVICE_TREE="infinity7"
CONFIG_SSTAR_ARM64=y
# CONFIG_SSTAR_BUILTIN_KERNEL_DTB is not set
CONFIG_SSTAR_KERNEL_ADDR_OFFSET=0xFE0000000
CONFIG_SSTAR_DISABLE_FIXUP_DTB_MEMORY_NODE=y
CONFIG_SSTAR_UBOOT_DTB_OVERLAY=y
CONFIG_SSTAR_KERNEL_DTB_OVERLAY=y
# CONFIG_PSCI_RESET is not set
# CONFIG_EXPERT is not set
CONFIG_SUPPORT_RAW_INITRD=y
CONFIG_BOOTDELAY=0
CONFIG_ANDROID_BOOTLOADER=y
CONFIG_ANDROID_USES_RECOVERY_AS_BOOT=y
CONFIG_AVB_VERIFY=y
CONFIG_ANDROID_AB=y
# CONFIG_CMD_BDI is not set
# CONFIG_CMD_CONSOLE is not set
# CONFIG_CMD_BOOTD is not set
# CONFIG_BOOTM_NETBSD is not set
# CONFIG_BOOTM_PLAN9 is not set
# CONFIG_BOOTM_RTEMS is not set
# CONFIG_BOOTM_VXWORKS is not set
# CONFIG_CMD_BOOTEFI is not set
# CONFIG_CMD_ELF is not set
# CONFIG_CMD_RUN is not set
# CONFIG_CMD_IMI is not set
# CONFIG_CMD_XIMG is not set
# CONFIG_CMD_EDITENV is not set
CONFIG_CMD_ERASEENV=y
# CONFIG_CMD_LZMADEC is not set
# CONFIG_CMD_UNLZ4 is not set
# CONFIG_CMD_UNZIP is not set
CONFIG_CMD_BCB=y
CONFIG_CMD_CLK=y
CONFIG_CMD_DM=y
CONFIG_CMD_GPIO=y
CONFIG_CMD_GPT=y
CONFIG_CMD_GPT_RENAME=y
CONFIG_CMD_I2C=y
# CONFIG_CMD_LOADB is not set
# CONFIG_CMD_LOADS is not set
CONFIG_CMD_BKOPS_ENABLE=y
CONFIG_CMD_MMC_SWRITE=y
CONFIG_CMD_PCI=y
# CONFIG_CMD_ECHO is not set
# CONFIG_CMD_ITEST is not set
# CONFIG_CMD_SOURCE is not set
CONFIG_CMD_AB_SELECT=y
CONFIG_CMD_BOOT_ANDROID=y
CONFIG_CMD_PING=y
CONFIG_CMD_CACHE=y
CONFIG_CMD_EXT4=y
CONFIG_CMD_EXT4_WRITE=y
CONFIG_CMD_FAT=y
CONFIG_CMD_SSTAR_AB_RESET=y
CONFIG_CMD_SSTAR_ESTAR=y
CONFIG_CMD_SSTAR_UART=y
CONFIG_CMD_SSTAR_RIU=y
CONFIG_CMD_SSTAR_DEBUG=y
CONFIG_CMD_SSTAR_MMC=y
CONFIG_OF_CONTROL=y
CONFIG_ENV_IS_IN_MMC=y
CONFIG_DM=y
# CONFIG_DM_WARN is not set
# CONFIG_DM_DEVICE_REMOVE is not set
CONFIG_USB_FUNCTION_FASTBOOT=y
CONFIG_FASTBOOT_BUF_ADDR=0x30000000
CONFIG_FASTBOOT_BUF_SIZE=0x10000000
CONFIG_FASTBOOT_FLASH=y
CONFIG_FASTBOOT_SSTAR_CMDS=y
CONFIG_FASTBOOT_SSTAR_GETVAR=y
CONFIG_DM_I2C=y
CONFIG_SPECIFY_CONSOLE_INDEX=y
CONFIG_CONS_INDEX=0
CONFIG_DM_SERIAL=y
CONFIG_SERIAL_PROBE_ALL=y
CONFIG_USB_GADGET_VENDOR_NUM=0x18D1
CONFIG_USB_GADGET_PRODUCT_NUM=0x0D02
CONFIG_SSTAR_DRIVERS=y
CONFIG_SSTAR_CLK=y
CONFIG_SSTAR_IIC=y
CONFIG_SSTAR_PADMUX=y
CONFIG_SSTAR_PWM=y
CONFIG_SSTAR_GMAC=y
CONFIG_SSTAR_IMAGE_POSTFIX="64_emmc"
# CONFIG_SSTAR_FORCE_IGNORE_ACCESS_WARN is not set
CONFIG_SSTAR_PCIE=y
CONFIG_SSTAR_USB_DWC3=y
CONFIG_SSTAR_USB_DWC3_GADGET=y
CONFIG_SSTAR_USB_PHY=y
CONFIG_LIBAVB=y
CONFIG_XBC=y
CONFIG_MZ=y
CONFIG_LZMA=y
CONFIG_ZLIB_UNCOMPRESS=y
```

## boot/configs/infinity7_emmc_nor_defconfig
```kconfig
CONFIG_ARM=y
CONFIG_ARCH_SSTAR=y
CONFIG_SYS_TEXT_BASE=0x27E00000
CONFIG_SYS_MALLOC_F_LEN=0x8000
CONFIG_NR_DRAM_BANKS=1
CONFIG_ENV_OFFSET=0x4F000
CONFIG_DM_GPIO=y
CONFIG_DEFAULT_DEVICE_TREE="infinity7"
CONFIG_SSTAR_RAM_SIZE=0x08000000
# CONFIG_EXPERT is not set
CONFIG_BOOTDELAY=0
# CONFIG_CMD_BDI is not set
# CONFIG_CMD_CONSOLE is not set
# CONFIG_CMD_BOOTD is not set
# CONFIG_BOOTM_NETBSD is not set
# CONFIG_BOOTM_PLAN9 is not set
# CONFIG_BOOTM_RTEMS is not set
# CONFIG_BOOTM_VXWORKS is not set
# CONFIG_CMD_BOOTEFI is not set
# CONFIG_CMD_ELF is not set
# CONFIG_CMD_FDT is not set
# CONFIG_CMD_RUN is not set
# CONFIG_CMD_IMI is not set
# CONFIG_CMD_XIMG is not set
# CONFIG_CMD_EDITENV is not set
CONFIG_CMD_ERASEENV=y
# CONFIG_CMD_FLASH is not set
CONFIG_CMD_GPIO=y
CONFIG_CMD_I2C=y
# CONFIG_CMD_LOADB is not set
# CONFIG_CMD_LOADS is not set
CONFIG_CMD_BKOPS_ENABLE=y
CONFIG_CMD_MMC_SWRITE=y
# CONFIG_CMD_ECHO is not set
# CONFIG_CMD_ITEST is not set
# CONFIG_CMD_SOURCE is not set
CONFIG_CMD_PING=y
CONFIG_CMD_CACHE=y
CONFIG_CMD_FAT=y
CONFIG_CMD_SSTAR_ESTAR=y
CONFIG_CMD_SSTAR_UART=y
CONFIG_CMD_SSTAR_RIU=y
CONFIG_CMD_SSTAR_DEBUG=y
CONFIG_CMD_SSTAR_MMC=y
CONFIG_OF_CONTROL=y
CONFIG_ENV_IS_IN_MMC=y
CONFIG_DM=y
# CONFIG_DM_WARN is not set
# CONFIG_DM_DEVICE_REMOVE is not set
CONFIG_DM_I2C=y
CONFIG_MTD=y
CONFIG_MTD_NOR_FLASH=y
CONFIG_SPECIFY_CONSOLE_INDEX=y
CONFIG_CONS_INDEX=0
CONFIG_DM_SERIAL=y
CONFIG_SERIAL_PROBE_ALL=y
CONFIG_SSTAR_DRIVERS=y
CONFIG_SSTAR_CLK=y
CONFIG_SSTAR_IIC=y
CONFIG_SSTAR_PADMUX=y
CONFIG_SSTAR_PWM=y
CONFIG_SSTAR_GMAC=y
CONFIG_SSTAR_IMAGE_POSTFIX="_emmc"
# CONFIG_SSTAR_FORCE_IGNORE_ACCESS_WARN is not set
CONFIG_SSTAR_FLASH=y
CONFIG_SSTAR_NOR=y
CONFIG_MZ=y
CONFIG_LZMA=y
```

## boot/configs/infinity7_spinand_bootlogo_defconfig
```kconfig
CONFIG_ARM=y
CONFIG_ARCH_SSTAR=y
CONFIG_SYS_TEXT_BASE=0x2FE00000
CONFIG_SYS_MALLOC_F_LEN=0x8000
CONFIG_NR_DRAM_BANKS=1
CONFIG_ENV_OFFSET=0x0
CONFIG_DM_GPIO=y
CONFIG_DEFAULT_DEVICE_TREE="infinity7"
# CONFIG_EXPERT is not set
CONFIG_BOOTDELAY=0
# CONFIG_CMD_BDI is not set
# CONFIG_CMD_CONSOLE is not set
# CONFIG_CMD_BOOTD is not set
# CONFIG_BOOTM_NETBSD is not set
# CONFIG_BOOTM_PLAN9 is not set
# CONFIG_BOOTM_RTEMS is not set
# CONFIG_BOOTM_VXWORKS is not set
# CONFIG_CMD_ELF is not set
# CONFIG_CMD_FDT is not set
# CONFIG_CMD_RUN is not set
# CONFIG_CMD_IMI is not set
# CONFIG_CMD_XIMG is not set
# CONFIG_CMD_FLASH is not set
CONFIG_CMD_GPIO=y
CONFIG_CMD_I2C=y
# CONFIG_CMD_LOADB is not set
# CONFIG_CMD_LOADS is not set
CONFIG_CMD_NAND=y
# CONFIG_CMD_ECHO is not set
# CONFIG_CMD_ITEST is not set
# CONFIG_CMD_SOURCE is not set
# CONFIG_CMD_SETEXPR is not set
CONFIG_CMD_DHCP=y
CONFIG_CMD_PING=y
CONFIG_CMD_CACHE=y
CONFIG_CMD_MTDPARTS=y
CONFIG_CMD_UBI=y
CONFIG_CMD_SSTAR_ESTAR=y
CONFIG_CMD_SSTAR_UART=y
CONFIG_CMD_SSTAR_RIU=y
CONFIG_CMD_SSTAR_DEBUG=y
CONFIG_OF_CONTROL=y
CONFIG_ENV_IS_IN_NAND=y
CONFIG_DM=y
# CONFIG_DM_WARN is not set
# CONFIG_DM_DEVICE_REMOVE is not set
CONFIG_BLK=y
CONFIG_DM_I2C=y
# CONFIG_MMC is not set
CONFIG_MTD=y
CONFIG_MTD_RAW_NAND=y
CONFIG_SPECIFY_CONSOLE_INDEX=y
CONFIG_CONS_INDEX=0
CONFIG_DM_SERIAL=y
CONFIG_SERIAL_PROBE_ALL=y
CONFIG_SSTAR_DRIVERS=y
CONFIG_SSTAR_CLK=y
CONFIG_SSTAR_IIC=y
CONFIG_SSTAR_PADMUX=y
CONFIG_SSTAR_PWM=y
CONFIG_SSTAR_GMAC=y
CONFIG_SSTAR_IMAGE_POSTFIX="_spinand"
CONFIG_SSTAR_DISP_HDMITX_VGA=y
CONFIG_SSTAR_UPGRADE_UI=y
CONFIG_SSTAR_UPGRADE_UI_DRAW_YUV=y
CONFIG_SSTAR_CJSON_PARSER=y
# CONFIG_SSTAR_FORCE_IGNORE_ACCESS_WARN is not set
CONFIG_SSTAR_CAMDRIVER=y
CONFIG_SSTAR_DISP=y
CONFIG_SSTAR_HDMITX=y
CONFIG_SSTAR_PNL=y
CONFIG_SSTAR_JPD=y
CONFIG_JPD_HW=y
CONFIG_SSTAR_FLASH=y
CONFIG_SSTAR_NAND=y
CONFIG_FS_FIRMWAREFS=y
CONFIG_MZ=y
CONFIG_LZMA=y
```

## boot/configs/pioneer5_64_spinand_defconfig
```kconfig
CONFIG_ARM=y
# CONFIG_STATIC_RELA is not set
CONFIG_SYS_ARM_MMU=y
# CONFIG_SYS_ARCH_TIMER is not set
CONFIG_ARCH_SSTAR=y
CONFIG_SYS_TEXT_BASE=0x27E00000
CONFIG_NR_DRAM_BANKS=1
CONFIG_ENV_SIZE=0x1000
CONFIG_ENV_OFFSET=0x0
CONFIG_DM_GPIO=y
CONFIG_DEFAULT_DEVICE_TREE="pioneer5-ssc028a-s01a-s"
CONFIG_SSTAR_ARM64=y
CONFIG_SSTAR_KERNEL_ADDR_OFFSET=0xFE0000000
CONFIG_SSTAR_RAM_SIZE=0x08000000
CONFIG_SSTAR_USE_TOOLCHAIN_DEFAULT_FLOAT_ABI=y
# CONFIG_SYS_MALLOC_F is not set
# CONFIG_EXPERT is not set
CONFIG_BOOTDELAY=0
# CONFIG_CMD_BDI is not set
# CONFIG_CMD_CONSOLE is not set
# CONFIG_CMD_BOOTD is not set
# CONFIG_BOOTM_NETBSD is not set
# CONFIG_BOOTM_PLAN9 is not set
# CONFIG_BOOTM_RTEMS is not set
# CONFIG_BOOTM_VXWORKS is not set
# CONFIG_CMD_ELF is not set
# CONFIG_CMD_FDT is not set
# CONFIG_CMD_IMI is not set
# CONFIG_CMD_XIMG is not set
# CONFIG_CMD_LZMADEC is not set
# CONFIG_CMD_UNLZ4 is not set
# CONFIG_CMD_UNZIP is not set
# CONFIG_CMD_FLASH is not set
CONFIG_CMD_GPIO=y
CONFIG_CMD_PWM=y
# CONFIG_CMD_LOADB is not set
# CONFIG_CMD_LOADS is not set
CONFIG_CMD_NAND=y
CONFIG_CMD_WDT=y
# CONFIG_CMD_ECHO is not set
# CONFIG_CMD_ITEST is not set
# CONFIG_CMD_SOURCE is not set
# CONFIG_CMD_SETEXPR is not set
CONFIG_CMD_DHCP=y
# CONFIG_CMD_NFS is not set
CONFIG_CMD_PING=y
CONFIG_CMD_CACHE=y
CONFIG_CMD_MTDPARTS=y
CONFIG_CMD_UBI=y
CONFIG_CMD_SSTAR_ESTAR=y
CONFIG_CMD_SSTAR_RIU=y
CONFIG_CMD_SSTAR_DEBUG=y
CONFIG_CMD_SSTAR_MMC=y
CONFIG_CMD_SSTAR_MMC_FDISK=y
CONFIG_PARTITION_UUIDS=y
CONFIG_OF_CONTROL=y
CONFIG_ENV_IS_IN_NAND=y
CONFIG_DM=y
CONFIG_CLK=y
CONFIG_CLK_CCF=y
CONFIG_CLK_COMPOSITE_CCF=y
CONFIG_DM_I2C=y
CONFIG_MTD=y
CONFIG_MTD_RAW_NAND=y
CONFIG_PHY_SSTAR=y
CONFIG_DM_PWM=y
CONFIG_SPI=y
CONFIG_DM_SPI=y
CONFIG_USB=y
CONFIG_WATCHDOG_TIMEOUT_MSECS=2000
CONFIG_WDT=y
CONFIG_SSTAR_DRIVERS=y
CONFIG_SSTAR_PADMUX=y
CONFIG_SSTAR_GMAC=y
CONFIG_SSTAR_IMAGE_POSTFIX="_spinand"
CONFIG_SSTAR_FLASH=y
CONFIG_SSTAR_NAND=y
CONFIG_XZ=y
CONFIG_MZ=y
# CONFIG_EFI_LOADER is not set
```
