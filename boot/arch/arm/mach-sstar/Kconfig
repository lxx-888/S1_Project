## boot/configs/pioneer5_android_fpga_defconfig
```kconfig
CONFIG_ARM=y
CONFIG_ARM_SMCCC=y
CONFIG_ARCH_SSTAR=y
CONFIG_SYS_TEXT_BASE=0x2FE00000
CONFIG_NR_DRAM_BANKS=1
CONFIG_ENV_SIZE=0x1000
CONFIG_ENV_OFFSET=0x0
CONFIG_DM_GPIO=y
CONFIG_DEFAULT_DEVICE_TREE="pioneer5-ssc028a-s01a-s"
CONFIG_SSTAR_VERSION_FPGA=y
# CONFIG_SSTAR_BUILTIN_KERNEL_DTB is not set
CONFIG_SSTAR_KERNEL_ADDR_OFFSET=0xFE0000000
CONFIG_SSTAR_DISABLE_FIXUP_DTB_MEMORY_NODE=y
CONFIG_SSTAR_USE_TOOLCHAIN_DEFAULT_FLOAT_ABI=y
# CONFIG_SYS_MALLOC_F is not set
# CONFIG_EXPERT is not set
CONFIG_SUPPORT_RAW_INITRD=y
CONFIG_BOOTDELAY=0
CONFIG_ANDROID_BOOTLOADER=y
CONFIG_ANDROID_USES_RECOVERY_AS_BOOT=y
CONFIG_AVB_VERIFY=y
CONFIG_ANDROID_AB=y
# CONFIG_CMD_BDI is not set
# CONFIG_CMD_CONSOLE is not set
# CONFIG_CMD_BOOTD is not set
# CONFIG_BOOTM_NETBSD is not set
# CONFIG_BOOTM_PLAN9 is not set
# CONFIG_BOOTM_RTEMS is not set
# CONFIG_BOOTM_VXWORKS is not set
# CONFIG_CMD_ELF is not set
# CONFIG_CMD_FDT is not set
# CONFIG_CMD_IMI is not set
# CONFIG_CMD_XIMG is not set
CONFIG_CMD_BCB=y
# CONFIG_CMD_FLASH is not set
CONFIG_CMD_GPIO=y
CONFIG_CMD_PWM=y
CONFIG_RANDOM_UUID=y
# CONFIG_CMD_LOADB is not set
# CONFIG_CMD_LOADS is not set
CONFIG_CMD_MMC=y
CONFIG_CMD_WDT=y
# CONFIG_CMD_ECHO is not set
# CONFIG_CMD_ITEST is not set
# CONFIG_CMD_SOURCE is not set
# CONFIG_CMD_SETEXPR is not set
CONFIG_CMD_AB_SELECT=y
CONFIG_CMD_BOOT_ANDROID=y
CONFIG_CMD_DHCP=y
# CONFIG_CMD_NFS is not set
CONFIG_CMD_PING=y
CONFIG_CMD_CACHE=y
CONFIG_CMD_EXT4=y
CONFIG_CMD_EXT4_WRITE=y
CONFIG_CMD_MTDPARTS=y
CONFIG_CMD_SSTAR_AB_RESET=y
CONFIG_CMD_SSTAR_ESTAR=y
CONFIG_CMD_SSTAR_RIU=y
CONFIG_CMD_SSTAR_DEBUG=y
CONFIG_EFI_PARTITION=y
CONFIG_OF_CONTROL=y
CONFIG_ENV_IS_IN_MMC=y
CONFIG_DM=y
CONFIG_CLK=y
CONFIG_CLK_CCF=y
CONFIG_CLK_COMPOSITE_CCF=y
CONFIG_USB_FUNCTION_FASTBOOT=y
CONFIG_UDP_FUNCTION_FASTBOOT=y
CONFIG_FASTBOOT_BUF_ADDR=0x30000000
CONFIG_FASTBOOT_BUF_SIZE=0x10000000
CONFIG_FASTBOOT_FLASH=y
CONFIG_FASTBOOT_SSTAR_CMDS=y
CONFIG_FASTBOOT_SSTAR_GETVAR=y
CONFIG_DM_I2C=y
CONFIG_MTD=y
CONFIG_MTD_NOR_FLASH=y
CONFIG_DM_PWM=y
CONFIG_SPI=y
CONFIG_DM_SPI=y
CONFIG_USB=y
CONFIG_USB_GADGET_VENDOR_NUM=0x18D1
CONFIG_USB_GADGET_PRODUCT_NUM=0x0D02
CONFIG_WATCHDOG_TIMEOUT_MSECS=2000
CONFIG_WDT=y
CONFIG_SSTAR_DRIVERS=y
# CONFIG_SSTAR_AESDMA is not set
CONFIG_SSTAR_MMC_HOST=y
CONFIG_SSTAR_PADMUX=y
CONFIG_SSTAR_GMAC=y
CONFIG_SSTAR_FLASH=y
CONFIG_SSTAR_NOR=y
CONFIG_SSTAR_USB_GADGET_MSB250X=y
CONFIG_USB_FPGA_VERIFICATION=y
CONFIG_LIBAVB=y
CONFIG_XBC=y
CONFIG_XZ=y
CONFIG_MZ=y
CONFIG_LZMA=y
CONFIG_ZLIB_UNCOMPRESS=y
# CONFIG_EFI_LOADER is not set
```

## boot/configs/pioneer5_android_ut_fpga_defconfig
```kconfig
CONFIG_ARM=y
CONFIG_ARM_SMCCC=y
CONFIG_ARCH_SSTAR=y
CONFIG_SYS_TEXT_BASE=0x2FE00000
CONFIG_NR_DRAM_BANKS=1
CONFIG_ENV_SIZE=0x1000
CONFIG_ENV_OFFSET=0x0
CONFIG_DM_GPIO=y
CONFIG_DEFAULT_DEVICE_TREE="pioneer5-ssc028a-s01a-s"
CONFIG_SSTAR_VERSION_FPGA=y
CONFIG_SSTAR_KERNEL_ADDR_OFFSET=0xFE0000000
CONFIG_SSTAR_USE_TOOLCHAIN_DEFAULT_FLOAT_ABI=y
# CONFIG_SYS_MALLOC_F is not set
# CONFIG_EXPERT is not set
CONFIG_BOOTDELAY=0
# CONFIG_CMD_BDI is not set
# CONFIG_CMD_CONSOLE is not set
# CONFIG_CMD_BOOTD is not set
# CONFIG_BOOTM_NETBSD is not set
# CONFIG_BOOTM_PLAN9 is not set
# CONFIG_BOOTM_RTEMS is not set
# CONFIG_BOOTM_VXWORKS is not set
# CONFIG_CMD_ELF is not set
# CONFIG_CMD_FDT is not set
# CONFIG_CMD_IMI is not set
# CONFIG_CMD_XIMG is not set
CONFIG_CMD_BCB=y
# CONFIG_CMD_FLASH is not set
CONFIG_CMD_GPIO=y
CONFIG_CMD_PWM=y
# CONFIG_CMD_LOADB is not set
# CONFIG_CMD_LOADS is not set
CONFIG_CMD_MMC=y
CONFIG_CMD_WDT=y
# CONFIG_CMD_ECHO is not set
# CONFIG_CMD_ITEST is not set
# CONFIG_CMD_SOURCE is not set
# CONFIG_CMD_SETEXPR is not set
CONFIG_CMD_DHCP=y
# CONFIG_CMD_NFS is not set
CONFIG_CMD_MDIO=y
CONFIG_CMD_PING=y
CONFIG_CMD_CACHE=y
CONFIG_CMD_MTDPARTS=y
CONFIG_CMD_SSTAR_ESTAR=y
CONFIG_CMD_SSTAR_RIU=y
CONFIG_CMD_SSTAR_DEBUG=y
CONFIG_EFI_PARTITION=y
CONFIG_OF_CONTROL=y
CONFIG_ENV_IS_IN_MMC=y
CONFIG_DM=y
CONFIG_CLK=y
CONFIG_CLK_CCF=y
CONFIG_CLK_COMPOSITE_CCF=y
CONFIG_DM_I2C=y
CONFIG_MTD=y
CONFIG_MTD_NOR_FLASH=y
CONFIG_PHYLIB=y
CONFIG_PHY_FIXED=y
CONFIG_DM_ETH=y
CONFIG_PHY_GIGE=y
CONFIG_PHY=y
CONFIG_DM_PWM=y
CONFIG_SPI=y
CONFIG_DM_SPI=y
CONFIG_USB=y
CONFIG_USB_GADGET_VENDOR_NUM=0x18D1
CONFIG_USB_GADGET_PRODUCT_NUM=0x0D02
CONFIG_USB_GADGET_DOWNLOAD=y
CONFIG_WATCHDOG_TIMEOUT_MSECS=2000
CONFIG_WDT=y
CONFIG_SSTAR_DRIVERS=y
# CONFIG_SSTAR_AESDMA is not set
CONFIG_SSTAR_MMC_HOST=y
CONFIG_SSTAR_PADMUX=y
CONFIG_SSTAR_FLASH=y
CONFIG_SSTAR_NOR=y
CONFIG_SSTAR_USB_GADGET_MSB250X=y
CONFIG_USB_FPGA_VERIFICATION=y
CONFIG_XZ=y
CONFIG_MZ=y
CONFIG_LZMA=y
# CONFIG_EFI_LOADER is not set
```

## boot/drivers/sstar/Kconfig
```kconfig
config SSTAR_AESDMA
	bool "SigmaStar AESDMA"
	default y

config SSTAR_AIO
	bool "SigmaStar AIO"
	default n

config SSTAR_BDMA
	bool "Sigmastar BDMA"
	default y

config SSTAR_CLK
	bool "SigmaStar clock support"
	select CLK
	select CLK_CCF
	select CLK_COMPOSITE_CCF

config PM_CLK_SRC_24M
	bool "Supports the removal of the RTC 32K crystal oscillator"
	default n

config SSTAR_MMC_HOST
	bool 'SigmaStar mmc host'
	select MMC
	select SUPPORT_EMMC_BOOT

config SSTAR_SELECT_EMMC
	bool "SELECT EMMC"
	depends on SSTAR_MMC_HOST
	default n

config SSTAR_SUPPORT_SDIO
	bool 'Support SDIO driver'
	depends on SSTAR_MMC_HOST
	default n

config SSTAR_GPIO
	bool 'SigmaStar GPIO'
	default y

config SSTAR_IIC
	bool 'SigmaStar IIC'
	depends on DM_I2C

config SSTAR_MSPI
	bool 'SigmaStar MSPI'
	depends on DM_SPI


config SSTAR_PADMUX
	bool 'SigmaStar padmux'
	depends on DM && SSTAR_GPIO

config SSTAR_PWM
	bool 'SigmaStar PWM'
	select DM_PWM
	select CMD_PWM
	default n

config SSTAR_PWM_EXTEND
	bool "Support high precision calculation"
	depends on SSTAR_PWM
	default y
	help
	  support a wider range of parameter settings

config SSTAR_ADCLP
	bool "SigmaStar ADCLP"
	select CONFIG_ADC
	select CONFIG_CMD_ADC
	default n

config SSTAR_EMAC
	select CMD_NET
	select NET
	bool 'SigmaStar EMAC'

config SSTAR_EMAC1
	bool "EMAC 1"
	depends on SSTAR_EMAC

menu "SSTAR GMAC"
config SSTAR_GMAC
	select CMD_NET
	select NET
	select NETDEVICES
	select DM_ETH
	select PHY_GIGE
	select PHY
	select PHY_FIXED
	select DWC_ETH_QOS
	select CMD_MDIO
	select CMD_SSTAR_GMAC
	select CONFIG_CMD_PING
	bool 'SigmaStar GMAC'

config MOTORCOMM_PHY
	bool 'MOTORCOMM PHY'

config SSTAR_GMAC_DISABLE_TX_FCTL
	bool 'Disable flow control'
	depends on SSTAR_GMAC
	default y

config SSTAR_SNPS_GMAC_RXCTL_PATCH
	depends on SSTAR_GMAC
	bool "SSTAR_SNPS_GMAC_RXCTL_PATCH"
	default y
	help
		SSTAR GMAC RXCTL patch

choice
	prompt "GMAC_RGMII0_TXC_PHASE_100M_DEGREE"
	depends on SSTAR_GMAC
	default GMAC_RGMII0_TXC_PHASE_100M_DEGREE_0
config GMAC_RGMII0_TXC_PHASE_100M_DEGREE_0
	bool "DEGREE 0"
config GMAC_RGMII0_TXC_PHASE_100M_DEGREE_90
	bool "DEGREE 90"
config GMAC_RGMII0_TXC_PHASE_100M_DEGREE_180
	bool "DEGREE 180"
config GMAC_RGMII0_TXC_PHASE_100M_DEGREE_270
	bool "DEGREE 270"
endchoice

choice
	prompt "GMAC_RGMII0_TXC_PHASE_1G_DEGREE"
	depends on SSTAR_GMAC
	default GMAC_RGMII0_TXC_PHASE_1G_DEGREE_0
config GMAC_RGMII0_TXC_PHASE_1G_DEGREE_0
	bool "DEGREE 0"
config GMAC_RGMII0_TXC_PHASE_1G_DEGREE_90
	bool "DEGREE 90"
config GMAC_RGMII0_TXC_PHASE_1G_DEGREE_180
	bool "DEGREE 180"
config GMAC_RGMII0_TXC_PHASE_1G_DEGREE_270
	bool "DEGREE 270"
endchoice

choice
	prompt "GMAC_RGMII1_TXC_PHASE_100M_DEGREE"
	depends on SSTAR_GMAC
	default GMAC_RGMII1_TXC_PHASE_100M_DEGREE_0
config GMAC_RGMII1_TXC_PHASE_100M_DEGREE_0
	bool "DEGREE 0"
config GMAC_RGMII1_TXC_PHASE_100M_DEGREE_90
	bool "DEGREE 90"
config GMAC_RGMII1_TXC_PHASE_100M_DEGREE_180
	bool "DEGREE 180"
config GMAC_RGMII1_TXC_PHASE_100M_DEGREE_270
	bool "DEGREE 270"
endchoice

choice
	prompt "GMAC_RGMII1_TXC_PHASE_1G_DEGREE"
	depends on SSTAR_GMAC
	default GMAC_RGMII1_TXC_PHASE_1G_DEGREE_0
config GMAC_RGMII1_TXC_PHASE_1G_DEGREE_0
	bool "DEGREE 0"
config GMAC_RGMII1_TXC_PHASE_1G_DEGREE_90
	bool "DEGREE 90"
config GMAC_RGMII1_TXC_PHASE_1G_DEGREE_180
	bool "DEGREE 180"
config GMAC_RGMII1_TXC_PHASE_1G_DEGREE_270
	bool "DEGREE 270"
endchoice
endmenu

config SSTAR_QFN
	bool "EMAC 1 FOR QFN"
	depends on SSTAR_EMAC1

config SSTAR_LQFP
	bool "EMAC 1 FOR LQFP"
	depends on SSTAR_EMAC1

config SSTAR_ETHERNET_ALBANY
	bool "EMAC supply to internel PHY"
	depends on SSTAR_EMAC

config SSTAR_ETHERNET_RMII
	bool "EMAC supply to RMII"
	depends on SSTAR_EMAC

config SSTAR_ETHERNET_ICPLUS
	bool "EMAC supply to IC+ Phy"
	depends on SSTAR_EMAC

config SSTAR_ETHERNET_FIXLINK
	bool "EMAC fix link to mii/rmii"
	depends on SSTAR_EMAC

config SSTAR_IMAGE_POSTFIX
	string "Append postfix name to compressed file"
	default ""
	help
	  u-boot"CONFIG_SSTAR_IMAGE_POSTFIX"

config SSTAR_DISP_HDMITX_VGA
	bool "SigmaStar Display HDMI_TX VGA"

config SSTAR_UPGRADE_UI
	bool "Support upgrade UI"
	depends on SSTAR_DISP

config SSTAR_UPGRADE_UI_WITH_TXT
	bool "Support upgrade UI with text"
	depends on SSTAR_DISP
	depends on SSTAR_UPGRADE_UI

config SSTAR_UPGRADE_UI_DRAW_YUV
	bool "Support upgrade UI(buffer is YUV FMT)"
	depends on SSTAR_DISP
	depends on SSTAR_UPGRADE_UI

config SSTAR_CJSON_PARSER
	bool "SSTAR CJSON FILE PARSER"

config SSTAR_FORCE_IGNORE_ACCESS_WARN
	bool "Ignore H_FORCE flag never print warning msg"
	default y

config SSTAR_WDT
	bool "Sigmastar watchdog"
	select WDT
	select CMD_WDT
	default n

config SSTAR_EMMC_PARTTION
	bool 'Support emmc partitions'
	depends on PARTITIONS

config SSTAR_PCIE
	bool "Sigmastar PCIe bus function"
	select PCI
	select PCIE_DW_COMMON
	default n

config SSTAR_PCIE_ENDPOINT
	bool "Sigmastar PCIe endpoint"
	select PCI_ENDPOINT
	default n

config SSTAR_XZDEC
	bool "Sigmastar xz decompression"
	select LZMA2
	default n

menuconfig SSTAR_CAMDRIVER
	bool "Sigmastar camdriver"
	default n

if (SSTAR_CAMDRIVER)
source "drivers/sstar/camdriver/Kconfig"
endif
source "drivers/sstar/usb/Kconfig"
source "drivers/sstar/fsp_qspi/Kconfig"
source "drivers/sstar/fcie/Kconfig"
source "drivers/sstar/flash/Kconfig"
source "drivers/sstar/usb/gadget/udc/usb20/Kconfig"
source "drivers/sstar/rpmb/Kconfig"
source "drivers/sstar/rtc/Kconfig"
source "drivers/sstar/mcu/Kconfig"
```

## boot/drivers/sstar/camdriver/Kconfig
```kconfig
source "drivers/sstar/camdriver/rgn/Kconfig"
source "drivers/sstar/camdriver/disp/Kconfig"
source "drivers/sstar/camdriver/hdmitx/Kconfig"
source "drivers/sstar/camdriver/panel/Kconfig"
source "drivers/sstar/camdriver/sensor/Kconfig"
source "drivers/sstar/camdriver/jpd/Kconfig"
```

## boot/drivers/sstar/flash/Kconfig
```kconfig
config SSTAR_FLASH
	bool 'SigmaStar FLASH'
	default n

config SSTAR_FLASH_DM
	bool "FLASH DM"
	depends on SSTAR_FLASH
	default n

config SSTAR_NAND
	bool "SPINAND"
	depends on SSTAR_FLASH
	default n

config SSTAR_NOR
	bool "SPINOR"
	depends on SSTAR_FLASH
	default n

config SSTAR_SOC_ECC
	bool "SOC ECC"
	depends on SSTAR_FLASH && SSTAR_NAND
```
